## configs/arm32_rtos_minimal_defconfig
```kconfig
#
# ARM32 RTOS Minimal Configuration
# Target: ARM32 (ARMv7-A) with RTOS
# Purpose: Minimal footprint for RTOS/bare-metal embedded systems
# Optimization: -Os for smallest binary size
# Libraries: Static libraries only (no dynamic linking in RTOS)
#

# ============================================================================
# Build Options
# ============================================================================
CONFIG_OPT_OS=y
CONFIG_LIBRARY_BUILD_TYPE_STATIC=y

# ============================================================================
# Target Platform
# ============================================================================
CONFIG_ARCH_ARM32=y
CONFIG_OS_RTOS=y
CONFIG_CROSS_COMPILE="arm-none-eabi-"

# ============================================================================
# OSAL (Operating System Abstraction Layer)
# ============================================================================
CONFIG_OSAL=y
CONFIG_OSAL_BUILD_STATIC=y

# OSAL Features (Minimal - no file/network in RTOS)
CONFIG_OSAL_IPC=y
CONFIG_OSAL_THREAD=y
CONFIG_OSAL_TIME=y

# OSAL Resource Limits (Minimal for RTOS)
CONFIG_OSAL_MAX_TASKS=16
CONFIG_OSAL_MAX_QUEUES=8
CONFIG_OSAL_MAX_MUTEXES=8

# ============================================================================
# HAL (Hardware Abstraction Layer)
# ============================================================================
CONFIG_HAL=y
CONFIG_HAL_BUILD_STATIC=y
CONFIG_PLATFORM_CUSTOM=y

# HAL Drivers (Essential only - direct hardware access)
CONFIG_HAL_UART=y

CONFIG_HAL_GPIO=y

CONFIG_HAL_WATCHDOG=y

# ============================================================================
# PCL (Protocol Control Layer)
# ============================================================================
CONFIG_PCL=y
CONFIG_PCL_BUILD_STATIC=y

# ============================================================================
# PDL (Protocol Data Layer)
# ============================================================================
CONFIG_PDL=y
CONFIG_PDL_BUILD_STATIC=y

# ============================================================================
# ACL (Application Control Layer)
# ============================================================================
CONFIG_ACL=y
CONFIG_ACL_BUILD_STATIC=y

# ============================================================================
# Products - CCM
# ============================================================================
CONFIG_PRODUCT_CCM=y
CONFIG_PROJECT_H200_AM625=y

# CCM Applications (Minimal - supervisor only)
CONFIG_BUILD_CCM_SUPERVISOR=y
```

## configs/arm64_raspberrypi_defconfig
```kconfig
#
# ARM64 Raspberry Pi Configuration
# Target: Raspberry Pi 4/5 (ARM Cortex-A72/A76)
# Purpose: Raspberry Pi platform for prototyping and development
# Optimization: -O2 for balanced performance
# Libraries: Shared libraries
#

# ============================================================================
# Build Options
# ============================================================================
CONFIG_OPT_O2=y
CONFIG_LIBRARY_BUILD_TYPE_DYNAMIC=y
CONFIG_INSTALL_HEADERS=y

# ============================================================================
# Target Platform
# ============================================================================
CONFIG_ARCH_ARM64=y
CONFIG_OS_LINUX=y
CONFIG_CROSS_COMPILE="aarch64-linux-gnu-"

# ============================================================================
# OSAL (Operating System Abstraction Layer)
# ============================================================================
CONFIG_OSAL=y
CONFIG_OSAL_BUILD_SHARED=y

# OSAL Features
CONFIG_OSAL_FILE=y
CONFIG_OSAL_NETWORK=y
CONFIG_OSAL_IPC=y
CONFIG_OSAL_THREAD=y
CONFIG_OSAL_TIME=y
CONFIG_OSAL_SIGNAL=y

# OSAL Resource Limits (Generous for RPi)
CONFIG_OSAL_MAX_TASKS=128
CONFIG_OSAL_MAX_QUEUES=64
CONFIG_OSAL_MAX_MUTEXES=64

# ============================================================================
# HAL (Hardware Abstraction Layer)
# ============================================================================
CONFIG_HAL=y
CONFIG_HAL_BUILD_SHARED=y
CONFIG_PLATFORM_RASPBERRY_PI=y

# HAL Drivers (Raspberry Pi specific)
CONFIG_HAL_CAN=y
CONFIG_HAL_CAN_FILTER=y
CONFIG_HAL_CAN_ERROR_HANDLING=y

CONFIG_HAL_UART=y

CONFIG_HAL_I2C=y

CONFIG_HAL_SPI=y
CONFIG_HAL_SPI_DMA=y

CONFIG_HAL_GPIO=y
CONFIG_HAL_GPIO_INTERRUPT=y
CONFIG_HAL_GPIO_DEBOUNCE=y

CONFIG_HAL_WATCHDOG=y

# ============================================================================
# PCL (Protocol Control Layer)
# ============================================================================
CONFIG_PCL=y
CONFIG_PCL_BUILD_SHARED=y

# ============================================================================
# PDL (Protocol Data Layer)
# ============================================================================
CONFIG_PDL=y
CONFIG_PDL_BUILD_SHARED=y

# ============================================================================
# ACL (Application Control Layer)
# ============================================================================
CONFIG_ACL=y
CONFIG_ACL_BUILD_SHARED=y

# ============================================================================
# Products - CCM
# ============================================================================
CONFIG_PRODUCT_CCM=y
CONFIG_PROJECT_H200_AM625=y

# CCM Applications (All enabled)
CONFIG_BUILD_CCM_SUPERVISOR=y
CONFIG_BUILD_CCM_COLLECTOR=y
CONFIG_BUILD_CCM_COMM=y
CONFIG_BUILD_CCM_HEALTH=y
CONFIG_BUILD_CCM_LOGGER=y
```

## configs/ccm/ccm_h200_100p_am625_debug_defconfig
```kconfig
# ============================================================================
# CCM H200 Development Configuration (Debug)
# ============================================================================
# CCM (Communication Controller Management) 开发环境配置
# 平台: H200-100P AM625
# 用途: 开发调试，包含所有调试功能和测试工具
# ============================================================================

# Product Selection
CONFIG_PRODUCT_CCM=y
# CONFIG_PRODUCT_CTEST is not set

# Project Identification
CONFIG_PROJECT_NAME="h200_100p_am625"
CONFIG_PROJECT_VERSION="1.0.0"

# Architecture and OS
CONFIG_OS_LINUX=y
# CONFIG_OS_WINDOWS is not set
# CONFIG_OS_RTOS is not set
# CONFIG_OS_MACOS is not set
# CONFIG_OS_BARE is not set
CONFIG_ARCH_ARM64=y
# CONFIG_ARCH_X86_64 is not set
# CONFIG_ARCH_ARM32 is not set
# CONFIG_ARCH_RISCV64 is not set

# Platform
CONFIG_PLATFORM_LINUX=y
CONFIG_PROJECT_H200_100P_AM625=y
# CONFIG_PROJECT_H200_200P is not set

# Core Components - Full Stack
CONFIG_OSAL=y
CONFIG_HAL=y
CONFIG_PDL=y
CONFIG_PRL=y
CONFIG_PCONFIG=y
CONFIG_ACONFIG=y
CONFIG_LIBCCM=y
CONFIG_TEST_FRAMEWORK=y

# Build Configuration - Shared Libraries for Development
CONFIG_OSAL_BUILD_SHARED=y
CONFIG_HAL_BUILD_SHARED=y
CONFIG_PDL_BUILD_SHARED=y
CONFIG_PRL_BUILD_SHARED=y
CONFIG_PCONFIG_BUILD_SHARED=y
CONFIG_ACONFIG_BUILD_SHARED=y

# HAL Drivers - All Enabled
CONFIG_HAL_CAN=y
CONFIG_HAL_UART=y
CONFIG_HAL_I2C=y
CONFIG_HAL_SPI=y
CONFIG_HAL_GPIO=y

# HAL Linux Drivers - All Enabled
CONFIG_HAL_CAN_LINUX=y
CONFIG_HAL_GPIO_LINUX=y
CONFIG_HAL_I2C_LINUX=y
CONFIG_HAL_SPI_LINUX=y
CONFIG_HAL_UART_LINUX=y

# HAL Debug and Statistics
CONFIG_HAL_DEBUG=y
CONFIG_HAL_STATISTICS=y

# PDL Sub-modules - CCM Required
CONFIG_PDL_MCU_SUPPORT=y
# CONFIG_PDL_SATELLITE_SUPPORT is not set
# CONFIG_PDL_BMC_SUPPORT is not set
# CONFIG_PDL_CCM_SUPPORT is not set
# CONFIG_PDL_MISC_SUPPORT is not set

# PDL MCU Drivers
CONFIG_PDL_MCU=y
CONFIG_PDL_MCU_CAN_SUPPORT=y
CONFIG_PDL_MCU_UART_SUPPORT=y
CONFIG_PDL_MCU_CAN=y
CONFIG_PDL_MCU_SERIAL=y
CONFIG_PDL_MCU_PROTOCOL=y


# PRL Protocols - CCM Required
CONFIG_PRL_MCU=y
CONFIG_PRL_CCM=y
CONFIG_PRL_PMC=y
CONFIG_PRL_POWER=y
# CONFIG_PRL_GSC is not set

# PRL Features
CONFIG_PRL_CRC_CHECK=y
CONFIG_PRL_SEQUENCE_CHECK=y
CONFIG_PRL_MAX_PAYLOAD_SIZE=4096

# CCM Applications - All Enabled
CONFIG_APP_COLLECTOR=y
CONFIG_APP_COMM=y
CONFIG_APP_LOGGER=y
CONFIG_APP_HEALTH=y
CONFIG_APP_SUPERVISOR=y

# OSAL Features - All Enabled
CONFIG_OSAL_IPC=y
CONFIG_OSAL_FILE=y
CONFIG_OSAL_THREAD=y
CONFIG_OSAL_NETWORK=y
CONFIG_OSAL_SIGNAL=y

# OSAL IPC - All Enabled
CONFIG_OSAL_IPC_ATOMIC=y
CONFIG_OSAL_IPC_MUTEX=y
CONFIG_OSAL_IPC_RWLOCK=y
CONFIG_OSAL_IPC_SEMAPHORE=y
CONFIG_OSAL_IPC_COND=y
CONFIG_OSAL_IPC_SHM=y
CONFIG_OSAL_IPC_SHM_CACHE=y

# OSAL Library - All Enabled
CONFIG_OSAL_LIB_ERRNO=y
CONFIG_OSAL_LIB_HEAP=y
CONFIG_OSAL_LIB_STDIO=y
CONFIG_OSAL_LIB_STRING=y

# OSAL System - All Enabled
CONFIG_OSAL_SYS_CLOCK=y
CONFIG_OSAL_SYS_ENV=y
CONFIG_OSAL_SYS_FILE=y
CONFIG_OSAL_SYS_PROCESS=y
CONFIG_OSAL_SYS_SCHED=y
CONFIG_OSAL_SYS_SELECT=y
CONFIG_OSAL_SYS_SIGNAL=y
CONFIG_OSAL_SYS_THREAD=y
CONFIG_OSAL_SYS_TIME=y
CONFIG_OSAL_SYS_POLL=y

# OSAL Network - All Enabled
CONFIG_OSAL_NET_SOCKET=y
CONFIG_OSAL_NET_TERMIOS=y

# OSAL Utility - All Enabled
CONFIG_OSAL_UTIL_LOG=y
CONFIG_OSAL_UTIL_VERSION=y
CONFIG_OSAL_UTIL_CRC=y

# Testing - Enabled in Development
CONFIG_BUILD_TESTING=y
CONFIG_TEST_UNIT=y
# CONFIG_TEST_PERFORMANCE is not set
# CONFIG_TEST_STRESS is not set
# CONFIG_TEST_SYSTEM is not set

# ============================================================================
# Debug Features - All Enabled for Development
# ============================================================================
CONFIG_DEBUG_MEMORY_TRACKING=y
CONFIG_DEBUG_BUFFER_OVERFLOW=y
CONFIG_DEBUG_USE_AFTER_FREE=y
CONFIG_DEBUG_DOUBLE_FREE=y
CONFIG_DEBUG_UNINITIALIZED_MEMORY=y
CONFIG_DEBUG_POSTCONDITION_CHECKS=y
CONFIG_DEBUG_INVARIANT_CHECKS=y
CONFIG_DEBUG_PERFORMANCE_COUNTERS=y
CONFIG_DEBUG_CALL_TRACING=y
CONFIG_DEBUG_RESOURCE_TRACKING=y
CONFIG_DEBUG_DUMP_STACK_ON_ERROR=y
CONFIG_DEBUG_CORE_DUMP_ON_FATAL=y
CONFIG_DEBUG_DUMP_ON_SIGNAL=y

# ============================================================================
# Logging Enhancements
# ============================================================================
CONFIG_LOG_FUNCTION_NAME=y
CONFIG_LOG_FILE_LINE=y
CONFIG_LOG_THREAD_ID=y
CONFIG_LOG_TIMESTAMP=y
```

## configs/ccm/ccm_h200_100p_am625_release_defconfig
```kconfig
# ============================================================================
# CCM Production Configuration
# ============================================================================
# CCM (Communication Controller Management) 生产环境配置
# 用于 H200 平台的 CCM 产品部署
# ============================================================================

# Product Selection
CONFIG_PRODUCT_CCM=y

# Architecture and OS
CONFIG_OS_LINUX=y
CONFIG_ARCH_ARM64=y

# Platform
CONFIG_PLATFORM_LINUX=y
CONFIG_PROJECT_H200_100P_AM625=y

# Core Components
CONFIG_OSAL=y
CONFIG_HAL=y
CONFIG_PDL=y
CONFIG_PRL=y
CONFIG_PCONFIG=y
CONFIG_ACONFIG=y
CONFIG_LIBCCM=y

# Build Configuration - Shared Libraries for Production
CONFIG_OSAL_BUILD_SHARED=y
CONFIG_HAL_BUILD_SHARED=y
CONFIG_PDL_BUILD_SHARED=y
CONFIG_PRL_BUILD_SHARED=y
CONFIG_PCONFIG_BUILD_SHARED=y
CONFIG_ACONFIG_BUILD_SHARED=y

# HAL Drivers - Production Required
CONFIG_HAL_CAN=y
CONFIG_HAL_UART=y
CONFIG_HAL_I2C=y
CONFIG_HAL_SPI=y
CONFIG_HAL_GPIO=y
CONFIG_HAL_WATCHDOG=y

# HAL Linux Drivers
CONFIG_HAL_CAN_LINUX=y
CONFIG_HAL_GPIO_LINUX=y
CONFIG_HAL_I2C_LINUX=y
CONFIG_HAL_SPI_LINUX=y
CONFIG_HAL_UART_LINUX=y
CONFIG_HAL_WATCHDOG_LINUX=y

# PDL Sub-modules - CCM Required
CONFIG_PDL_MCU_SUPPORT=y
CONFIG_PDL_WATCHDOG_SUPPORT=y

# PDL MCU Drivers
CONFIG_PDL_MCU=y
CONFIG_PDL_MCU_CAN_SUPPORT=y
CONFIG_PDL_MCU_CAN=y
CONFIG_PDL_MCU_PROTOCOL=y

# PRL Protocols - CCM Required
CONFIG_PRL_MCU=y
CONFIG_PRL_CCM=y
CONFIG_PRL_PMC=y
CONFIG_PRL_POWER=y

# PRL Features
CONFIG_PRL_CRC_CHECK=y
CONFIG_PRL_SEQUENCE_CHECK=y
CONFIG_PRL_MAX_PAYLOAD_SIZE=4096

# CCM Applications - Production
CONFIG_APP_COLLECTOR=y
CONFIG_APP_COMM=y
CONFIG_APP_LOGGER=y
CONFIG_APP_HEALTH=y
CONFIG_APP_SUPERVISOR=y

# OSAL Features - Production Required
CONFIG_OSAL_IPC=y
CONFIG_OSAL_FILE=y
CONFIG_OSAL_THREAD=y
CONFIG_OSAL_NETWORK=y
CONFIG_OSAL_SIGNAL=y

# OSAL IPC
CONFIG_OSAL_IPC_ATOMIC=y
CONFIG_OSAL_IPC_MUTEX=y
CONFIG_OSAL_IPC_RWLOCK=y
CONFIG_OSAL_IPC_SEMAPHORE=y
CONFIG_OSAL_IPC_COND=y
CONFIG_OSAL_IPC_SHM=y
CONFIG_OSAL_IPC_SHM_CACHE=y

# OSAL Library
CONFIG_OSAL_LIB_ERRNO=y
CONFIG_OSAL_LIB_HEAP=y
CONFIG_OSAL_LIB_STDIO=y
CONFIG_OSAL_LIB_STRING=y

# OSAL System
CONFIG_OSAL_SYS_CLOCK=y
CONFIG_OSAL_SYS_ENV=y
CONFIG_OSAL_SYS_FILE=y
CONFIG_OSAL_SYS_PROCESS=y
CONFIG_OSAL_SYS_SCHED=y
CONFIG_OSAL_SYS_SELECT=y
CONFIG_OSAL_SYS_SIGNAL=y
CONFIG_OSAL_SYS_THREAD=y
CONFIG_OSAL_SYS_TIME=y

# OSAL Network
CONFIG_OSAL_NET_SOCKET=y
CONFIG_OSAL_NET_TERMIOS=y

# OSAL Utility
CONFIG_OSAL_UTIL_LOG=y
CONFIG_OSAL_UTIL_VERSION=y

# Testing - Disabled in Production
# CONFIG_BUILD_TESTING is not set
```

## configs/ccm_2apps_defconfig
```kconfig
# ============================================================================
# Products Layer Trimming Test Configuration
# ============================================================================
# This configuration demonstrates products layer (libs/apps) trimming.
# Only selected apps are enabled.
# ============================================================================

# Product Selection
CONFIG_PRODUCT_CCM=y

# Core Components - Full stack
CONFIG_OSAL=y
CONFIG_HAL=y
CONFIG_PCL=y
CONFIG_PDL=y
CONFIG_ACL=y

# OSAL Configuration (use defaults)
CONFIG_OS_LINUX=y
CONFIG_ARCH_X86_64=y
CONFIG_OSAL_BUILD_SHARED=y

# HAL Configuration (use defaults)
CONFIG_PLATFORM_GENERIC_LINUX=y
CONFIG_HAL_BUILD_SHARED=y

# CCM Platform
CONFIG_PROJECT_H200_AM625=y

# ============================================================================
# Products Layer Trimming - Only 2 apps
# ============================================================================

# CCM Libraries - Enable
CONFIG_LIBCCM=y

# CCM Applications - Only enable 2 apps
CONFIG_APP_COLLECTOR=y
CONFIG_APP_COMM=y

# OSAL 构建配置
CONFIG_OSAL_BUILD_STATIC=y

# HAL 构建配置
CONFIG_HAL_BUILD_STATIC=y

# HAL 平台
CONFIG_PLATFORM_GENERIC_LINUX=y

# HAL 驱动
CONFIG_HAL_CAN=y
CONFIG_HAL_UART=y
CONFIG_HAL_I2C=y
CONFIG_HAL_SPI=y
CONFIG_HAL_GPIO=y
CONFIG_HAL_WATCHDOG=y

# HAL Linux 驱动
CONFIG_HAL_CAN_LINUX=y
CONFIG_HAL_GPIO_LINUX=y
CONFIG_HAL_I2C_LINUX=y
CONFIG_HAL_SPI_LINUX=y
CONFIG_HAL_UART_LINUX=y
CONFIG_HAL_WATCHDOG_LINUX=y

# PCL 构建配置
CONFIG_PCL_BUILD_STATIC=y

# PDL 构建配置
CONFIG_PDL_BUILD_STATIC=y

# ACL 构建配置
CONFIG_ACL_BUILD_STATIC=y

# OSAL 功能
CONFIG_OSAL_IPC=y
CONFIG_OSAL_FILE=y
CONFIG_OSAL_THREAD=y
CONFIG_OSAL_NETWORK=y
CONFIG_OSAL_SIGNAL=y

# OSAL IPC
CONFIG_OSAL_IPC_ATOMIC=y
CONFIG_OSAL_IPC_MUTEX=y
CONFIG_OSAL_IPC_SEMAPHORE=y
CONFIG_OSAL_IPC_COND=y
CONFIG_OSAL_IPC_SHM=y
CONFIG_OSAL_IPC_SHM_CACHE=y

# OSAL Library
CONFIG_OSAL_LIB_ERRNO=y
CONFIG_OSAL_LIB_HEAP=y
CONFIG_OSAL_LIB_STDIO=y
CONFIG_OSAL_LIB_STRING=y

# OSAL System
CONFIG_OSAL_SYS_CLOCK=y
CONFIG_OSAL_SYS_ENV=y
CONFIG_OSAL_SYS_FILE=y
CONFIG_OSAL_SYS_PROCESS=y
CONFIG_OSAL_SYS_SCHED=y
CONFIG_OSAL_SYS_SELECT=y
CONFIG_OSAL_SYS_SIGNAL=y
CONFIG_OSAL_SYS_THREAD=y
CONFIG_OSAL_SYS_TIME=y

# OSAL Network
CONFIG_OSAL_NET_SOCKET=y
CONFIG_OSAL_NET_TERMIOS=y

# OSAL Utility
CONFIG_OSAL_UTIL_LOG=y
CONFIG_OSAL_UTIL_VERSION=y
```
