## configs/ctest/ctest_x86_osal_defconfig
```kconfig
# ============================================================================
# OSAL Test Configuration
# ============================================================================
# 专注于 OSAL 层的测试配置
# 包含完整的 OSAL 功能和测试，其他模块最小化
# ============================================================================

# Architecture and OS
CONFIG_OS_LINUX=y
CONFIG_ARCH_X86_64=y

# Platform
CONFIG_PLATFORM_LINUX=y

# Core Components - OSAL Only
CONFIG_OSAL=y
CONFIG_TEST_FRAMEWORK=y

# Build Configuration - Shared Libraries for Testing
CONFIG_OSAL_BUILD_SHARED=y

# OSAL Features - All Enabled
CONFIG_OSAL_IPC=y
CONFIG_OSAL_FILE=y
CONFIG_OSAL_THREAD=y
CONFIG_OSAL_NETWORK=y
CONFIG_OSAL_SIGNAL=y

# OSAL IPC - All Enabled
CONFIG_OSAL_IPC_ATOMIC=y
CONFIG_OSAL_IPC_MUTEX=y
CONFIG_OSAL_IPC_RWLOCK=y
CONFIG_OSAL_IPC_SEMAPHORE=y
CONFIG_OSAL_IPC_COND=y
CONFIG_OSAL_IPC_SHM=y
CONFIG_OSAL_IPC_SHM_CACHE=y

# OSAL Library - All Enabled
CONFIG_OSAL_LIB_ERRNO=y
CONFIG_OSAL_LIB_HEAP=y
CONFIG_OSAL_LIB_STDIO=y
CONFIG_OSAL_LIB_STRING=y
CONFIG_OSAL_LIB_FLOCK=y

# OSAL System - All Enabled
CONFIG_OSAL_SYS_CLOCK=y
CONFIG_OSAL_SYS_ENV=y
CONFIG_OSAL_SYS_FILE=y
CONFIG_OSAL_SYS_POLL=y
CONFIG_OSAL_SYS_PROCESS=y
CONFIG_OSAL_SYS_SCHED=y
CONFIG_OSAL_SYS_SELECT=y
CONFIG_OSAL_SYS_SIGNAL=y
CONFIG_OSAL_SYS_THREAD=y
CONFIG_OSAL_SYS_TIME=y

# OSAL Network - All Enabled
CONFIG_OSAL_NET_SOCKET=y
CONFIG_OSAL_NET_TERMIOS=y

# OSAL Utility - All Enabled
CONFIG_OSAL_UTIL_LOG=y
CONFIG_OSAL_UTIL_VERSION=y

# Testing - OSAL Only
CONFIG_BUILD_TESTING=y
CONFIG_TEST_UNIT=y

# OSAL Unit Tests - All Enabled
CONFIG_TEST_OSAL=y
CONFIG_TEST_OSAL_ALL=y
CONFIG_TEST_OSAL_ATOMIC=y
CONFIG_TEST_OSAL_CLOCK=y
CONFIG_TEST_OSAL_COND=y
CONFIG_TEST_OSAL_ENV=y
CONFIG_TEST_OSAL_ERRNO=y
CONFIG_TEST_OSAL_FILE=y
CONFIG_TEST_OSAL_HEAP=y
CONFIG_TEST_OSAL_LOG=y
CONFIG_TEST_OSAL_MUTEX=y
CONFIG_TEST_OSAL_PROCESS=y
CONFIG_TEST_OSAL_RWLOCK=y
CONFIG_TEST_OSAL_SCHED=y
CONFIG_TEST_OSAL_SEMAPHORE=y
CONFIG_TEST_OSAL_SHM=y
CONFIG_TEST_OSAL_SIGNAL=y
CONFIG_TEST_OSAL_SOCKET=y
CONFIG_TEST_OSAL_STRESS=y
CONFIG_TEST_OSAL_STRING=y
CONFIG_TEST_OSAL_THREAD=y
CONFIG_TEST_OSAL_TIME=y
CONFIG_TEST_OSAL_VERSION=y

# Other test modules disabled
# CONFIG_TEST_HAL is not set
# CONFIG_TEST_PDL is not set
# CONFIG_TEST_PCONFIG is not set
# CONFIG_TEST_ACONFIG is not set
# CONFIG_TEST_PERFORMANCE is not set
# CONFIG_TEST_STRESS is not set
# CONFIG_TEST_SYSTEM is not set

# Other Modules - Disabled
# CONFIG_HAL is not set
# CONFIG_PCONFIG is not set
# CONFIG_PDL is not set
# CONFIG_ACONFIG is not set

# Products - Disabled
```

## configs/ctest/ctest_x86_pconfig_defconfig
```kconfig
# ============================================================================
# PCONFIG Test Configuration
# ============================================================================
# PCONFIG (Platform Configuration Layer) 测试配置
# 用于测试平台配置层功能
# ============================================================================

# Architecture and OS
CONFIG_OS_LINUX=y
CONFIG_ARCH_X86_64=y

# Platform
CONFIG_PLATFORM_LINUX=y
CONFIG_PROJECT_H200_AM625=y

CONFIG_OSAL=y
CONFIG_TEST_FRAMEWORK=y
CONFIG_HAL=y
CONFIG_PDL=y
CONFIG_PCONFIG=y

# Build Configuration
CONFIG_OSAL_BUILD_SHARED=y
CONFIG_HAL_BUILD_SHARED=y
CONFIG_PDL_BUILD_SHARED=y
CONFIG_PCONFIG_BUILD_SHARED=y

# OSAL Features - Required
CONFIG_OSAL_IPC=y
CONFIG_OSAL_FILE=y
CONFIG_OSAL_THREAD=y

# OSAL IPC
CONFIG_OSAL_IPC_ATOMIC=y
CONFIG_OSAL_IPC_MUTEX=y
CONFIG_OSAL_IPC_RWLOCK=y

# OSAL Library
CONFIG_OSAL_LIB_ERRNO=y
CONFIG_OSAL_LIB_HEAP=y
CONFIG_OSAL_LIB_STDIO=y
CONFIG_OSAL_LIB_STRING=y

# OSAL Network
CONFIG_OSAL_NET_SOCKET=y
CONFIG_OSAL_NET_TERMIOS=y

# OSAL System - Enable All
CONFIG_OSAL_SYS_CLOCK=y
CONFIG_OSAL_SYS_ENV=y
CONFIG_OSAL_SYS_FILE=y
CONFIG_OSAL_SYS_PROCESS=y
CONFIG_OSAL_SYS_SCHED=y
CONFIG_OSAL_SYS_SELECT=y
CONFIG_OSAL_SYS_THREAD=y
CONFIG_OSAL_SYS_TIME=y

# OSAL Utility
CONFIG_OSAL_UTIL_LOG=y
CONFIG_OSAL_UTIL_VERSION=y

# Testing - Enabled
CONFIG_BUILD_TESTING=y
CONFIG_TEST_UNIT=y

# PCONFIG Unit Tests - All Enabled
CONFIG_TEST_PCONFIG=y
CONFIG_TEST_PCONFIG_ALL=y
CONFIG_TEST_PCONFIG_API=y

# Other test modules disabled
# CONFIG_TEST_OSAL is not set
# CONFIG_TEST_HAL is not set
# CONFIG_TEST_PDL is not set
# CONFIG_TEST_ACONFIG is not set
# CONFIG_TEST_PERFORMANCE is not set
# CONFIG_TEST_STRESS is not set
# CONFIG_TEST_SYSTEM is not set

# Products - All Disabled

# HAL - Disabled

# PDL - Disabled


# HAL Features - Enable basic features
CONFIG_HAL_CAN=y
CONFIG_HAL_GPIO=y
CONFIG_HAL_I2C=y
CONFIG_HAL_SPI=y
CONFIG_HAL_UART=y

# PDL Features - Enable basic modules
CONFIG_PDL_MCU_SUPPORT=y
```

## configs/ctest/ctest_x86_pdl_defconfig
```kconfig
# ============================================================================
# PDL Unit Test Configuration
# ============================================================================
# Only PDL module (and its dependencies OSAL + HAL) is enabled for unit testing.
# All other modules are disabled.
# ============================================================================

# Architecture and OS
CONFIG_OS_LINUX=y
CONFIG_ARCH_X86_64=y

# Platform
CONFIG_PLATFORM_LINUX=y

# Core Modules - OSAL + HAL + PDL
CONFIG_OSAL=y
CONFIG_TEST_FRAMEWORK=y
CONFIG_HAL=y
# CONFIG_PCONFIG is not set
CONFIG_PDL=y
# CONFIG_ACONFIG is not set

# Build Configuration
CONFIG_OSAL_BUILD_SHARED=y
CONFIG_HAL_BUILD_SHARED=y
CONFIG_PDL_BUILD_SHARED=y

# HAL Drivers
CONFIG_HAL_CAN=y
CONFIG_HAL_UART=y
CONFIG_HAL_I2C=y
CONFIG_HAL_SPI=y
CONFIG_HAL_GPIO=y

# HAL Linux Drivers
CONFIG_HAL_CAN_LINUX=y
CONFIG_HAL_GPIO_LINUX=y
CONFIG_HAL_I2C_LINUX=y
CONFIG_HAL_SPI_LINUX=y
CONFIG_HAL_UART_LINUX=y

# PDL Sub-modules - Enable All
CONFIG_PDL_SATELLITE_SUPPORT=y
CONFIG_PDL_BMC_SUPPORT=y
CONFIG_PDL_MCU_SUPPORT=y

# PDL Satellite Drivers
CONFIG_PDL_SATELLITE=y
CONFIG_PDL_SATELLITE_CAN=y

# PDL BMC Drivers
CONFIG_PDL_BMC=y
CONFIG_PDL_BMC_IPMI=y
CONFIG_PDL_BMC_REDFISH=y
CONFIG_PDL_BMC_TRANSPORT=y

# PDL MCU Drivers
CONFIG_PDL_MCU=y
CONFIG_PDL_MCU_CAN_SUPPORT=y
CONFIG_PDL_MCU_UART_SUPPORT=y
CONFIG_PDL_MCU_CAN=y
CONFIG_PDL_MCU_SERIAL=y
CONFIG_PDL_MCU_PROTOCOL=y

# OSAL Features
CONFIG_OSAL_IPC=y
CONFIG_OSAL_FILE=y
CONFIG_OSAL_THREAD=y
CONFIG_OSAL_NETWORK=y
CONFIG_OSAL_SIGNAL=y

# OSAL IPC
CONFIG_OSAL_IPC_ATOMIC=y
CONFIG_OSAL_IPC_MUTEX=y
CONFIG_OSAL_IPC_SEMAPHORE=y
CONFIG_OSAL_IPC_COND=y
CONFIG_OSAL_IPC_SHM=y
CONFIG_OSAL_IPC_SHM_CACHE=y

# OSAL Library
CONFIG_OSAL_LIB_ERRNO=y
CONFIG_OSAL_LIB_HEAP=y
CONFIG_OSAL_LIB_STDIO=y
CONFIG_OSAL_LIB_STRING=y

# OSAL System
CONFIG_OSAL_SYS_CLOCK=y
CONFIG_OSAL_SYS_ENV=y
CONFIG_OSAL_SYS_FILE=y
CONFIG_OSAL_SYS_PROCESS=y
CONFIG_OSAL_SYS_SCHED=y
CONFIG_OSAL_SYS_SELECT=y
CONFIG_OSAL_SYS_SIGNAL=y
CONFIG_OSAL_SYS_THREAD=y
CONFIG_OSAL_SYS_TIME=y

# OSAL Network
CONFIG_OSAL_NET_SOCKET=y
CONFIG_OSAL_NET_TERMIOS=y

# OSAL Utility
CONFIG_OSAL_UTIL_LOG=y
CONFIG_OSAL_UTIL_VERSION=y

# Testing
CONFIG_BUILD_TESTING=y
CONFIG_TEST_UNIT=y

# PDL Unit Tests - All Enabled
CONFIG_TEST_PDL=y
CONFIG_TEST_PDL_ALL=y
CONFIG_TEST_PDL_BMC=y
CONFIG_TEST_PDL_BMC_PROTOCOL=y
CONFIG_TEST_PDL_MCU=y
CONFIG_TEST_PDL_SATELLITE=y

# Other test modules disabled
# CONFIG_TEST_OSAL is not set
# CONFIG_TEST_HAL is not set
# CONFIG_TEST_PRL is not set
# CONFIG_TEST_PCONFIG is not set
# CONFIG_TEST_ACONFIG is not set
# CONFIG_TEST_PERFORMANCE is not set
# CONFIG_TEST_STRESS is not set
# CONFIG_TEST_SYSTEM is not set

# Products - All Disabled
# CONFIG_PRODUCT_PMC is not set
```

## configs/ctest/ctest_x86_pdm_protocol_defconfig
```kconfig
# ============================================================================
# PDM Protocol Test Configuration
# ============================================================================

# Architecture and OS
CONFIG_OS_LINUX=y
CONFIG_ARCH_X86_64=y
CONFIG_PLATFORM_LINUX=y

# Core Components - PDM internal protocol path
CONFIG_OSAL=y
CONFIG_HAL=y
CONFIG_PCONFIG=y
CONFIG_PDM=y
CONFIG_TEST_FRAMEWORK=y

# Build Configuration
CONFIG_OSAL_BUILD_SHARED=y
CONFIG_HAL_BUILD_SHARED=y
CONFIG_PCONFIG_BUILD_SHARED=y
CONFIG_PDM_BUILD_STATIC=y

# HAL drivers required by PDM MCU transports
CONFIG_HAL_CAN=y
CONFIG_HAL_UART=y
CONFIG_HAL_CAN_LINUX=y
CONFIG_HAL_UART_LINUX=y

# PDM protocol and MCU support
CONFIG_PDM_MCU_SUPPORT=y
CONFIG_PDM_PROTOCOL=y
CONFIG_PDM_PROTOCOL_MCU=y
CONFIG_PDM_PROTOCOL_CRC_CHECK=y
CONFIG_PDM_PROTOCOL_SEQUENCE_CHECK=y
CONFIG_PDM_PROTOCOL_TIMESTAMP_CHECK=y
CONFIG_PDM_PROTOCOL_MAX_PAYLOAD_SIZE=4096

# OSAL Features
CONFIG_OSAL_IPC=y
CONFIG_OSAL_THREAD=y
CONFIG_OSAL_NETWORK=y
CONFIG_OSAL_FILE=y

# OSAL IPC
CONFIG_OSAL_IPC_ATOMIC=y
CONFIG_OSAL_IPC_MUTEX=y

# OSAL Library
CONFIG_OSAL_LIB_ERRNO=y
CONFIG_OSAL_LIB_HEAP=y
CONFIG_OSAL_LIB_STDIO=y
CONFIG_OSAL_LIB_STRING=y

# OSAL System
CONFIG_OSAL_SYS_CLOCK=y
CONFIG_OSAL_SYS_ENV=y
CONFIG_OSAL_SYS_FILE=y
CONFIG_OSAL_SYS_PROCESS=y
CONFIG_OSAL_SYS_SCHED=y
CONFIG_OSAL_SYS_SELECT=y
CONFIG_OSAL_SYS_THREAD=y
CONFIG_OSAL_SYS_TIME=y

# OSAL Network
CONFIG_OSAL_NET_SOCKET=y
CONFIG_OSAL_NET_TERMIOS=y

# OSAL Utility
CONFIG_OSAL_UTIL_LOG=y
CONFIG_OSAL_UTIL_VERSION=y
CONFIG_OSAL_UTIL_CRC=y

# Testing - build the ctest product with PDM protocol enabled
CONFIG_BUILD_TESTING=y
CONFIG_TEST_UNIT=y
CONFIG_TEST_PDM=y
CONFIG_TEST_PDM_PROTOCOL=y

# Other test modules disabled
# CONFIG_TEST_OSAL is not set
# CONFIG_TEST_HAL is not set
# CONFIG_TEST_PDI is not set
# CONFIG_TEST_PCONFIG is not set
# CONFIG_TEST_ACONFIG is not set
# CONFIG_TEST_PERFORMANCE is not set
# CONFIG_TEST_STRESS is not set
# CONFIG_TEST_SYSTEM is not set
```

## configs/defconfig
```kconfig
#
# EMS Default Configuration
# Target: x86_64 Linux
# Purpose: Balanced default configuration for general use
# Optimization: -O2 for balanced performance and size
# Libraries: Both static and shared
#

# ============================================================================
# Build Options
# ============================================================================
CONFIG_OPT_O2=y
CONFIG_LIBRARY_BUILD_TYPE_STATIC=y
CONFIG_LIBRARY_BUILD_TYPE_DYNAMIC=y
CONFIG_INSTALL_HEADERS=y

# ============================================================================
# Target Platform
# ============================================================================
CONFIG_ARCH_X86_64=y
CONFIG_OS_LINUX=y
CONFIG_CROSS_COMPILE=""

# ============================================================================
# OSAL (Operating System Abstraction Layer)
# ============================================================================
CONFIG_OSAL=y
CONFIG_OSAL_BUILD_STATIC=y
CONFIG_OSAL_BUILD_SHARED=y

# OSAL Features
CONFIG_OSAL_FILE=y
CONFIG_OSAL_NETWORK=y
CONFIG_OSAL_IPC=y
CONFIG_OSAL_THREAD=y
CONFIG_OSAL_TIME=y
CONFIG_OSAL_SIGNAL=y

# OSAL Resource Limits (Balanced)
CONFIG_OSAL_MAX_TASKS=128
CONFIG_OSAL_MAX_QUEUES=64
CONFIG_OSAL_MAX_MUTEXES=64

# ============================================================================
# HAL (Hardware Abstraction Layer)
# ============================================================================
CONFIG_HAL=y
CONFIG_HAL_BUILD_STATIC=y
CONFIG_HAL_BUILD_SHARED=y
CONFIG_PLATFORM_GENERIC_LINUX=y

# HAL Drivers (Common drivers)
CONFIG_HAL_CAN=y
CONFIG_HAL_CAN_FILTER=y
CONFIG_HAL_CAN_ERROR_HANDLING=y

CONFIG_HAL_UART=y

CONFIG_HAL_I2C=y

CONFIG_HAL_SPI=y

CONFIG_HAL_GPIO=y
CONFIG_HAL_GPIO_INTERRUPT=y

CONFIG_HAL_WATCHDOG=y

# ============================================================================
# PCL (Protocol Control Layer)
# ============================================================================
CONFIG_PCL=y
CONFIG_PCL_BUILD_STATIC=y
CONFIG_PCL_BUILD_SHARED=y

# ============================================================================
# PDL (Protocol Data Layer)
# ============================================================================
CONFIG_PDL=y
CONFIG_PDL_BUILD_STATIC=y
CONFIG_PDL_BUILD_SHARED=y

# ============================================================================
# ACL (Application Control Layer)
# ============================================================================
CONFIG_ACL=y
CONFIG_ACL_BUILD_STATIC=y
CONFIG_ACL_BUILD_SHARED=y

# ============================================================================
# Products - CCM
# ============================================================================
CONFIG_PRODUCT_CCM=y
CONFIG_PROJECT_H200_AM625=y

# CCM Applications (All enabled)
CONFIG_BUILD_CCM_SUPERVISOR=y
CONFIG_BUILD_CCM_COLLECTOR=y
CONFIG_BUILD_CCM_COMM=y
CONFIG_BUILD_CCM_HEALTH=y
CONFIG_BUILD_CCM_LOGGER=y
```
