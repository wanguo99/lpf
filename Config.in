## Config.in
```kconfig
# ============================================================================
# LPF SDK Root Configuration
# ============================================================================
# This is the root Config.in file for the LPF kernel-centric SDK.
# It provides a unified configuration interface for core components.
# ============================================================================

mainmenu "LPF (Linux Peripheral Framework) Configuration"

config LPF_VERSION
	string
	default "1.0.0"

# ============================================================================
# Project Identification
# ============================================================================

config PROJECT_NAME
	string "Project name"
	default "unknown"
	help
	  Project name, typically extracted from defconfig filename.

	  Naming convention: <scope>_<project>_defconfig
	  - ubuntu_x86_modules_defconfig → project name: x86_modules

	  Can be overridden in defconfig file by setting CONFIG_PROJECT_NAME.

config PROJECT_VERSION
	string "Project version"
	default LPF_VERSION
	help
	  Project version string.

# ============================================================================
# Build Profile
# ============================================================================

config LINUX_ONLY
	bool "Linux-only profile"
	default n
	help
	  Restrict the SDK to Linux development only.

	  This profile hides non-Linux operating system options. It is
	  intended for the current kernel-centric peripheral framework direction.

# ============================================================================
# Build System Configuration
# ============================================================================

menu "Build System Configuration"

config MODULES
	bool "Enable loadable module support"
	default y
	modules
	help
	  Enable Kconfig tristate module values. LPF kernel products are built
	  as external loadable modules, so top-level kernel module targets use
	  =m while features linked into those modules remain bool options.

# ============================================================================
# Platform Configuration (Top Level)
# ============================================================================

choice
	prompt "Target operating system"
	default OS_LINUX
	help
	  Select the target operating system type.

	  LPF currently supports Linux only.

config OS_LINUX
	bool "Linux"
	help
	  Target Linux operating system (POSIX-compliant).

	  Provides:
	  - Full POSIX API support
	  - Complete IPC, threading, networking
	  - Virtual memory management
	  - Rich filesystem support

	  Suitable for: Embedded Linux (AM625, i.MX6/8, Zynq), Desktop Linux
	  Memory: Requires MMU, typically 32MB+ RAM

endchoice

config OS
	string
	default "linux" if OS_LINUX

choice
	prompt "Target architecture"
	default ARCH_X86_64
	help
	  Select the target CPU architecture.

	  This determines compiler flags, calling conventions,
	  and architecture-specific optimizations.

config ARCH_X86_64
	bool "x86_64 (64-bit Intel/AMD)"
	help
	  Intel/AMD 64-bit architecture (x86-64, amd64).

	  Features:
	  - 64-bit addressing
	  - SSE/AVX SIMD instructions
	  - Rich instruction set

	  Suitable for: Desktop, server, development machines
	  Performance: High compute capability, good for testing

config ARCH_ARM32
	bool "ARM (32-bit)"
	help
	  ARM 32-bit architecture (ARMv7-A and compatible).

	  Features:
	  - 32-bit addressing
	  - NEON SIMD (optional)
	  - Lower power consumption

	  Suitable for: Cortex-A7, A9, A15 processors
	  Examples: i.MX6, OMAP, older Raspberry Pi

config ARCH_ARM64
	bool "ARM64 (AArch64)"
	help
	  ARM 64-bit architecture (ARMv8-A and later).

	  Features:
	  - 64-bit addressing
	  - Advanced SIMD (NEON)
	  - Efficient instruction encoding

	  Suitable for: Cortex-A53, A72, A76 processors
	  Examples: TI AM625, NXP i.MX8, Raspberry Pi 4

config ARCH_RISCV64
	bool "RISC-V (64-bit)"
	help
	  RISC-V 64-bit architecture.

	  Features:
	  - Open ISA
	  - Modular extension architecture
	  - Clean instruction encoding

	  Suitable for: RISC-V processors (SiFive, Andes, etc)
	  Note: Experimental support

endchoice

config ARCH
	string
	default "x86_64" if ARCH_X86_64
	default "arm" if ARCH_ARM32
	default "arm64" if ARCH_ARM64
	default "riscv64" if ARCH_RISCV64

config TOOLCHAIN_PREFIX
	string "Toolchain prefix"
	default "aarch64-linux-gnu-" if ARCH_ARM64
	default "arm-linux-gnueabihf-" if ARCH_ARM32
	default ""
	help
	  Toolchain prefix for cross-compilation.

	  Examples:
	    ARM64: aarch64-linux-gnu- or aarch64-none-linux-gnu-
	    ARM32: arm-linux-gnueabihf-
	    x86_64: Leave empty for native compilation

config TOOLCHAIN_PATH
	string "Toolchain path"
	default ""
	help
	  Absolute path to the cross-compilation toolchain.
	  Leave empty to use system default compiler.

	  Example: /opt/toolchains/gcc-arm-11.2/bin

# ============================================================================
# Build Type and Optimization (Top Level)
# ============================================================================

choice
	prompt "Build type"
	default BUILD_TYPE_DEBUG
	help
	  Select the build type.

	  This affects optimization level, debug symbols, and runtime checks.

config BUILD_TYPE_DEBUG
	bool "Debug"
	help
	  Debug build with no optimization and full debug symbols.

	  - Optimization: -O0
	  - Debug symbols: -g
	  - Assertions: Enabled
	  - DEBUG macro: Defined (DEBUG=1, RELEASE=0)

	  Use for development and debugging.

config BUILD_TYPE_RELEASE
	bool "Release"
	help
	  Release build with optimization and no debug symbols.

	  - Optimization: -O2
	  - Debug symbols: None
	  - Assertions: Disabled
	  - RELEASE macro: Defined (RELEASE=1, DEBUG=0)

	  Use for production deployment.

config BUILD_TYPE_RELWITHDEBINFO
	bool "RelWithDebInfo"
	help
	  Release build with debug symbols.

	  - Optimization: -O2
	  - Debug symbols: -g
	  - Assertions: Disabled
	  - RELEASE macro: Defined (RELEASE=1, DEBUG=0)

	  Use for profiling and debugging optimized code.

config BUILD_TYPE_MINSIZEREL
	bool "MinSizeRel"
	help
	  Release build optimized for size.

	  - Optimization: -Os
	  - Debug symbols: None
	  - Assertions: Disabled
	  - RELEASE macro: Defined (RELEASE=1, DEBUG=0)

	  Use for storage-constrained systems.

endchoice

config BUILD_TYPE
	string
	default "Debug" if BUILD_TYPE_DEBUG
	default "Release" if BUILD_TYPE_RELEASE
	default "RelWithDebInfo" if BUILD_TYPE_RELWITHDEBINFO
	default "MinSizeRel" if BUILD_TYPE_MINSIZEREL

choice
	prompt "Optimization level"
	default COMPILER_OPT_DEFAULT
	help
	  Select compiler optimization level.

	  Different optimization levels trade off between code size,
	  compilation time, and runtime performance.

config COMPILER_OPT_DEFAULT
	bool "Default (based on build type)"
	help
	  Use optimization level based on build type:
	    Debug: -O0 (no optimization, best for debugging)
	    Release: -O2 (recommended for production)
	    RelWithDebInfo: -O2 (optimized with debug info)
	    MinSizeRel: -Os (optimize for size)

config COMPILER_OPT_O0
	bool "-O0: No optimization"
	help
	  Disable all optimization. Best for debugging.
	  Fastest compilation time.

	  Note: Requires CONFIG_COMPILER_DISABLE_FORTIFY_WITH_O0
	  in Buildroot/Yocto environments.

config COMPILER_OPT_O1
	bool "-O1: Basic optimization"
	help
	  Enable basic optimization that doesn't increase
	  compilation time significantly. Good balance for
	  debugging with some performance.

config COMPILER_OPT_O2
	bool "-O2: Recommended optimization"
	help
	  Enable most optimizations that don't involve a
	  space-speed tradeoff. Recommended for production.

config COMPILER_OPT_O3
	bool "-O3: Aggressive optimization"
	help
	  Enable all optimizations including those that may
	  increase code size. Maximum performance.

config COMPILER_OPT_OS
	bool "-Os: Optimize for size"
	help
	  Optimize for small code size. Good for embedded
	  systems with limited flash/ROM.

config COMPILER_OPT_OFAST
	bool "-Ofast: Maximum speed (non-standard)"
	help
	  Enable all -O3 optimizations plus fast math.
	  May not conform to standards (e.g., IEEE 754).

config COMPILER_OPT_OG
	bool "-Og: Optimize for debugging"
	help
	  Optimize while maintaining good debugging experience.
	  Better than -O0 performance, better than -O1 debugging.
	  Requires GCC 4.8+ or Clang 4.0+.

endchoice

config COMPILER_OPTIMIZATION_LEVEL
	string
	default "" if COMPILER_OPT_DEFAULT
	default "-O0" if COMPILER_OPT_O0
	default "-O1" if COMPILER_OPT_O1
	default "-O2" if COMPILER_OPT_O2
	default "-O3" if COMPILER_OPT_O3
	default "-Os" if COMPILER_OPT_OS
	default "-Ofast" if COMPILER_OPT_OFAST
	default "-Og" if COMPILER_OPT_OG

config COMPILER_DEBUG_LEVEL
	string "Debug information level"
	default "-g" if BUILD_TYPE_DEBUG || BUILD_TYPE_RELWITHDEBINFO
	default ""
	help
	  Debug information level flag.

	  Options:
	    -g   : Default debug info
	    -g3  : Maximum debug info (includes macro definitions)
	    -ggdb: GDB-specific debug info
	    (empty): No debug info

# ============================================================================
# Runtime Options (Top Level)
# ============================================================================

config ENABLE_ASSERT
	bool "Enable assertions"
	default y if BUILD_TYPE_DEBUG
	default n
	help
	  Enable runtime assertions.

	  When disabled, defines NDEBUG macro to remove assert() checks.

config STACK_PROTECTOR
	bool "Enable stack protector"
	default y if BUILD_TYPE_DEBUG || BUILD_TYPE_RELEASE
	default n
	help
	  Enable stack overflow protection.

	  Adds -fstack-protector-strong flag.

config POSITION_INDEPENDENT_CODE
	bool "Generate position independent code (PIC)"
	default y
	help
	  Generate position independent code for shared libraries.

	  Adds -fPIC flag.

config FORTIFY_SOURCE
	bool "Enable FORTIFY_SOURCE"
	default y if BUILD_TYPE_RELEASE
	default n
	help
	  Enable compile-time and runtime buffer overflow protection.

	  Defines _FORTIFY_SOURCE=2.

	  Only effective with optimization level >= -O1.

config COMPILER_DISABLE_FORTIFY_WITH_O0
	bool "Disable _FORTIFY_SOURCE when using -O0"
	default y
	help
	  Automatically disable _FORTIFY_SOURCE macro when compiling
	  with -O0 optimization level.

	  _FORTIFY_SOURCE is a glibc feature that adds compile-time and
	  runtime checks for buffer overflows. However, it requires
	  optimization (-O1 or higher) to work properly.

	  This option is essential for Buildroot/Yocto/embedded toolchains
	  that automatically add -D_FORTIFY_SOURCE=2, which conflicts with
	  debug builds using -O0.

	  When enabled, adds -U_FORTIFY_SOURCE flag automatically when
	  CONFIG_BUILD_TYPE_DEBUG uses -O0.

	  Recommended: Keep enabled for cross-compilation environments.
	  Disable only if you're sure your toolchain doesn't add
	  _FORTIFY_SOURCE automatically.

# ============================================================================
# Compiler Warnings (Top Level)
# ============================================================================

config COMPILER_WARNINGS_AS_ERRORS
	bool "Treat warnings as errors (-Werror)"
	default y
	help
	  Enable -Werror flag to treat all compiler warnings as errors.

	  This ensures code quality by preventing compilation when
	  warnings are present.

	  Recommended for production code.

config COMPILER_WALL
	bool "Enable all warnings (-Wall)"
	default y
	help
	  Enable -Wall flag to show all common compiler warnings.

config COMPILER_WEXTRA
	bool "Enable extra warnings (-Wextra)"
	default n
	help
	  Enable -Wextra flag for additional compiler warnings.

config COMPILER_PEDANTIC
	bool "Enable pedantic warnings (-Wpedantic)"
	default n
	help
	  Enable -Wpedantic flag for strict ISO C compliance warnings.

# ============================================================================
# Advanced Options (Collapsed by default)
# ============================================================================

menu "Advanced Compiler Options"

config COMPILER_LTO
	bool "Enable Link Time Optimization (LTO)"
	default n
	depends on BUILD_TYPE_RELEASE || BUILD_TYPE_MINSIZEREL
	help
	  Enable Link Time Optimization for better performance.

	  Adds -flto flag.

	  Note: Increases build time significantly.

config COMPILER_SANITIZER_ADDRESS
	bool "Enable AddressSanitizer"
	default n
	depends on BUILD_TYPE_DEBUG
	help
	  Enable AddressSanitizer for detecting memory errors.

	  Adds -fsanitize=address flag.

	  Note: This adds significant runtime overhead.
	  Only use for debugging and testing.

config COMPILER_SANITIZER_THREAD
	bool "Enable ThreadSanitizer"
	default n
	depends on BUILD_TYPE_DEBUG
	help
	  Enable ThreadSanitizer for detecting data races.

	  Adds -fsanitize=thread flag.

	  Note: Cannot be used with AddressSanitizer.

config COMPILER_SANITIZER_UNDEFINED
	bool "Enable UndefinedBehaviorSanitizer"
	default n
	depends on BUILD_TYPE_DEBUG
	help
	  Enable UndefinedBehaviorSanitizer for detecting undefined behavior.

	  Adds -fsanitize=undefined flag.

config COMPILER_COVERAGE
	bool "Enable code coverage (-fprofile-arcs -ftest-coverage)"
	default n
	depends on BUILD_TYPE_DEBUG
	help
	  Enable code coverage instrumentation for gcov/lcov.

	  Adds -fprofile-arcs -ftest-coverage flags.

config COMPILER_CUSTOM_C_FLAGS
	string "Custom C flags"
	default ""
	help
	  Additional custom C compiler flags.

	  These flags are appended to the default flags.

	  Example: -fno-strict-aliasing -Wno-unused-parameter

config COMPILER_CUSTOM_CXX_FLAGS
	string "Custom C++ flags"
	default ""
	help
	  Additional custom C++ compiler flags.

	  These flags are appended to the default flags.

config COMPILER_CUSTOM_LINK_FLAGS
	string "Custom linker flags"
	default ""
	help
	  Additional custom linker flags.

	  Example: -Wl,--gc-sections -Wl,--print-memory-usage

endmenu

endmenu

# ============================================================================
# Module Configuration
# ============================================================================

menu "Modules"

source "user/osal/Config.in"
source "kernel/lpf-core/Config.in"
source "kernel/lpf-configs/Config.in"
source "user/aconfig/Config.in"
source "user/pdi/Config.in"

endmenu

# ============================================================================
# Product-Specific Configuration
# ============================================================================

# ============================================================================
# Configuration Validation
# ============================================================================

# ============================================================================
# Configuration Sanity Checks
# ============================================================================
# These hidden configs detect invalid configurations and show error messages.
# They prevent build failures by catching configuration conflicts early.
# ============================================================================

menu "Configuration Validation"

# ============================================================================
# Dependency Checks
# ============================================================================

config SANITY_ERROR_LPF_RUNTIME_NO_DEPS
	def_bool y
	depends on LPF_RUNTIME && (!OSAL || !LPF_CORE)
	prompt "ERROR: LPF runtime requires OSAL and LPF Core to be enabled"

config SANITY_ERROR_ACONFIG_NO_OSAL
	def_bool y
	depends on ACONFIG && !OSAL
	prompt "ERROR: ACONFIG requires OSAL to be enabled"

# ============================================================================
# LPF HW Dependency Checks
# ============================================================================

config SANITY_ERROR_LPF_HW_CAN_NO_PLATFORM
	def_bool y
	depends on LPF_HW_CAN && !PLATFORM_LINUX
	prompt "ERROR: LPF_HW_CAN requires Linux platform support (PLATFORM_LINUX)"

config SANITY_ERROR_LPF_HW_UART_NO_PLATFORM
	def_bool y
	depends on LPF_HW_UART && !PLATFORM_LINUX
	prompt "ERROR: LPF_HW_UART requires Linux platform support (PLATFORM_LINUX)"

config SANITY_ERROR_LPF_HW_GPIO_NO_PLATFORM
	def_bool y
	depends on LPF_HW_GPIO && !PLATFORM_LINUX
	prompt "ERROR: LPF_HW_GPIO requires Linux platform support (PLATFORM_LINUX)"

config SANITY_ERROR_LPF_HW_PWM_NO_PLATFORM
	def_bool y
	depends on LPF_HW_PWM && !PLATFORM_LINUX
	prompt "ERROR: LPF_HW_PWM requires Linux platform support (PLATFORM_LINUX)"

config SANITY_ERROR_LPF_HW_I2C_NO_PLATFORM
	def_bool y
	depends on LPF_HW_I2C && !PLATFORM_LINUX
	prompt "ERROR: LPF_HW_I2C requires Linux platform support (PLATFORM_LINUX)"

config SANITY_ERROR_LPF_HW_SPI_NO_PLATFORM
	def_bool y
	depends on LPF_HW_SPI && !PLATFORM_LINUX
	prompt "ERROR: LPF_HW_SPI requires Linux platform support (PLATFORM_LINUX)"

# ============================================================================
# Compatibility Checks
# ============================================================================

config SANITY_ERROR_SANITIZER_CONFLICT
	def_bool y
	depends on COMPILER_SANITIZER_ADDRESS && COMPILER_SANITIZER_THREAD
	prompt "ERROR: AddressSanitizer and ThreadSanitizer cannot be used together"

# ============================================================================
# Product Configuration Checks
# ============================================================================

# ============================================================================
# Configuration Summary
# ============================================================================

config SANITY_CHECK_PASSED
	def_bool y
	depends on !SANITY_ERROR_LPF_RUNTIME_NO_DEPS && \
	           !SANITY_ERROR_ACONFIG_NO_OSAL && \
	           !SANITY_ERROR_LPF_HW_CAN_NO_PLATFORM && \
	           !SANITY_ERROR_LPF_HW_UART_NO_PLATFORM && \
	           !SANITY_ERROR_LPF_HW_GPIO_NO_PLATFORM && \
	           !SANITY_ERROR_LPF_HW_PWM_NO_PLATFORM && \
	           !SANITY_ERROR_LPF_HW_I2C_NO_PLATFORM && \
	           !SANITY_ERROR_LPF_HW_SPI_NO_PLATFORM && \
	           !SANITY_ERROR_SANITIZER_CONFLICT
	help
	  This symbol is set when all sanity checks pass.
	  If this is not set, review error messages above.

endmenu
```
