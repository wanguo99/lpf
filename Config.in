## Kconfig
```kconfig
# ============================================================================
# ES-Middleware SDK Root Configuration
# ============================================================================
# This is the root Kconfig file for the entire ES-Middleware SDK.
# It provides a unified configuration interface for:
#   - Product selection (which products to build)
#   - Core components configuration (OSAL, HAL, PCL, PDL, ACL)
#   - Product-specific configurations
# ============================================================================

mainmenu "ES-Middleware SDK Configuration"

# ============================================================================
# Configuration Templates (Quick Start)
# ============================================================================
# Load a predefined configuration template to quickly get started.
# You can further customize the configuration after loading a template.
# ============================================================================

menu "Configuration Templates"

choice
	prompt "Load configuration template"
	default TEMPLATE_NONE
	help
	  Quick start with a predefined configuration template.

	  Templates provide optimized configurations for different scenarios:
	  - RTOS Minimal: Ultra-compact for resource-constrained RTOS (<50KB RAM)
	  - Linux Minimal: Essential features for storage-limited Linux systems
	  - Linux Standard: Balanced configuration for typical Linux products
	  - Linux Full: All features enabled for development and testing

	  After loading a template, you can further customize individual options.

	  If you prefer manual configuration, select "None".

config TEMPLATE_NONE
	bool "None - Manual configuration"
	help
	  Configure all options manually.

	  Choose this if you want full control over every configuration option,
	  or if you're loading an existing defconfig file.

config TEMPLATE_RTOS_MINIMAL
	bool "RTOS Minimal - Ultra-compact (<50KB)"
	help
	  Optimized for RTOS with severe memory constraints.

	  Target: <50KB total footprint
	  Suitable for: Cortex-M MCUs with 32-64KB RAM

	  Features:
	  - OSAL: Basic IPC (mutex + semaphore), minimal file ops, threads
	  - HAL: Only essential drivers
	  - No network support
	  - No advanced features

	  Use case: Simple sensor nodes, actuator controllers

config TEMPLATE_LINUX_MINIMAL
	bool "Linux Minimal - Essential features (~100KB)"
	help
	  Minimal Linux configuration for storage-constrained systems.

	  Target: ~100KB total footprint
	  Suitable for: Embedded Linux with limited flash/RAM

	  Features:
	  - OSAL: Standard IPC, basic file ops, threads, limited network
	  - HAL: Common drivers (CAN, UART, GPIO)
	  - Basic PDL support
	  - 1-2 applications

	  Use case: Simple data collectors, edge gateways

config TEMPLATE_LINUX_STANDARD
	bool "Linux Standard - Balanced configuration (~200KB) [Recommended]"
	help
	  Recommended configuration for typical Linux-based products.

	  Target: ~200KB total footprint
	  Suitable for: AM625, i.MX6/8, Zynq and similar SoCs

	  Features:
	  - OSAL: Full IPC, complete file ops, threads, full network
	  - HAL: All drivers (CAN, UART, I2C, SPI, GPIO, Watchdog)
	  - PCL: Full peripheral configuration
	  - PDL: All peripheral drivers
	  - ACL: Application configuration layer
	  - Multiple applications

	  Use case: Satellite payloads, industrial controllers, IoT gateways

	  This is the recommended starting point for most projects.

config TEMPLATE_LINUX_FULL
	bool "Linux Full - All features (~300KB)"
	help
	  All features enabled for development and testing.

	  Target: ~300KB total footprint
	  Suitable for: Development, testing, feature-rich products

	  Features:
	  - All OSAL features including debug and statistics
	  - All HAL drivers and advanced features
	  - All PCL/PDL/ACL features
	  - All applications
	  - Debug logging and diagnostics

	  Use case: Development, testing, debugging, feature exploration

endchoice

config EXPERT
	bool "Expert mode - Show advanced options"
	default n
	help
	  Enable expert mode to access advanced configuration options.

	  When enabled, you can:
	  - Fine-tune individual file-level compilation
	  - Access debug and diagnostic options
	  - Configure resource limits precisely
	  - Override automatic dependency resolution

	  Warning: Incorrect advanced settings may result in build failures
	  or runtime errors. Only enable if you know what you're doing.

	  If unsure, say N.

endmenu

# ============================================================================
# Product Selection
# ============================================================================
# Select which products to build. Multiple products can be enabled
# simultaneously for parallel development and testing.
# ============================================================================

menu "Product Selection"

config PRODUCT_CCM
	bool "CCM Product"
	default n
	help
	  Enable CCM (Central Control Module) product.

	  CCM is a satellite payload control and data management system
	  designed for H200 platform with AM625 SoC.

	  If unsure, say N.

# config PRODUCT_SAMPLE
# 	bool "Sample Product"
# 	default n
# 	help
# 	  Enable Sample product (demonstration and template).
#
# 	  Sample product provides a minimal working example showing
# 	  how to structure a product using the ES-Middleware SDK framework.
#
# 	  Useful for learning and as a starting point for new products.

endmenu

# ============================================================================
# Build System Configuration
# ============================================================================
# Platform and toolchain configuration
# ============================================================================

menu "Build System Configuration"

# Include platform configuration (OS and Architecture)
source "Kconfig.platform"

# Include build and compiler configuration
source "Kconfig.build"

menu "Toolchain"

config TOOLCHAIN_PATH
	string "Toolchain path"
	default ""
	help
	  Absolute path to the cross-compilation toolchain.
	  Leave empty to use system default compiler.

	  Example: /opt/toolchains/gcc-arm-11.2-2022.02-x86_64-aarch64-none-linux-gnu/bin

config TOOLCHAIN_PREFIX
	string "Toolchain prefix"
	default "aarch64-linux-gnu-" if ARCH_ARM64
	default "arm-linux-gnueabihf-" if ARCH_ARM32
	default ""
	help
	  Toolchain prefix for cross-compilation.

	  Examples:
	    ARM64: aarch64-linux-gnu- or aarch64-none-linux-gnu-
	    ARM32: arm-linux-gnueabihf-
	    x86_64: Leave empty for native compilation

endmenu

endmenu

# ============================================================================
# Core Components Configuration
# ============================================================================
# Configure SDK core components that are shared across all products.
# These components provide fundamental abstractions and services.
# ============================================================================

menu "Core Components"

source "core/osal/Kconfig"
source "core/hal/Kconfig"
source "core/pconfig/Kconfig"
source "core/pdl/Kconfig"
source "core/prl/Kconfig"
source "core/aconfig/Kconfig"

endmenu

# ============================================================================
# Product-Specific Configuration
# ============================================================================
# Each enabled product's configuration menu appears here.
# Product configurations are only shown if the product is enabled above.
# ============================================================================

menu "Product Configuration"

if PRODUCT_CCM
	source "products/ccm/Kconfig"
endif

# if PRODUCT_SAMPLE
# 	osource "products/sample/Kconfig"
# endif

endmenu

# ============================================================================
# Testing Configuration
# ============================================================================
# Configure test suite and test modules.
# Tests are only available when BUILD_TESTING is enabled.
# ============================================================================

config BUILD_TESTING
	bool "Build test suite"
	default n
	help
	  Enable building of test suite.

	  This option controls whether the test framework and test cases
	  are compiled. Tests include:
	  - Unit tests for individual modules
	  - Performance tests for benchmarking
	  - Stress tests for stability validation
	  - System tests for integration testing

if BUILD_TESTING
	menu "Test Configuration"
		source "products/tests/Kconfig"
	endmenu
endif
```

## apps/Config.in
```kconfig
# ============================================================================
# Application Configuration
# ============================================================================

menu "Apps"

config PRINT_TEST
	bool "Build print_test app"
	help
	  Build the print_test userspace executable.

config SMART_MONITOR
	bool "Build smart_monitor app"
	help
	  Build the smart_monitor userspace executable for reading eMMC
	  SMART data through the Linux MMC ioctl interface.

config MEMORY_MONITOR
	bool "Build memory_monitor app"
	help
	  Build the memory_monitor userspace executable for collecting
	  system, kernel, reserved, process, and thread memory statistics.

endmenu
```

## components/hal/src/generic-linux/Kconfig.gpio
```kconfig
# HAL GPIO 驱动配置

if HAL_GPIO

config HAL_GPIO_LINUX
	bool "GPIO Linux driver"
	default y
	depends on PLATFORM_GENERIC_LINUX
	help
	  Enable GPIO driver for Linux (sysfs/gpiod).
	  Source: src/generic-linux/hal_gpio_linux.c

config HAL_GPIO_INTERRUPT
	bool "GPIO interrupt support"
	default y
	help
	  Enable GPIO interrupt/edge detection.

config HAL_GPIO_DEBOUNCE
	bool "GPIO debounce"
	default y
	help
	  Enable GPIO input debouncing.

endif # HAL_GPIO
```

## components/hal/src/generic-linux/Kconfig.spi
```kconfig
# HAL SPI 驱动配置

if HAL_SPI

config HAL_SPI_LINUX
	bool "SPI Linux driver"
	default y
	depends on PLATFORM_GENERIC_LINUX
	help
	  Enable SPI driver for Linux.
	  Source: src/generic-linux/hal_spi_linux.c

config HAL_SPI_DMA
	bool "SPI DMA support"
	default y
	help
	  Enable SPI DMA transfers.

config HAL_SPI_SLAVE
	bool "SPI slave mode"
	default y
	help
	  Enable SPI slave mode support.

endif # HAL_SPI
```

## components/hal/src/generic-linux/Kconfig.watchdog
```kconfig
# HAL Watchdog 驱动配置

if HAL_WATCHDOG

config HAL_WATCHDOG_LINUX
	bool "Watchdog Linux driver"
	default y
	depends on PLATFORM_GENERIC_LINUX
	help
	  Enable Watchdog driver for Linux.
	  Source: src/generic-linux/hal_watchdog_linux.c

config HAL_WATCHDOG_PRETIMEOUT
	bool "Watchdog pretimeout"
	default y
	help
	  Enable watchdog pretimeout notification.

endif # HAL_WATCHDOG
```

## components/pcl/src/Kconfig.api
```kconfig
# PCL API 配置

if PCL

menu "API Configuration"

config PCL_API
	bool "PCL API"
	default y
	help
	  Enable PCL core API functions.
	  Source: src/pcl_api.c

config PCL_REGISTER
	bool "PCL Register"
	default y
	help
	  Enable PCL device registration functions.
	  Source: src/pcl_register.c

endmenu

endif # PCL
```

## configs/aconfig_test_defconfig
```kconfig
# ============================================================================
# ACONFIG Test Configuration
# ============================================================================
# ACONFIG (Application Configuration Layer) 测试配置
# 用于测试应用配置层功能
# ============================================================================

# Architecture and OS
CONFIG_OS_LINUX=y
CONFIG_ARCH_X86_64=y

# Platform
CONFIG_PLATFORM_LINUX=y
CONFIG_PROJECT_H200_AM625=y

# Core Components - OSAL + PCONFIG + ACONFIG
CONFIG_OSAL=y
CONFIG_TYPES=y
CONFIG_PCONFIG=y
CONFIG_ACONFIG=y

# Build Configuration
CONFIG_OSAL_BUILD_SHARED=y
CONFIG_PCONFIG_BUILD_SHARED=y
CONFIG_ACONFIG_BUILD_SHARED=y

# OSAL Features - Required
CONFIG_OSAL_IPC=y
CONFIG_OSAL_FILE=y
CONFIG_OSAL_THREAD=y

# OSAL IPC
CONFIG_OSAL_IPC_ATOMIC=y
CONFIG_OSAL_IPC_MUTEX=y
CONFIG_OSAL_IPC_RWLOCK=y

# OSAL Library
CONFIG_OSAL_LIB_ERRNO=y
CONFIG_OSAL_LIB_HEAP=y
CONFIG_OSAL_LIB_STDIO=y
CONFIG_OSAL_LIB_STRING=y

# OSAL System
CONFIG_OSAL_SYS_CLOCK=y
CONFIG_OSAL_SYS_FILE=y
CONFIG_OSAL_SYS_THREAD=y
CONFIG_OSAL_SYS_TIME=y

# OSAL Utility
CONFIG_OSAL_UTIL_LOG=y
CONFIG_OSAL_UTIL_VERSION=y

# Testing - Enabled
CONFIG_BUILD_TESTING=y

# Products - All Disabled
# CONFIG_PRODUCT_CCM is not set

# HAL - Disabled
# CONFIG_HAL is not set

# PDL - Disabled
# CONFIG_PDL is not set

# PRL - Disabled
# CONFIG_PRL is not set
```

## configs/arm32_beaglebone_defconfig
```kconfig
#
# ARM32 BeagleBone Configuration
# Target: BeagleBone (TI AM335x, ARM Cortex-A8)
# Purpose: BeagleBone platform for industrial applications
# Optimization: -O2 for balanced performance
# Libraries: Shared libraries
#

# ============================================================================
# Build Options
# ============================================================================
CONFIG_OPT_O2=y
CONFIG_LIBRARY_BUILD_TYPE_DYNAMIC=y
CONFIG_INSTALL_HEADERS=y

# ============================================================================
# Target Platform
# ============================================================================
CONFIG_ARCH_ARM32=y
CONFIG_OS_LINUX=y
CONFIG_CROSS_COMPILE="arm-linux-gnueabihf-"

# ============================================================================
# OSAL (Operating System Abstraction Layer)
# ============================================================================
CONFIG_OSAL=y
CONFIG_OSAL_BUILD_SHARED=y

# OSAL Features
CONFIG_OSAL_FILE=y
CONFIG_OSAL_NETWORK=y
CONFIG_OSAL_IPC=y
CONFIG_OSAL_THREAD=y
CONFIG_OSAL_TIME=y
CONFIG_OSAL_SIGNAL=y

# OSAL Resource Limits (Moderate for ARM32)
CONFIG_OSAL_MAX_TASKS=64
CONFIG_OSAL_MAX_QUEUES=32
CONFIG_OSAL_MAX_MUTEXES=32

# ============================================================================
# HAL (Hardware Abstraction Layer)
# ============================================================================
CONFIG_HAL=y
CONFIG_HAL_BUILD_SHARED=y
CONFIG_PLATFORM_BEAGLEBONE=y

# HAL Advanced Features
CONFIG_HAL_POWER_MANAGEMENT=y

# HAL Drivers (BeagleBone specific)
CONFIG_HAL_CAN=y
CONFIG_HAL_CAN_FILTER=y
CONFIG_HAL_CAN_ERROR_HANDLING=y

CONFIG_HAL_UART=y
CONFIG_HAL_UART_FLOW_CONTROL=y

CONFIG_HAL_I2C=y

CONFIG_HAL_SPI=y

CONFIG_HAL_GPIO=y
CONFIG_HAL_GPIO_INTERRUPT=y
CONFIG_HAL_GPIO_DEBOUNCE=y

CONFIG_HAL_WATCHDOG=y

# ============================================================================
# PCL (Protocol Control Layer)
# ============================================================================
CONFIG_PCL=y
CONFIG_PCL_BUILD_SHARED=y

# ============================================================================
# PDL (Protocol Data Layer)
# ============================================================================
CONFIG_PDL=y
CONFIG_PDL_BUILD_SHARED=y

# ============================================================================
# ACL (Application Control Layer)
# ============================================================================
CONFIG_ACL=y
CONFIG_ACL_BUILD_SHARED=y

# ============================================================================
# Products - CCM
# ============================================================================
CONFIG_PRODUCT_CCM=y
CONFIG_PROJECT_H200_AM625=y

# CCM Applications (All enabled)
CONFIG_BUILD_CCM_SUPERVISOR=y
CONFIG_BUILD_CCM_COLLECTOR=y
CONFIG_BUILD_CCM_COMM=y
CONFIG_BUILD_CCM_HEALTH=y
CONFIG_BUILD_CCM_LOGGER=y
```
