## configs/ccm_h200_100p_v1_defconfig
```kconfig
# H200-100P V1 Product Configuration
# 基础型号：只启用核心应用

# 产品选择
CONFIG_PRODUCT_CCM=y

# 启用的应用
CONFIG_APP_COLLECTOR=y
CONFIG_APP_COMM=y

# SDK 组件（必需）
CONFIG_OSAL=y
CONFIG_HAL=y
CONFIG_PCL=y
CONFIG_PDL=y
CONFIG_ACL=y

# 产品组件（必需）
CONFIG_PROJECT_H200_AM625=y
CONFIG_LIBCCM=y

# 平台配置
CONFIG_OS_LINUX=y
CONFIG_ARCH_ARM64=y

# OSAL 构建配置
CONFIG_OSAL_BUILD_STATIC=y
CONFIG_OSAL_BUILD_SHARED=y

# HAL 构建配置
CONFIG_HAL_BUILD_STATIC=y
CONFIG_HAL_BUILD_SHARED=y

# HAL 平台
CONFIG_PLATFORM_GENERIC_LINUX=y

# HAL 驱动
CONFIG_HAL_CAN=y
CONFIG_HAL_UART=y
CONFIG_HAL_I2C=y
CONFIG_HAL_SPI=y
CONFIG_HAL_GPIO=y
CONFIG_HAL_WATCHDOG=y

# HAL Linux 驱动
CONFIG_HAL_CAN_LINUX=y
CONFIG_HAL_GPIO_LINUX=y
CONFIG_HAL_I2C_LINUX=y
CONFIG_HAL_SPI_LINUX=y
CONFIG_HAL_UART_LINUX=y
CONFIG_HAL_WATCHDOG_LINUX=y

# PCL 构建配置
CONFIG_PCL_BUILD_STATIC=y

# PDL 构建配置
CONFIG_PDL_BUILD_STATIC=y

# ACL 构建配置
CONFIG_ACL_BUILD_STATIC=y

# OSAL 功能
CONFIG_OSAL_IPC=y
CONFIG_OSAL_FILE=y
CONFIG_OSAL_THREAD=y
CONFIG_OSAL_NETWORK=y
CONFIG_OSAL_SIGNAL=y

# OSAL IPC
CONFIG_OSAL_IPC_ATOMIC=y
CONFIG_OSAL_IPC_MUTEX=y
CONFIG_OSAL_IPC_SEMAPHORE=y
CONFIG_OSAL_IPC_COND=y
CONFIG_OSAL_IPC_SHM=y
CONFIG_OSAL_IPC_SHM_CACHE=y

# OSAL Library
CONFIG_OSAL_LIB_ERRNO=y
CONFIG_OSAL_LIB_HEAP=y
CONFIG_OSAL_LIB_STDIO=y
CONFIG_OSAL_LIB_STRING=y

# OSAL System
CONFIG_OSAL_SYS_CLOCK=y
CONFIG_OSAL_SYS_ENV=y
CONFIG_OSAL_SYS_FILE=y
CONFIG_OSAL_SYS_PROCESS=y
CONFIG_OSAL_SYS_SCHED=y
CONFIG_OSAL_SYS_SELECT=y
CONFIG_OSAL_SYS_SIGNAL=y
CONFIG_OSAL_SYS_THREAD=y
CONFIG_OSAL_SYS_TIME=y

# OSAL Network
CONFIG_OSAL_NET_SOCKET=y
CONFIG_OSAL_NET_TERMIOS=y

# OSAL Utility
CONFIG_OSAL_UTIL_LOG=y
CONFIG_OSAL_UTIL_VERSION=y
```

## configs/ccm_h200_am625_debug_defconfig
```kconfig
#
# CCM H200 AM625 Debug Configuration
# Target: TI AM625 SoC (ARM Cortex-A53 + Cortex-R5F)
# Purpose: Development and debugging with full features enabled
# Optimization: -O0 for best debugging experience
# Libraries: Shared libraries for faster iteration
#

# ============================================================================
# Build Options
# ============================================================================
CONFIG_BUILD_TYPE_DEBUG=y
CONFIG_OPT_O0=y
CONFIG_LIBRARY_BUILD_TYPE_DYNAMIC=y
CONFIG_INSTALL_HEADERS=y

# ============================================================================
# Target Platform
# ============================================================================
CONFIG_ARCH_ARM64=y
CONFIG_OS_LINUX=y
CONFIG_CROSS_COMPILE="aarch64-linux-gnu-"

# ============================================================================
# OSAL (Operating System Abstraction Layer)
# ============================================================================
CONFIG_OSAL=y
CONFIG_OSAL_BUILD_SHARED=y

# OSAL Features (All enabled for debugging)
CONFIG_OSAL_FILE=y
CONFIG_OSAL_NETWORK=y
CONFIG_OSAL_IPC=y
CONFIG_OSAL_THREAD=y
CONFIG_OSAL_TIME=y
CONFIG_OSAL_SIGNAL=y

# OSAL Resource Limits (Increased for debugging)
CONFIG_OSAL_MAX_TASKS=128
CONFIG_OSAL_MAX_QUEUES=64
CONFIG_OSAL_MAX_MUTEXES=64

# OSAL Debug
CONFIG_OSAL_DEBUG_LOGGING=y

# ============================================================================
# HAL (Hardware Abstraction Layer)
# ============================================================================
CONFIG_HAL=y
CONFIG_HAL_BUILD_SHARED=y
CONFIG_PLATFORM_TI_AM625=y

# HAL Advanced Features
CONFIG_HAL_DEBUG=y
CONFIG_HAL_STATISTICS=y
CONFIG_HAL_POWER_MANAGEMENT=y

# HAL Drivers (All enabled for testing)
CONFIG_HAL_CAN=y
CONFIG_HAL_CAN_FILTER=y
CONFIG_HAL_CAN_ERROR_HANDLING=y
CONFIG_HAL_CAN_LOOPBACK=y

CONFIG_HAL_UART=y
CONFIG_HAL_UART_FLOW_CONTROL=y
CONFIG_HAL_UART_RS485=y

CONFIG_HAL_I2C=y
CONFIG_HAL_I2C_SLAVE=y
CONFIG_HAL_I2C_10BIT_ADDR=y

CONFIG_HAL_SPI=y
CONFIG_HAL_SPI_DMA=y
CONFIG_HAL_SPI_SLAVE=y

CONFIG_HAL_GPIO=y
CONFIG_HAL_GPIO_INTERRUPT=y
CONFIG_HAL_GPIO_DEBOUNCE=y

CONFIG_HAL_WATCHDOG=y
CONFIG_HAL_WATCHDOG_PRETIMEOUT=y

# ============================================================================
# PCL (Protocol Control Layer)
# ============================================================================
CONFIG_PCL=y
CONFIG_PCL_BUILD_SHARED=y

# ============================================================================
# PDL (Protocol Data Layer)
# ============================================================================
CONFIG_PDL=y
CONFIG_PDL_BUILD_SHARED=y

# ============================================================================
# ACL (Application Control Layer)
# ============================================================================
CONFIG_ACL=y
CONFIG_ACL_BUILD_SHARED=y

# ============================================================================
# Products - CCM
# ============================================================================
CONFIG_PRODUCT_CCM=y
CONFIG_PROJECT_H200_AM625=y

# CCM Applications (All enabled for debugging)
CONFIG_BUILD_CCM_SUPERVISOR=y
CONFIG_BUILD_CCM_COLLECTOR=y
CONFIG_BUILD_CCM_COMM=y
CONFIG_BUILD_CCM_HEALTH=y
CONFIG_BUILD_CCM_LOGGER=y

# ============================================================================
# Test Configuration
# ============================================================================
CONFIG_BUILD_TESTING=y
```

## configs/ccm_h200p100_development_defconfig
```kconfig
# ============================================================================
# CCM Development Configuration
# ============================================================================
# CCM 开发环境配置
# 包含所有调试功能和测试工具
# ============================================================================

# Product Selection
CONFIG_PRODUCT_CCM=y

# Architecture and OS
CONFIG_OS_LINUX=y
CONFIG_ARCH_X86_64=y

# Platform
CONFIG_PLATFORM_LINUX=y
CONFIG_PROJECT_H200_AM625=y

# Core Components - Full Stack
CONFIG_OSAL=y
CONFIG_TYPES=y
CONFIG_HAL=y
CONFIG_PDL=y
CONFIG_PRL=y
CONFIG_PCONFIG=y
CONFIG_ACONFIG=y
CONFIG_LIBCCM=y

# Build Configuration - Shared Libraries for Development
CONFIG_OSAL_BUILD_SHARED=y
CONFIG_HAL_BUILD_SHARED=y
CONFIG_PDL_BUILD_SHARED=y
CONFIG_PRL_BUILD_SHARED=y
CONFIG_PCONFIG_BUILD_SHARED=y
CONFIG_ACONFIG_BUILD_SHARED=y

# HAL Drivers - All Enabled
CONFIG_HAL_CAN=y
CONFIG_HAL_UART=y
CONFIG_HAL_I2C=y
CONFIG_HAL_SPI=y
CONFIG_HAL_GPIO=y
CONFIG_HAL_WATCHDOG=y

# HAL Linux Drivers
CONFIG_HAL_CAN_LINUX=y
CONFIG_HAL_GPIO_LINUX=y
CONFIG_HAL_I2C_LINUX=y
CONFIG_HAL_SPI_LINUX=y
CONFIG_HAL_UART_LINUX=y
CONFIG_HAL_WATCHDOG_LINUX=y

# PDL Sub-modules - All Enabled for Development
CONFIG_PDL_MCU_SUPPORT=y
CONFIG_PDL_WATCHDOG_SUPPORT=y

# PDL MCU Drivers
CONFIG_PDL_MCU=y
CONFIG_PDL_MCU_CAN_SUPPORT=y
CONFIG_PDL_MCU_UART_SUPPORT=y
CONFIG_PDL_MCU_CAN=y
CONFIG_PDL_MCU_SERIAL=y
CONFIG_PDL_MCU_PROTOCOL=y

# PRL Protocols - All Enabled
CONFIG_PRL_MCU=y
CONFIG_PRL_CCM=y
CONFIG_PRL_PMC=y
CONFIG_PRL_GSC=y
CONFIG_PRL_POWER=y

# PRL Features - All Enabled
CONFIG_PRL_CRC_CHECK=y
CONFIG_PRL_SEQUENCE_CHECK=y
CONFIG_PRL_TIMESTAMP_CHECK=y
CONFIG_PRL_MAX_PAYLOAD_SIZE=4096

# CCM Applications - All Enabled
CONFIG_APP_COLLECTOR=y
CONFIG_APP_COMM=y
CONFIG_APP_LOGGER=y
CONFIG_APP_HEALTH=y
CONFIG_APP_SUPERVISOR=y

# OSAL Features - All Enabled
CONFIG_OSAL_IPC=y
CONFIG_OSAL_FILE=y
CONFIG_OSAL_THREAD=y
CONFIG_OSAL_NETWORK=y
CONFIG_OSAL_SIGNAL=y

# OSAL IPC - All Enabled
CONFIG_OSAL_IPC_ATOMIC=y
CONFIG_OSAL_IPC_MUTEX=y
CONFIG_OSAL_IPC_RWLOCK=y
CONFIG_OSAL_IPC_SEMAPHORE=y
CONFIG_OSAL_IPC_COND=y
CONFIG_OSAL_IPC_SHM=y
CONFIG_OSAL_IPC_SHM_CACHE=y

# OSAL Library - All Enabled
CONFIG_OSAL_LIB_ERRNO=y
CONFIG_OSAL_LIB_HEAP=y
CONFIG_OSAL_LIB_STDIO=y
CONFIG_OSAL_LIB_STRING=y

# OSAL System - All Enabled
CONFIG_OSAL_SYS_CLOCK=y
CONFIG_OSAL_SYS_ENV=y
CONFIG_OSAL_SYS_FILE=y
CONFIG_OSAL_SYS_PROCESS=y
CONFIG_OSAL_SYS_SCHED=y
CONFIG_OSAL_SYS_SELECT=y
CONFIG_OSAL_SYS_SIGNAL=y
CONFIG_OSAL_SYS_THREAD=y
CONFIG_OSAL_SYS_TIME=y

# OSAL Network - All Enabled
CONFIG_OSAL_NET_SOCKET=y
CONFIG_OSAL_NET_TERMIOS=y

# OSAL Utility - All Enabled
CONFIG_OSAL_UTIL_LOG=y
CONFIG_OSAL_UTIL_VERSION=y

# Testing - Enabled in Development
CONFIG_BUILD_TESTING=y

# Debug Options
CONFIG_DEBUG=y
CONFIG_DEBUG_SYMBOLS=y
```

## configs/ccm_minimal_defconfig
```kconfig
# ============================================================================
# Minimal OSAL Configuration - Only Basic Features
# ============================================================================
# This configuration demonstrates fine-grained file-level trimming.
# Only essential OSAL features are enabled, all other modules are disabled.
# ============================================================================
#
# NOTE: Due to Kconfig 'select' mechanism, some modules will be automatically
#       enabled even if not explicitly configured here:
#       - HAL, PCL, PDL, ACL will be auto-enabled by application dependencies
#       - This is intentional to ensure all required dependencies are present
# ============================================================================

# Product Selection
CONFIG_PRODUCT_CCM=y

# Core Components - Only OSAL explicitly enabled
# (HAL/PCL/PDL/ACL will be auto-enabled by 'select' dependencies)
CONFIG_OSAL=y

# OSAL Platform
CONFIG_OS_LINUX=y
CONFIG_ARCH_X86_64=y

# OSAL Build
CONFIG_OSAL_BUILD_STATIC=y

# OSAL Features - Minimal set
CONFIG_OSAL_IPC=y
CONFIG_OSAL_FILE=y
CONFIG_OSAL_THREAD=y
CONFIG_OSAL_SIGNAL=y

# OSAL IPC - Only mutex and semaphore
CONFIG_OSAL_IPC_MUTEX=y
CONFIG_OSAL_IPC_SEMAPHORE=y
CONFIG_OSAL_IPC_SHM=y

# OSAL Library - Only basic functions
CONFIG_OSAL_LIB_ERRNO=y
CONFIG_OSAL_LIB_HEAP=y
CONFIG_OSAL_LIB_STDIO=y
CONFIG_OSAL_LIB_STRING=y

# OSAL System - Only essential operations
CONFIG_OSAL_SYS_CLOCK=y
CONFIG_OSAL_SYS_FILE=y
CONFIG_OSAL_SYS_SCHED=y
CONFIG_OSAL_SYS_SIGNAL=y
CONFIG_OSAL_SYS_THREAD=y
CONFIG_OSAL_SYS_TIME=y

# OSAL Utility
CONFIG_OSAL_UTIL_LOG=y
CONFIG_OSAL_UTIL_VERSION=y

# HAL Platform (auto-enabled by select)
CONFIG_PLATFORM_GENERIC_LINUX=y

# HAL Build
CONFIG_HAL_BUILD_STATIC=y

# HAL Drivers (required for libccm)
CONFIG_HAL_CAN=y
CONFIG_HAL_UART=y
CONFIG_HAL_I2C=y
CONFIG_HAL_SPI=y
CONFIG_HAL_GPIO=y
CONFIG_HAL_WATCHDOG=y

# HAL Linux Drivers
CONFIG_HAL_CAN_LINUX=y
CONFIG_HAL_GPIO_LINUX=y
CONFIG_HAL_I2C_LINUX=y
CONFIG_HAL_SPI_LINUX=y
CONFIG_HAL_UART_LINUX=y
CONFIG_HAL_WATCHDOG_LINUX=y

# PCL Build
CONFIG_PCL_BUILD_STATIC=y

# PDL Build
CONFIG_PDL_BUILD_STATIC=y

# ACL Build
CONFIG_ACL_BUILD_STATIC=y

# CCM Platform
CONFIG_PROJECT_H200_AM625=y

# CCM Libraries
CONFIG_LIBCCM=y

# CCM Applications - Only one app for testing
CONFIG_APP_COLLECTOR=y
```
