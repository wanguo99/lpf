## configs/ctest/ctest_arm64_full_defconfig
```kconfig
# ============================================================================
# Full Test Configuration
# ============================================================================
# All modules, all features, all products, all applications enabled.
# Used for comprehensive full-stack testing.
# ============================================================================

# Product Selection - Disabled for testing
# CONFIG_PRODUCT_CCM is not set
# Core Components - Full Stack
CONFIG_OSAL=y
CONFIG_HAL=y
CONFIG_PCONFIG=y
CONFIG_PDL=y
CONFIG_PRL=y
CONFIG_ACONFIG=y
CONFIG_TEST_FRAMEWORK=y
# Architecture and OS
CONFIG_OS_LINUX=y
CONFIG_ARCH_ARM64=y
# Platform
CONFIG_PLATFORM_LINUX=y
# CCM Platform
CONFIG_PROJECT_H200_AM625=y
# Build Configuration - Dynamic Libraries
CONFIG_OSAL_BUILD_SHARED=y
CONFIG_HAL_BUILD_SHARED=y
CONFIG_PCONFIG_BUILD_SHARED=y
CONFIG_PDL_BUILD_SHARED=y
CONFIG_PRL_BUILD_SHARED=y
CONFIG_ACONFIG_BUILD_SHARED=y
# HAL Drivers - All Enabled
CONFIG_HAL_CAN=y
CONFIG_HAL_UART=y
CONFIG_HAL_I2C=y
CONFIG_HAL_SPI=y
CONFIG_HAL_GPIO=y
# HAL Linux Drivers - All Enabled
CONFIG_HAL_CAN_LINUX=y
CONFIG_HAL_GPIO_LINUX=y
CONFIG_HAL_I2C_LINUX=y
CONFIG_HAL_SPI_LINUX=y
CONFIG_HAL_UART_LINUX=y
# PDL Sub-modules - All Enabled
CONFIG_PDL_SATELLITE_SUPPORT=y
CONFIG_PDL_BMC_SUPPORT=y
CONFIG_PDL_MCU_SUPPORT=y
CONFIG_PDL_CCM_SUPPORT=y
# PRL Protocols - All Enabled (Updated to device-based organization)
CONFIG_PRL_MCU=y
CONFIG_PRL_CCM=y
CONFIG_PRL_PMC=y
CONFIG_PRL_GSC=y
CONFIG_PRL_POWER=y
# PRL Features - All Enabled
CONFIG_PRL_CRC_CHECK=y
CONFIG_PRL_SEQUENCE_CHECK=y
CONFIG_PRL_MAX_PAYLOAD_SIZE=4096
# PDL Satellite Drivers - All Enabled
CONFIG_PDL_SATELLITE=y
CONFIG_PDL_SATELLITE_CAN=y
# PDL BMC Drivers - All Enabled
CONFIG_PDL_BMC=y
CONFIG_PDL_BMC_IPMI=y
CONFIG_PDL_BMC_REDFISH=y
CONFIG_PDL_BMC_TRANSPORT=y
# PDL MCU Drivers - All Enabled
CONFIG_PDL_MCU=y
CONFIG_PDL_MCU_CAN_SUPPORT=y
CONFIG_PDL_MCU_UART_SUPPORT=y
CONFIG_PDL_MCU_CAN=y
CONFIG_PDL_MCU_SERIAL=y
CONFIG_PDL_MCU_PROTOCOL=y
# OSAL Features - All Enabled
CONFIG_OSAL_IPC=y
CONFIG_OSAL_FILE=y
CONFIG_OSAL_THREAD=y
CONFIG_OSAL_NETWORK=y
CONFIG_OSAL_SIGNAL=y
# OSAL IPC - All Enabled
CONFIG_OSAL_IPC_ATOMIC=y
CONFIG_OSAL_IPC_MUTEX=y
CONFIG_OSAL_IPC_RWLOCK=y
CONFIG_OSAL_IPC_SEMAPHORE=y
CONFIG_OSAL_IPC_COND=y
CONFIG_OSAL_IPC_SHM=y
CONFIG_OSAL_IPC_SHM_CACHE=y
# OSAL Library - All Enabled
CONFIG_OSAL_LIB_ERRNO=y
CONFIG_OSAL_LIB_HEAP=y
CONFIG_OSAL_LIB_STDIO=y
CONFIG_OSAL_LIB_STRING=y
# OSAL System - All Enabled
CONFIG_OSAL_SYS_CLOCK=y
CONFIG_OSAL_SYS_ENV=y
CONFIG_OSAL_SYS_FILE=y
CONFIG_OSAL_SYS_PROCESS=y
CONFIG_OSAL_SYS_SCHED=y
CONFIG_OSAL_SYS_SELECT=y
CONFIG_OSAL_SYS_SIGNAL=y
CONFIG_OSAL_SYS_THREAD=y
CONFIG_OSAL_SYS_TIME=y
# OSAL Network - All Enabled
CONFIG_OSAL_NET_SOCKET=y
CONFIG_OSAL_NET_TERMIOS=y
# OSAL Utility - All Enabled
CONFIG_OSAL_UTIL_LOG=y
CONFIG_OSAL_UTIL_VERSION=y
# Testing - Enable All Tests
CONFIG_BUILD_TESTING=y
CONFIG_TEST_UNIT=y
CONFIG_TEST_PERFORMANCE=y
CONFIG_TEST_STRESS=y
CONFIG_TEST_SYSTEM=y
# ============================================================================
# Unit Tests - All Enabled
# ============================================================================
# OSAL Unit Tests - All Enabled
CONFIG_TEST_OSAL=y
CONFIG_TEST_OSAL_ALL=y
CONFIG_TEST_OSAL_ATOMIC=y
CONFIG_TEST_OSAL_CLOCK=y
CONFIG_TEST_OSAL_COND=y
CONFIG_TEST_OSAL_ENV=y
CONFIG_TEST_OSAL_ERRNO=y
CONFIG_TEST_OSAL_FILE=y
CONFIG_TEST_OSAL_HEAP=y
CONFIG_TEST_OSAL_LOG=y
CONFIG_TEST_OSAL_MUTEX=y
CONFIG_TEST_OSAL_PROCESS=y
CONFIG_TEST_OSAL_RWLOCK=y
CONFIG_TEST_OSAL_SCHED=y
CONFIG_TEST_OSAL_SEMAPHORE=y
CONFIG_TEST_OSAL_SHM=y
CONFIG_TEST_OSAL_SIGNAL=y
CONFIG_TEST_OSAL_SOCKET=y
CONFIG_TEST_OSAL_STRESS=y
CONFIG_TEST_OSAL_STRING=y
CONFIG_TEST_OSAL_THREAD=y
CONFIG_TEST_OSAL_TIME=y
CONFIG_TEST_OSAL_VERSION=y
# HAL Unit Tests - All Enabled
CONFIG_TEST_HAL=y
CONFIG_TEST_HAL_ALL=y
CONFIG_TEST_HAL_CAN=y
CONFIG_TEST_HAL_GPIO=y
CONFIG_TEST_HAL_I2C=y
CONFIG_TEST_HAL_SERIAL=y
CONFIG_TEST_HAL_SPI=y
# PDL Unit Tests - All Enabled
CONFIG_TEST_PDL=y
CONFIG_TEST_PDL_ALL=y
CONFIG_TEST_PDL_BMC=y
CONFIG_TEST_PDL_BMC_PROTOCOL=y
CONFIG_TEST_PDL_MCU=y
CONFIG_TEST_PDL_SATELLITE=y
# PRL Unit Tests - All Enabled
CONFIG_TEST_PRL=y
CONFIG_TEST_PRL_ALL=y
CONFIG_TEST_PRL_COMMON=y
CONFIG_TEST_PRL_DEVICE=y
# PCONFIG Unit Tests - All Enabled
CONFIG_TEST_PCONFIG=y
CONFIG_TEST_PCONFIG_ALL=y
CONFIG_TEST_PCONFIG_API=y
# ACONFIG Unit Tests - All Enabled
CONFIG_TEST_ACONFIG=y
CONFIG_TEST_ACONFIG_ALL=y
CONFIG_TEST_ACONFIG_API=y
# ============================================================================
# Performance Tests - All Enabled
# ============================================================================
# OSAL Performance Tests
CONFIG_TEST_PERFORMANCE_OSAL=y
CONFIG_TEST_PERFORMANCE_OSAL_MUTEX=y
CONFIG_TEST_PERFORMANCE_OSAL_THREAD=y
CONFIG_TEST_PERFORMANCE_OSAL_SEMAPHORE=y
CONFIG_TEST_PERFORMANCE_OSAL_SHM=y
CONFIG_TEST_PERFORMANCE_OSAL_FILE=y
# HAL Performance Tests
CONFIG_TEST_PERFORMANCE_HAL=y
CONFIG_TEST_PERFORMANCE_HAL_CAN=y
CONFIG_TEST_PERFORMANCE_HAL_GPIO=y
CONFIG_TEST_PERFORMANCE_HAL_I2C=y
CONFIG_TEST_PERFORMANCE_HAL_SPI=y
# PDL Performance Tests
CONFIG_TEST_PERFORMANCE_PDL=y
CONFIG_TEST_PERFORMANCE_PDL_MCU=y
CONFIG_TEST_PERFORMANCE_PDL_BMC=y
# ============================================================================
# Stress Tests - All Enabled
# ============================================================================
# OSAL Stress Tests
CONFIG_TEST_STRESS_OSAL=y
CONFIG_TEST_STRESS_OSAL_THREAD=y
CONFIG_TEST_STRESS_OSAL_MEMORY=y
CONFIG_TEST_STRESS_OSAL_IPC=y
# HAL Stress Tests
CONFIG_TEST_STRESS_HAL=y
CONFIG_TEST_STRESS_HAL_CONCURRENT=y
CONFIG_TEST_STRESS_HAL_HIGH_LOAD=y
# PDL Stress Tests - All Enabled
CONFIG_TEST_STRESS_PDL=y
CONFIG_TEST_STRESS_PDL_BMC_CONCURRENT=y
CONFIG_TEST_STRESS_PDL_MCU_LONG_RUNNING=y
CONFIG_TEST_STRESS_PDL_SATELLITE_CONCURRENT=y
CONFIG_TEST_STRESS_PDL_CCM_CONCURRENT=y
CONFIG_TEST_STRESS_PDL_MULTIDEVICE=y
CONFIG_TEST_STRESS_PDL_RESOURCE_EXHAUSTION=y
# ============================================================================
# System Tests - All Enabled
# ============================================================================
# OSAL System Tests
CONFIG_TEST_SYSTEM_OSAL=y
CONFIG_TEST_SYSTEM_OSAL_CROSS_MODULE=y
# HAL System Tests
CONFIG_TEST_SYSTEM_HAL=y
CONFIG_TEST_SYSTEM_HAL_MULTI_DEVICE=y
# PDL System Tests
CONFIG_TEST_SYSTEM_PDL=y
CONFIG_TEST_SYSTEM_PDL_PROTOCOL_STACK=y
# Integration Tests
CONFIG_TEST_INTEGRATION=y
CONFIG_TEST_INTEGRATION_FULL_STACK=y
CONFIG_OSAL_UTIL_CRC=y
# ============================================================================
# Debug Features - All Enabled
# ============================================================================
CONFIG_DEBUG_MEMORY_TRACKING=y
CONFIG_DEBUG_BUFFER_OVERFLOW=y
CONFIG_DEBUG_USE_AFTER_FREE=y
CONFIG_DEBUG_DOUBLE_FREE=y
CONFIG_DEBUG_UNINITIALIZED_MEMORY=y
CONFIG_DEBUG_POSTCONDITION_CHECKS=y
CONFIG_DEBUG_INVARIANT_CHECKS=y
CONFIG_DEBUG_PERFORMANCE_COUNTERS=y
CONFIG_DEBUG_CALL_TRACING=y
CONFIG_DEBUG_RESOURCE_TRACKING=y
CONFIG_DEBUG_DUMP_STACK_ON_ERROR=y
CONFIG_DEBUG_CORE_DUMP_ON_FATAL=y
CONFIG_DEBUG_DUMP_ON_SIGNAL=y
# ============================================================================
# Logging Enhancements
# ============================================================================
CONFIG_LOG_FUNCTION_NAME=y
CONFIG_LOG_FILE_LINE=y
CONFIG_LOG_THREAD_ID=y
CONFIG_LOG_TIMESTAMP=y
# ============================================================================
# HAL Debug and Statistics
# ============================================================================
CONFIG_HAL_DEBUG=y
CONFIG_HAL_STATISTICS=y
# ============================================================================
# Additional Performance Tests
# ============================================================================
CONFIG_TEST_PERFORMANCE_PCONFIG=y
CONFIG_TEST_PERFORMANCE_ACONFIG=y
CONFIG_TEST_PERF_OSAL_MUTEX=y
CONFIG_TEST_PERF_OSAL_THREAD=y
CONFIG_TEST_PERF_OSAL_SEMAPHORE=y
CONFIG_TEST_PERF_OSAL_COND=y
CONFIG_TEST_PERF_OSAL_HEAP=y
CONFIG_TEST_PERF_OSAL_FILE=y
CONFIG_TEST_PERF_OSAL_ATOMIC=y
CONFIG_TEST_PERF_OSAL_TIME=y
CONFIG_TEST_PERF_HAL_CAN=y
CONFIG_TEST_PERF_HAL_SERIAL=y
CONFIG_TEST_PERF_HAL_SPI=y
CONFIG_TEST_PERF_HAL_I2C=y
CONFIG_TEST_PERF_HAL_GPIO=y
CONFIG_TEST_PERF_PDL_MCU=y
CONFIG_TEST_PERF_PDL_BMC=y
CONFIG_TEST_PERF_PDL_SATELLITE=y
CONFIG_TEST_PERF_PDL_PROTOCOL=y
# ============================================================================
# Additional Stress Tests
# ============================================================================
CONFIG_TEST_STRESS_PCONFIG=y
CONFIG_TEST_STRESS_OSAL_VERBOSE=y
CONFIG_TEST_STRESS_HAL_CAN=y
# CONFIG_TEST_STRESS_HAL_SERIAL is not set
# CONFIG_TEST_STRESS_HAL_SPI is not set
# CONFIG_TEST_STRESS_HAL_I2C is not set
# CONFIG_TEST_STRESS_HAL_GPIO is not set
CONFIG_TEST_STRESS_PRL_LONG_RUNNING=y
CONFIG_TEST_STRESS_PCONFIG_LARGE_CONFIG=y
CONFIG_TEST_STRESS_PCONFIG_RELOAD=y
CONFIG_TEST_STRESS_PCONFIG_MALFORMED=y
# ============================================================================
# Additional System Tests
# ============================================================================
CONFIG_TEST_SYSTEM_PCONFIG=y
# CONFIG_TEST_SYSTEM_ACONFIG is not set
# CONFIG_TEST_SYSTEM_OSAL_PROCESS_IPC is not set
# CONFIG_TEST_SYSTEM_OSAL_REALTIME is not set
CONFIG_TEST_SYSTEM_HAL_CAN_SERIAL=y
CONFIG_TEST_SYSTEM_HAL_SPI_I2C=y
CONFIG_TEST_SYSTEM_HAL_GPIO_INTERRUPT=y
CONFIG_TEST_SYSTEM_HAL_DMA_SHARING=y
CONFIG_TEST_SYSTEM_PDL_BUS_SHARING=y
CONFIG_TEST_SYSTEM_PDL_ERROR_PROPAGATION=y
CONFIG_TEST_SYSTEM_PDL_TELEMETRY=y
# ============================================================================
# Additional Integration Tests
# ============================================================================
CONFIG_TEST_INTEGRATION_PERFORMANCE=y
CONFIG_TEST_INTEGRATION_ROBUSTNESS=y
# ============================================================================
# Test Framework Verbose Output
# ============================================================================
CONFIG_TEST_FRAMEWORK_VERBOSE=y
# ============================================================================
# ACONFIG Tests
# ============================================================================
# ============================================================================
# ACONFIG Performance Tests
# ============================================================================
CONFIG_TEST_PERF_ACONFIG_TC=y
CONFIG_TEST_PERF_ACONFIG_TM=y
```

## configs/ctest/ctest_arm64_stress_defconfig
```kconfig
# ============================================================================
# Stress Test Configuration
# ============================================================================
# All core modules, all products, and all applications enabled.
# Used for stress and performance testing.
# ============================================================================

# Product Selection - All Products
CONFIG_PRODUCT_CCM=y

# Core Components - Full Stack
CONFIG_OSAL=y
CONFIG_TEST_FRAMEWORK=y
CONFIG_HAL=y
CONFIG_PCONFIG=y
CONFIG_PDL=y
CONFIG_ACONFIG=y

# Architecture and OS
CONFIG_OS_LINUX=y
CONFIG_ARCH_ARM64=y
CONFIG_OSAL_OS_POSIX=y

# Platform
CONFIG_PLATFORM_LINUX=y

# CCM Platform
CONFIG_PROJECT_H200_AM625=y

# Build Configuration - Dynamic Libraries
CONFIG_OSAL_BUILD_SHARED=y
CONFIG_HAL_BUILD_SHARED=y
CONFIG_PCONFIG_BUILD_SHARED=y
CONFIG_PDL_BUILD_SHARED=y
CONFIG_ACONFIG_BUILD_SHARED=y

# HAL Drivers - All Enabled
CONFIG_HAL_CAN=y
CONFIG_HAL_UART=y
CONFIG_HAL_I2C=y
CONFIG_HAL_SPI=y
CONFIG_HAL_GPIO=y

# HAL Linux Drivers - All Enabled
CONFIG_HAL_CAN_LINUX=y
CONFIG_HAL_GPIO_LINUX=y
CONFIG_HAL_I2C_LINUX=y
CONFIG_HAL_SPI_LINUX=y
CONFIG_HAL_UART_LINUX=y

# PDL Sub-modules - All Enabled
CONFIG_PDL_SATELLITE_SUPPORT=y
CONFIG_PDL_BMC_SUPPORT=y
CONFIG_PDL_MCU_SUPPORT=y

# PDL Satellite Drivers - All Enabled
CONFIG_PDL_SATELLITE=y
CONFIG_PDL_SATELLITE_CAN=y

# PDL BMC Drivers - All Enabled
CONFIG_PDL_BMC=y
CONFIG_PDL_BMC_IPMI=y
CONFIG_PDL_BMC_REDFISH=y
CONFIG_PDL_BMC_TRANSPORT=y

# PDL MCU Drivers - All Enabled
CONFIG_PDL_MCU=y
CONFIG_PDL_MCU_CAN_SUPPORT=y
CONFIG_PDL_MCU_UART_SUPPORT=y
CONFIG_PDL_MCU_CAN=y
CONFIG_PDL_MCU_SERIAL=y
CONFIG_PDL_MCU_PROTOCOL=y

# CCM Libraries - All Enabled
CONFIG_LIBCCM=y

# CCM Applications - All Enabled
CONFIG_APP_COLLECTOR=y
CONFIG_APP_COMM=y
CONFIG_APP_LOGGER=y
CONFIG_APP_HEALTH=y
CONFIG_APP_SUPERVISOR=y

# OSAL Features - All Enabled
CONFIG_OSAL_IPC=y
CONFIG_OSAL_FILE=y
CONFIG_OSAL_THREAD=y
CONFIG_OSAL_NETWORK=y
CONFIG_OSAL_SIGNAL=y

# OSAL IPC - All Enabled
CONFIG_OSAL_IPC_ATOMIC=y
CONFIG_OSAL_IPC_MUTEX=y
CONFIG_OSAL_IPC_SEMAPHORE=y
CONFIG_OSAL_IPC_COND=y
CONFIG_OSAL_IPC_SHM=y
CONFIG_OSAL_IPC_SHM_CACHE=y

# OSAL Library - All Enabled
CONFIG_OSAL_LIB_ERRNO=y
CONFIG_OSAL_LIB_HEAP=y
CONFIG_OSAL_LIB_STDIO=y
CONFIG_OSAL_LIB_STRING=y

# OSAL System - All Enabled
CONFIG_OSAL_SYS_CLOCK=y
CONFIG_OSAL_SYS_ENV=y
CONFIG_OSAL_SYS_FILE=y
CONFIG_OSAL_SYS_PROCESS=y
CONFIG_OSAL_SYS_SCHED=y
CONFIG_OSAL_SYS_SELECT=y
CONFIG_OSAL_SYS_SIGNAL=y
CONFIG_OSAL_SYS_THREAD=y
CONFIG_OSAL_SYS_TIME=y

# OSAL Network - All Enabled
CONFIG_OSAL_NET_SOCKET=y
CONFIG_OSAL_NET_TERMIOS=y

# OSAL Utility - All Enabled
CONFIG_OSAL_UTIL_LOG=y
CONFIG_OSAL_UTIL_VERSION=y

# Testing
CONFIG_BUILD_TESTING=y
CONFIG_TEST_STRESS=y

# OSAL Stress Tests - All Enabled
CONFIG_TEST_STRESS_OSAL=y
CONFIG_TEST_STRESS_OSAL_THREAD=y
CONFIG_TEST_STRESS_OSAL_MEMORY=y
CONFIG_TEST_STRESS_OSAL_IPC=y

# HAL Stress Tests - All Enabled
CONFIG_TEST_STRESS_HAL=y
CONFIG_TEST_STRESS_HAL_CONCURRENT=y
CONFIG_TEST_STRESS_HAL_HIGH_LOAD=y

# PDL Stress Tests - All Enabled
CONFIG_TEST_STRESS_PDL=y
CONFIG_TEST_STRESS_PDL_DEVICE=y

# Other test categories disabled
# CONFIG_TEST_UNIT is not set
# CONFIG_TEST_PERFORMANCE is not set
# CONFIG_TEST_SYSTEM is not set
```
