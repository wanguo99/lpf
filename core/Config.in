## core/osal/src/Kconfig.posix
```kconfig
# ============================================================================
# OSAL POSIX Implementation Configuration
# ============================================================================
# Fine-grained per-file configuration for POSIX platform (Linux/macOS)
# ============================================================================

if OSAL_OS_POSIX

# ============================================================================
# IPC (Inter-Process Communication)
# ============================================================================

if OSAL_IPC

config OSAL_IPC_ATOMIC
	bool "Atomic operations"
	default y
	help
	  Enable atomic operations support.
	  Source: src/posix/ipc/osal_atomic.c

config OSAL_IPC_MUTEX
	bool "Mutex support"
	default y
	help
	  Enable mutex (mutual exclusion) support.
	  Source: src/posix/ipc/osal_mutex.c

config OSAL_IPC_SEMAPHORE
	bool "Semaphore support"
	default y
	help
	  Enable semaphore support.
	  Source: src/posix/ipc/osal_semaphore.c

config OSAL_IPC_COND
	bool "Condition variable support"
	default y
	depends on OSAL_IPC_MUTEX
	help
	  Enable condition variable support.
	  Requires mutex support.
	  Source: src/posix/ipc/osal_cond.c

config OSAL_IPC_SHM
	bool "Shared memory support"
	default y
	help
	  Enable shared memory support.
	  Source: src/posix/ipc/osal_shm.c

config OSAL_IPC_SHM_CACHE
	bool "Shared memory cache"
	default y
	depends on OSAL_IPC_SHM
	help
	  Enable shared memory cache optimization.
	  Requires shared memory support.
	  Source: src/posix/ipc/osal_shm_cache.c

endif # OSAL_IPC

# ============================================================================
# Library Functions
# ============================================================================

menu "Library Functions"

config OSAL_LIB_ERRNO
	bool "Error number handling"
	default y
	help
	  Enable errno operations.
	  Source: src/posix/lib/osal_errno.c

config OSAL_LIB_HEAP
	bool "Heap memory management"
	default y
	help
	  Enable heap memory operations (malloc/free wrappers).
	  Source: src/posix/lib/osal_heap.c

config OSAL_LIB_STDIO
	bool "Standard I/O"
	default y
	help
	  Enable standard I/O operations (printf wrappers).
	  Source: src/posix/lib/osal_stdio.c

config OSAL_LIB_STRING
	bool "String operations"
	default y
	help
	  Enable string operations (safe string functions).
	  Source: src/posix/lib/osal_string.c

endmenu

# ============================================================================
# System Operations
# ============================================================================

if OSAL_FILE

config OSAL_SYS_CLOCK
	bool "Clock operations"
	default y
	help
	  Enable clock operations (clock_gettime, etc).
	  Source: src/posix/sys/osal_clock.c

config OSAL_SYS_ENV
	bool "Environment variables"
	default y
	help
	  Enable environment variable operations.
	  Source: src/posix/sys/osal_env.c

config OSAL_SYS_FILE
	bool "File operations"
	default y
	help
	  Enable file I/O operations.
	  Source: src/posix/sys/osal_file.c

config OSAL_SYS_PROCESS
	bool "Process management"
	default y
	help
	  Enable process management (fork, exec, etc).
	  Source: src/posix/sys/osal_process.c

config OSAL_SYS_SCHED
	bool "Scheduler operations"
	default y
	help
	  Enable scheduler operations (priority, affinity).
	  Source: src/posix/sys/osal_sched.c

config OSAL_SYS_SELECT
	bool "Select/poll operations"
	default y
	help
	  Enable select/poll I/O multiplexing.
	  Source: src/posix/sys/osal_select.c

endif # OSAL_FILE

# ============================================================================
# Thread Support
# ============================================================================

if OSAL_THREAD

config OSAL_SYS_THREAD
	bool "Thread operations"
	default y
	help
	  Enable thread creation and management.
	  Source: src/posix/sys/osal_thread.c

config OSAL_SYS_TIME
	bool "Time operations"
	default y
	help
	  Enable time operations (sleep, delay, etc).
	  Source: src/posix/sys/osal_time.c

endif # OSAL_THREAD

# ============================================================================
# Signal Support
# ============================================================================

if OSAL_SIGNAL

config OSAL_SYS_SIGNAL
	bool "Signal handling"
	default y
	help
	  Enable signal handling operations.
	  Source: src/posix/sys/osal_signal.c

endif # OSAL_SIGNAL

# ============================================================================
# Network Support
# ============================================================================

if OSAL_NETWORK

config OSAL_NET_SOCKET
	bool "Socket operations"
	default y
	help
	  Enable socket operations (TCP/UDP).
	  Source: src/posix/net/osal_socket.c

config OSAL_NET_TERMIOS
	bool "Terminal I/O (termios)"
	default y
	help
	  Enable terminal I/O control.
	  Source: src/posix/net/osal_termios.c

endif # OSAL_NETWORK

# ============================================================================
# Utility Functions
# ============================================================================

menu "Utility Functions"

config OSAL_UTIL_LOG
	bool "Logging support"
	default y
	help
	  Enable logging utilities.
	  Source: src/posix/util/osal_log.c

config OSAL_UTIL_VERSION
	bool "Version information"
	default y
	help
	  Enable version information.
	  Source: src/posix/util/osal_version.c

endmenu

endif # OSAL_OS_POSIX
```

## core/osal/src/posix/Kconfig.file
```kconfig
# OSAL 文件和系统支持配置

if OSAL_FILE

config OSAL_FILE_CLOCK
	bool "Clock operations"
	default y
	help
	  Enable clock operations.
	  Source: src/*/sys/osal_clock.c

config OSAL_FILE_ENV
	bool "Environment variables"
	default y
	help
	  Enable environment variable operations.
	  Source: src/*/sys/osal_env.c

config OSAL_FILE_FILE
	bool "File operations"
	default y
	help
	  Enable file I/O operations.
	  Source: src/*/sys/osal_file.c

config OSAL_FILE_PROCESS
	bool "Process management"
	default y
	help
	  Enable process management.
	  Source: src/*/sys/osal_process.c

config OSAL_FILE_SCHED
	bool "Scheduler operations"
	default y
	help
	  Enable scheduler operations.
	  Source: src/*/sys/osal_sched.c

config OSAL_FILE_SELECT
	bool "Select/poll operations"
	default y
	help
	  Enable select/poll I/O multiplexing.
	  Source: src/*/sys/osal_select.c

endif # OSAL_FILE
```

## core/osal/src/posix/Kconfig.ipc
```kconfig
# OSAL IPC 支持配置

if OSAL_IPC

config OSAL_IPC_ATOMIC
	bool "Atomic operations"
	default y
	help
	  Enable atomic operations support.
	  Source: src/*/ipc/osal_atomic.c

config OSAL_IPC_MUTEX
	bool "Mutex support"
	default y
	help
	  Enable mutex (mutual exclusion) support.
	  Source: src/*/ipc/osal_mutex.c

config OSAL_IPC_SEMAPHORE
	bool "Semaphore support"
	default y
	help
	  Enable semaphore support.
	  Source: src/*/ipc/osal_semaphore.c

config OSAL_IPC_COND
	bool "Condition variable support"
	default y
	depends on OSAL_IPC_MUTEX
	help
	  Enable condition variable support.
	  Requires mutex support.
	  Source: src/*/ipc/osal_cond.c

config OSAL_IPC_SHM
	bool "Shared memory support"
	default y
	help
	  Enable shared memory support.
	  Source: src/*/ipc/osal_shm.c

config OSAL_IPC_SHM_CACHE
	bool "Shared memory cache"
	default y
	depends on OSAL_IPC_SHM
	help
	  Enable shared memory cache optimization.
	  Requires shared memory support.
	  Source: src/*/ipc/osal_shm_cache.c

endif # OSAL_IPC
```

## core/osal/src/posix/Kconfig.network
```kconfig
# OSAL 网络支持配置

if OSAL_NETWORK

config OSAL_NETWORK_SOCKET
	bool "Socket operations"
	default y
	help
	  Enable socket operations (TCP/UDP).
	  Source: src/*/net/osal_socket.c

config OSAL_NETWORK_TERMIOS
	bool "Terminal I/O (termios)"
	default y
	help
	  Enable terminal I/O control.
	  Source: src/*/net/osal_termios.c

endif # OSAL_NETWORK
```

## core/osal/src/posix/Kconfig.signal
```kconfig
# OSAL 信号支持配置

if OSAL_SIGNAL

config OSAL_SIGNAL_SIGNAL
	bool "Signal handling"
	default y
	help
	  Enable signal handling operations.
	  Source: src/*/sys/osal_signal.c

endif # OSAL_SIGNAL
```

## core/osal/src/posix/Kconfig.thread
```kconfig
# OSAL 线程支持配置

if OSAL_THREAD

config OSAL_THREAD_THREAD
	bool "Thread operations"
	default y
	help
	  Enable thread creation and management.
	  Source: src/*/sys/osal_thread.c

config OSAL_THREAD_TIME
	bool "Time operations"
	default y
	help
	  Enable time operations (sleep, delay, etc).
	  Source: src/*/sys/osal_time.c

endif # OSAL_THREAD
```

## core/pcl/Kconfig
```kconfig
# PCL (Peripheral Configuration Library) Configuration

menuconfig PCL
	bool "PCL (Peripheral Configuration Library)"
	default n
	select OSAL
	select HAL
	help
	  Peripheral Configuration Library provides device-tree-like hardware
	  configuration. PCL depends on OSAL and HAL.

	  If unsure, say Y.

if PCL

menu "PCL Build Configuration"

config PCL_BUILD_STATIC
	bool "Build static library (.a)"
	default n
	help
	  Build PCL as a static library (libpcl.a).

config PCL_BUILD_SHARED
	bool "Build shared library (.so)"
	default n
	help
	  Build PCL as a shared library (libpcl.so).

endmenu

#source "src/Kconfig.api"

endif # PCL
```

## core/pconfig/Config.in
```kconfig
# PCONFIG (Peripheral Configuration Library) Configuration

menuconfig PCONFIG
	bool "PCONFIG (Peripheral Configuration Library)"
	default n
	depends on OSAL && HAL
	help
	  Peripheral Configuration Library provides device-tree-like hardware
	  configuration management.

	  PCONFIG acts as a hardware abstraction layer that describes the physical
	  hardware configuration of a platform (board variant, peripheral
	  connections, pin mappings, etc.) in a structured, data-driven way.

	  Key features:
	  - Platform-specific hardware descriptions
	  - Board variant management (e.g., H200_100P_V1, H200_100P_V2)
	  - Peripheral configuration tables
	  - Runtime hardware detection and configuration

	  Memory footprint: ~10KB code + configuration data (varies by platform)

	  Use cases:
	  - Multi-board product variants
	  - Hardware abstraction for applications
	  - Runtime board identification
	  - Peripheral auto-configuration

	  Dependencies: OSAL (for basic services), HAL (for hardware access)

	  Note: Enable OSAL, HAL, and TYPES first in "Core Modules" menu.

	  Recommended: Enable for products with multiple hardware variants

	  If unsure, say Y.

if PCONFIG

menu "PCONFIG Build Configuration"

config PCONFIG_BUILD_STATIC
	bool "Build static library (.a)"
	default n
	help
	  Build PCONFIG as a static library (libpconfig.a).

	  Static linking advantages:
	  - No runtime dependencies
	  - Configuration data embedded in executable
	  - Slightly faster (no dynamic linking)

	  Recommended: Enable for embedded systems with fixed hardware

config PCONFIG_BUILD_SHARED
	bool "Build shared library (.so)"
	default n
	help
	  Build PCONFIG as a shared library (libpconfig.so).

	  Shared library advantages:
	  - Can update hardware configurations without recompiling apps
	  - Smaller executable size
	  - Code sharing between processes

	  Use cases:
	  - Systems with multiple applications using PCONFIG
	  - Field-updatable hardware configurations

	  Recommended: Enable for multi-application systems

endmenu

endif # PCONFIG
```

## core/pdl/Config.in
```kconfig
# PDL (Peripheral Driver Layer) Configuration

menuconfig PDL
	bool "PDL (Peripheral Driver Layer)"
	default n
	depends on OSAL && HAL && PCONFIG
	help
	  Peripheral Driver Layer provides high-level peripheral management
	  and protocol handling.

	  PDL sits above HAL and provides:
	  - Protocol-aware peripheral drivers
	  - Device abstraction (MCU modules, PMC)
	  - State management and error handling
	  - Unified API for complex peripherals

	  Architecture:
	  PDL uses HAL for low-level hardware access and PCONFIG for
	  hardware configuration, providing application-level APIs
	  for managing complex peripheral subsystems.

	  Memory footprint: ~15KB base + per-peripheral drivers

	  Supported peripherals:
	  - MCU modules (microcontroller peripherals)
	  - PMC (Communication Control Module)

	  Dependencies: OSAL, HAL, PCONFIG

	  Note: Enable OSAL, HAL, PCONFIG, and TYPES first in "Core Modules" menu.

	  Recommended: Enable for systems with complex peripheral management

	  If unsure, say Y.

if PDL

menu "PDL Build Configuration"

config PDL_BUILD_STATIC
	bool "Build static library (.a)"
	default y
	help
	  Build PDL as a static library (libpdl.a).

	  Static linking advantages:
	  - No runtime dependencies
	  - Peripheral drivers embedded in executable
	  - Slightly faster

	  Recommended: Enable for embedded systems

config PDL_BUILD_SHARED
	bool "Build shared library (.so)"
	default n
	help
	  Build PDL as a shared library (libpdl.so).

	  Shared library advantages:
	  - Can update peripheral drivers without recompiling apps
	  - Smaller executable size
	  - Code sharing between processes

	  Recommended: Enable for multi-application systems

endmenu

menuconfig PDL_MCU_SUPPORT
	bool "MCU peripheral support"
	default n
	help
	  Enable MCU (Microcontroller) peripheral support.

	  MCU peripherals are microcontroller-based modules that provide
	  specialized control and monitoring functions, offloading tasks
	  from the main processor.

	  Typical MCU functions:
	  - Real-time sensor data acquisition
	  - PWM control for motors/actuators
	  - Analog signal processing
	  - Low-level protocol handling

	  Communication options:
	  - CAN bus (for robust, multi-drop networks)
	  - UART (for point-to-point connections)

	  Memory footprint: ~8KB base + protocol overhead

	  You can enable CAN-based or UART-based MCU support in the submenu.

	  If unsure, say Y.

source "core/pdl/src/pdl_mcu/Config.in"

menuconfig PDL_PMC_SUPPORT
	bool "PMC (Communication Control Module) support"
	default n
	select OSAL_NETWORK
	help
	  Enable PMC (Communication Control Module) for PMC communication.

	  PMC provides high-level interface with PMC (Power Management
	  Controller) over Ethernet, handling:
	  - TCP/IP socket communication
	  - Message framing and CRC validation
	  - Connection management and auto-reconnect
	  - Command/response protocol

	  Features:
	  - Reliable TCP-based communication
	  - Automatic message sequencing
	  - Configurable timeouts
	  - Thread-safe operation

	  Memory footprint: ~8KB

	  Communication protocol:
	  - Frame: [Magic][Type][Rsv][SeqNum][Len][CRC32][Payload]
	  - Magic number: 0xAA55
	  - CRC32 validation for data integrity

	  Use cases:
	  - PMC power management and monitoring
	  - Remote system control
	  - Distributed power systems

	  Dependencies: OSAL_NETWORK (for socket API)

	  If unsure, say N.

source "core/pdl/src/pdl_pmc/Config.in"

endif # PDL
```
