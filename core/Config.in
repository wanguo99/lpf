## core/pdl/Kconfig
```kconfig
# PDL (Peripheral Driver Layer) Configuration

menuconfig PDL
	bool "PDL (Peripheral Driver Layer)"
	default n
	select OSAL
	select HAL
	select PCL
	help
	  Peripheral Driver Layer provides high-level peripheral management
	  and protocol handling.

	  PDL sits above HAL and provides:
	  - Protocol-aware peripheral drivers
	  - Device abstraction (satellites, BMC, MCU modules)
	  - State management and error handling
	  - Unified API for complex peripherals

	  Architecture:
	  PDL uses HAL for low-level hardware access and PCL for
	  hardware configuration, providing application-level APIs
	  for managing complex peripheral subsystems.

	  Memory footprint: ~15KB base + per-peripheral drivers

	  Supported peripherals:
	  - Satellite modules (CAN-based distributed I/O)
	  - BMC (Baseboard Management Controller)
	  - MCU modules (microcontroller peripherals)
	  - Watchdog management

	  Dependencies: OSAL, HAL, PCL

	  Recommended: Enable for systems with complex peripheral management

	  If unsure, say Y.

if PDL

menu "PDL Build Configuration"

config PDL_BUILD_STATIC
	bool "Build static library (.a)"
	default y
	help
	  Build PDL as a static library (libpdl.a).

	  Static linking advantages:
	  - No runtime dependencies
	  - Peripheral drivers embedded in executable
	  - Slightly faster

	  Recommended: Enable for embedded systems

config PDL_BUILD_SHARED
	bool "Build shared library (.so)"
	default n
	help
	  Build PDL as a shared library (libpdl.so).

	  Shared library advantages:
	  - Can update peripheral drivers without recompiling apps
	  - Smaller executable size
	  - Code sharing between processes

	  Recommended: Enable for multi-application systems

endmenu

menuconfig PDL_SATELLITE_SUPPORT
	bool "Satellite peripheral support"
	default n
	select HAL_CAN
	select OSAL_NETWORK
	help
	  Enable satellite peripheral management via CAN bus.

	  Satellites are remote sensor/actuator modules connected via
	  CAN bus, providing distributed I/O capabilities for large
	  systems where centralized I/O is impractical.

	  Features:
	  - CAN-based communication protocol
	  - Remote sensor reading
	  - Remote actuator control
	  - Health monitoring and diagnostics

	  Memory footprint: ~12KB

	  Use cases:
	  - Distributed sensor networks
	  - Large spacecraft with multiple subsystems
	  - Industrial automation with remote I/O

	  Dependencies: HAL_CAN (for CAN bus), OSAL_NETWORK (for protocol)

	  If unsure, say Y.

source "core/pdl/src/pdl_satellite/Kconfig"

menuconfig PDL_BMC_SUPPORT
	bool "BMC peripheral support"
	default n
	select HAL_UART
	select OSAL_NETWORK
	help
	  Enable BMC (Baseboard Management Controller) peripheral support.

	  BMC provides out-of-band server management functions including:
	  - Power control (on/off/reset)
	  - Temperature and voltage monitoring
	  - Fan control
	  - Remote console access (SOL - Serial Over LAN)
	  - Event logging

	  Memory footprint: ~10KB

	  Communication interfaces:
	  - UART (for local management)
	  - Ethernet (for remote management via IPMI)

	  Use cases:
	  - Server management
	  - Remote system monitoring
	  - Automated recovery from failures

	  Dependencies: HAL_UART, OSAL_NETWORK

	  If unsure, say Y.

source "core/pdl/src/pdl_bmc/Kconfig"

menuconfig PDL_MCU_SUPPORT
	bool "MCU peripheral support"
	default n
	help
	  Enable MCU (Microcontroller) peripheral support.

	  MCU peripherals are microcontroller-based modules that provide
	  specialized control and monitoring functions, offloading tasks
	  from the main processor.

	  Typical MCU functions:
	  - Real-time sensor data acquisition
	  - PWM control for motors/actuators
	  - Analog signal processing
	  - Low-level protocol handling

	  Communication options:
	  - CAN bus (for robust, multi-drop networks)
	  - UART (for point-to-point connections)

	  Memory footprint: ~8KB base + protocol overhead

	  You can enable CAN-based or UART-based MCU support below.

	  If unsure, say Y.

if PDL_MCU_SUPPORT

config PDL_MCU_CAN_SUPPORT
	bool "MCU peripheral via CAN"
	default y
	select HAL_CAN
	select OSAL_NETWORK
	help
	  Enable MCU peripheral support via CAN bus.

	  CAN-based MCU communication provides:
	  - Multi-drop network (multiple MCUs on one bus)
	  - Robust error detection (CRC, bit stuffing)
	  - Priority-based arbitration
	  - Up to 1 Mbps data rate

	  Memory footprint: ~6KB

	  Use cases:
	  - Automotive-style distributed control
	  - Industrial automation networks
	  - Systems with multiple MCU modules

	  Dependencies: HAL_CAN, OSAL_NETWORK

	  Recommended: Enable for CAN-based systems

config PDL_MCU_UART_SUPPORT
	bool "MCU peripheral via UART"
	default n
	select HAL_UART
	select OSAL_NETWORK
	help
	  Enable MCU peripheral support via UART.

	  UART-based MCU communication provides:
	  - Simple point-to-point connection
	  - Lower cost (no CAN transceiver needed)
	  - Flexible baud rates
	  - Easy debugging (can monitor with serial terminal)

	  Memory footprint: ~5KB

	  Use cases:
	  - Single MCU module systems
	  - Cost-sensitive designs
	  - Debug and development

	  Dependencies: HAL_UART, OSAL_NETWORK

	  Recommended: Enable for UART-based systems

endif # PDL_MCU_SUPPORT

source "core/pdl/src/pdl_mcu/Kconfig"

menuconfig PDL_WATCHDOG_SUPPORT
	bool "Watchdog peripheral support"
	default n
	select HAL_WATCHDOG
	select OSAL_THREAD
	help
	  Enable watchdog peripheral support for system reliability.

	  Watchdog management provides:
	  - Automatic system reset on software hang
	  - Configurable timeout periods
	  - Periodic "kick" mechanism
	  - Health monitoring integration

	  Features:
	  - Background thread for automatic watchdog refresh
	  - Application health check callbacks
	  - Graceful shutdown on critical errors
	  - Watchdog timeout logging

	  Memory footprint: ~4KB + thread stack (typically 8KB)

	  Use cases:
	  - Unattended operation (satellites, remote systems)
	  - Safety-critical applications
	  - High-reliability systems

	  Dependencies: HAL_WATCHDOG, OSAL_THREAD

	  Recommended: Enable for production systems requiring high reliability

	  Note: Improper watchdog configuration can cause unexpected resets.
	  Ensure all critical tasks can complete within the timeout period.

endif # PDL
```
