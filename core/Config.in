## core/hal/Kconfig
```kconfig
# HAL (Hardware Abstraction Layer) Configuration

menuconfig HAL
	bool "HAL (Hardware Abstraction Layer)"
	default n
	select OSAL
	help
	  Hardware Abstraction Layer provides unified hardware interfaces.
	  HAL depends on OSAL.

if HAL

# =============================================================================
# Platform Configuration
# =============================================================================

menu "Platform Configuration"

config PLATFORM_GENERIC_LINUX
	bool "Generic Linux platform"
	default y
	depends on OS_LINUX
	help
	  Enable generic Linux platform support.
	  Uses standard Linux drivers (SocketCAN, sysfs GPIO, etc).

endmenu

# =============================================================================
# Build Configuration
# =============================================================================

menu "Build Configuration"

config HAL_BUILD_STATIC
	bool "Build static library"
	default y
	help
	  Build libhal.a static library.

config HAL_BUILD_SHARED
	bool "Build shared library"
	default n
	help
	  Build libhal.so shared library.

endmenu

# =============================================================================
# Driver Configuration (Fine-grained per-driver control)
# =============================================================================

menu "Driver Configuration"

menuconfig HAL_CAN
	bool "CAN bus support"
	default y
	help
	  Enable CAN bus driver.

menuconfig HAL_UART
	bool "UART support"
	default y
	help
	  Enable UART/serial driver.

menuconfig HAL_I2C
	bool "I2C support"
	default y
	help
	  Enable I2C bus driver.

menuconfig HAL_SPI
	bool "SPI support"
	default y
	help
	  Enable SPI bus driver.

menuconfig HAL_GPIO
	bool "GPIO support"
	default y
	help
	  Enable GPIO driver.

menuconfig HAL_WATCHDOG
	bool "Watchdog support"
	default y
	help
	  Enable watchdog timer driver.

endmenu

# Platform-specific fine-grained configuration
source "core/hal/src/Kconfig.linux"
source "core/hal/src/Kconfig.macos"

# =============================================================================
# Advanced Features
# =============================================================================

menu "Advanced Features"

config HAL_DEBUG
	bool "Enable debug logging"
	default n
	help
	  Enable verbose debug logging in HAL.

config HAL_STATISTICS
	bool "Enable statistics"
	default n
	help
	  Enable HAL statistics collection.

config HAL_POWER_MANAGEMENT
	bool "Enable power management"
	default n
	help
	  Enable power management features.

endmenu

endif # HAL
```

## core/hal/src/Kconfig.linux
```kconfig
# ============================================================================
# HAL Generic Linux Platform Configuration
# ============================================================================
# Fine-grained per-driver configuration for Generic Linux platform
# ============================================================================

if PLATFORM_GENERIC_LINUX

# ============================================================================
# CAN Bus Driver
# ============================================================================

if HAL_CAN

config HAL_CAN_LINUX
	bool "Linux SocketCAN driver"
	default y
	help
	  Enable Linux SocketCAN driver.
	  Source: src/linux/hal_can_linux.c

endif # HAL_CAN

# ============================================================================
# GPIO Driver
# ============================================================================

if HAL_GPIO

config HAL_GPIO_LINUX
	bool "Linux sysfs GPIO driver"
	default y
	help
	  Enable Linux sysfs GPIO driver.
	  Source: src/linux/hal_gpio_linux.c

endif # HAL_GPIO

# ============================================================================
# I2C Driver
# ============================================================================

if HAL_I2C

config HAL_I2C_LINUX
	bool "Linux I2C driver"
	default y
	help
	  Enable Linux I2C driver (/dev/i2c-*).
	  Source: src/linux/hal_i2c_linux.c

endif # HAL_I2C

# ============================================================================
# SPI Driver
# ============================================================================

if HAL_SPI

config HAL_SPI_LINUX
	bool "Linux SPI driver"
	default y
	help
	  Enable Linux SPI driver (/dev/spidev*).
	  Source: src/linux/hal_spi_linux.c

endif # HAL_SPI

# ============================================================================
# UART Driver
# ============================================================================

if HAL_UART

config HAL_UART_LINUX
	bool "Linux serial driver"
	default y
	help
	  Enable Linux serial driver (/dev/tty*).
	  Source: src/linux/hal_serial_linux.c

endif # HAL_UART

# ============================================================================
# Watchdog Driver
# ============================================================================

if HAL_WATCHDOG

config HAL_WATCHDOG_LINUX
	bool "Linux watchdog driver"
	default y
	help
	  Enable Linux watchdog driver (/dev/watchdog).
	  Source: src/linux/hal_watchdog_linux.c

endif # HAL_WATCHDOG

endif # PLATFORM_GENERIC_LINUX
```

## core/hal/src/generic-linux/Kconfig.can
```kconfig
# HAL CAN 驱动配置

if HAL_CAN

config HAL_CAN_LINUX
	bool "CAN Linux driver"
	default y
	depends on PLATFORM_GENERIC_LINUX
	help
	  Enable CAN driver for Linux (SocketCAN).
	  Source: src/generic-linux/hal_can_linux.c

config HAL_CAN_FILTER
	bool "CAN filter support"
	default y
	help
	  Enable CAN message filtering.

config HAL_CAN_ERROR_HANDLING
	bool "CAN error handling"
	default y
	help
	  Enable CAN error frame handling.

config HAL_CAN_LOOPBACK
	bool "CAN loopback mode"
	default y
	help
	  Enable CAN loopback mode for testing.

endif # HAL_CAN
```

## core/hal/src/generic-linux/Kconfig.i2c
```kconfig
# HAL I2C 驱动配置

if HAL_I2C

config HAL_I2C_LINUX
	bool "I2C Linux driver"
	default y
	depends on PLATFORM_GENERIC_LINUX
	help
	  Enable I2C driver for Linux.
	  Source: src/generic-linux/hal_i2c_linux.c

config HAL_I2C_SLAVE
	bool "I2C slave mode"
	default y
	help
	  Enable I2C slave mode support.

config HAL_I2C_10BIT_ADDR
	bool "I2C 10-bit addressing"
	default y
	help
	  Enable 10-bit I2C addressing.

endif # HAL_I2C
```

## core/hal/src/generic-linux/Kconfig.uart
```kconfig
# HAL UART 驱动配置

if HAL_UART

config HAL_UART_LINUX
	bool "UART Linux driver"
	default y
	depends on PLATFORM_GENERIC_LINUX
	help
	  Enable UART driver for Linux.
	  Source: src/generic-linux/hal_serial_linux.c

config HAL_UART_FLOW_CONTROL
	bool "UART flow control"
	default y
	help
	  Enable hardware flow control (RTS/CTS).

config HAL_UART_RS485
	bool "RS485 support"
	default y
	help
	  Enable RS485 mode support.

endif # HAL_UART
```

## core/hal/src/macos/Config.in
```kconfig
# ============================================================================
# HAL macOS Platform Configuration
# ============================================================================
# Fine-grained per-driver configuration for macOS platform
# ============================================================================

if OS_MACOS

# ============================================================================
# CAN Bus Driver
# ============================================================================

if HAL_CAN

config HAL_CAN_MACOS
	bool "macOS CAN driver (stub)"
	default y
	help
	  Enable macOS CAN driver stub.
	  Source: src/macos/hal_can_macos.c

endif # HAL_CAN

# ============================================================================
# GPIO Driver
# ============================================================================

if HAL_GPIO

config HAL_GPIO_MACOS
	bool "macOS GPIO driver (stub)"
	default y
	help
	  Enable macOS GPIO driver stub.
	  Source: src/macos/hal_gpio_macos.c

endif # HAL_GPIO

# ============================================================================
# I2C Driver
# ============================================================================

if HAL_I2C

config HAL_I2C_MACOS
	bool "macOS I2C driver (stub)"
	default y
	help
	  Enable macOS I2C driver stub.
	  Source: src/macos/hal_i2c_macos.c

endif # HAL_I2C

# ============================================================================
# SPI Driver
# ============================================================================

if HAL_SPI

config HAL_SPI_MACOS
	bool "macOS SPI driver (stub)"
	default y
	help
	  Enable macOS SPI driver stub.
	  Source: src/macos/hal_spi_macos.c

endif # HAL_SPI

# ============================================================================
# UART Driver
# ============================================================================

if HAL_UART

config HAL_UART_MACOS
	bool "macOS serial driver"
	default y
	help
	  Enable macOS serial driver.
	  Source: src/macos/hal_serial_macos.c

endif # HAL_UART

# ============================================================================
# Watchdog Driver
# ============================================================================

if HAL_WATCHDOG

config HAL_WATCHDOG_MACOS
	bool "macOS watchdog driver (stub)"
	default y
	help
	  Enable macOS watchdog driver stub.
	  Source: src/macos/hal_watchdog_macos.c

endif # HAL_WATCHDOG

endif # OS_MACOS
```

## core/kernel/pconfig/Config.in
```kconfig
# PCONFIG (Peripheral Configuration Library) Configuration

menuconfig PCONFIG
	bool "PCONFIG (Peripheral Configuration Library)"
	default n
	depends on OSAL
	help
	  Peripheral Configuration Library provides read-only access to
	  product-defined hardware configuration tables.

	  PCONFIG describes the physical hardware configuration of a platform
	  (board variant, peripheral connections, pin mappings, etc.) in a
	  structured, data-driven way.

	  Key features:
	  - Platform-specific hardware descriptions
	  - Board variant tables compiled in by the product
	  - Peripheral configuration tables
	  - Query-only platform configuration API

	  Memory footprint: small code footprint + product configuration data

	  Use cases:
	  - Fixed product hardware descriptions
	  - Multi-board product variants selected at build time
	  - Hardware abstraction for applications and PDL
	  - Peripheral lookup by index or platform/product name

	  Dependencies: OSAL (for basic services)

	  Note: Enable OSAL first in "Core Modules" menu.
	  Runtime code must not register, reload, switch, or mutate PCONFIG data
	  through core APIs.

	  Recommended: Enable for products with hardware configuration tables

	  If unsure, say Y.

if PCONFIG

menu "PCONFIG Build Configuration"

config PCONFIG_BUILD_STATIC
	bool "Build static library (.a)"
	default n
	help
	  Build PCONFIG as a static library (libpconfig.a).

	  Static linking advantages:
	  - No runtime dependencies
	  - Configuration data embedded in executable
	  - Slightly faster (no dynamic linking)

	  Recommended: Enable for embedded systems with fixed hardware

config PCONFIG_BUILD_SHARED
	bool "Build shared library (.so)"
	default n
	help
	  Build PCONFIG as a shared library (libpconfig.so).

	  Shared library advantages:
	  - Smaller executable size
	  - Code sharing between processes

	  Note: configuration data is still read-only from PCONFIG's public API.

	  Recommended: Enable for multi-application systems

endmenu

endif # PCONFIG
```

## core/kernel/pdm/Config.in
```kconfig
# PDM (Peripheral Driver Module) Configuration

menuconfig PDM
	bool "PDM (Peripheral Driver Module)"
	default n
	depends on OSAL && HAL && PCONFIG
	help
	  Peripheral Driver Module provides high-level peripheral management
	  and protocol handling.

	  PDM sits above HAL and provides:
	  - Protocol-aware peripheral drivers
	  - Device abstraction (current MCU peripheral type)
	  - State management and error handling
	  - Unified API for complex peripherals

	  Architecture:
	  PDM uses HAL for low-level hardware access and PCONFIG for
	  hardware configuration, providing application-level APIs
	  for managing peripheral subsystems.

	  Memory footprint: ~15KB base + per-peripheral drivers

	  Supported peripherals:
	  - MCU peripherals

	  Dependencies: OSAL, HAL, PCONFIG

	  Note: Enable OSAL, HAL, PCONFIG, and TYPES first in "Core Modules" menu.

	  Recommended: Enable for systems with peripheral management

	  If unsure, say Y.

if PDM

menu "PDM Build Configuration"

config PDM_BUILD_STATIC
	bool "Build static library (.a)"
	default y
	help
	  Build PDM as a static library (libpdm.a).

	  Static linking advantages:
	  - No runtime dependencies
	  - Peripheral drivers embedded in executable
	  - Slightly faster

	  Recommended: Enable for embedded systems

config PDM_BUILD_SHARED
	bool "Build shared library (.so)"
	default n
	help
	  Build PDM as a shared library (libpdm.so).

	  Shared library advantages:
	  - Can update peripheral drivers without recompiling apps
	  - Smaller executable size
	  - Code sharing between processes

	  Recommended: Enable for multi-application systems

endmenu

menuconfig PDM_MCU_SUPPORT
	bool "MCU peripheral support"
	default n
	help
	  Enable MCU (Microcontroller) peripheral support.

	  MCU peripherals are microcontroller-based modules that provide
	  specialized control and monitoring functions, offloading tasks
	  from the main processor.

	  Typical MCU functions:
	  - Real-time sensor data acquisition
	  - PWM control for motors/actuators
	  - Analog signal processing
	  - Low-level protocol handling

	  Communication options:
	  - CAN bus (for robust, multi-drop networks)
	  - UART (for point-to-point connections)

	  Memory footprint: ~8KB base + protocol overhead

	  You can enable CAN-based or UART-based MCU support in the submenu.

	  If unsure, say Y.

source "core/kernel/pdm/src/pdm_mcu/Config.in"

endif # PDM
```
