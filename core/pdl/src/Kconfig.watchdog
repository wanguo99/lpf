## core/user/osal/src/Config.in
```kconfig
# ============================================================================
# OSAL Linux User-Space Backend Configuration
# ============================================================================
# Fine-grained per-file configuration for the Linux user-space backend
# ============================================================================

if OSAL_OS_POSIX

# ============================================================================
# IPC (Inter-Process Communication)
# ============================================================================

if OSAL_IPC

config OSAL_IPC_ATOMIC
	bool "Atomic operations"
	default n
	help
	  Enable atomic operations support.
	  Source: inline header implementation

config OSAL_IPC_MUTEX
	bool "Mutex support"
	default n
	help
	  Enable mutex (mutual exclusion) support.
	  Source: src/ipc/osal_mutex.c

config OSAL_IPC_RWLOCK
	bool "Read-write lock support"
	default n
	help
	  Enable read-write lock support for read-heavy scenarios.
	  Allows multiple readers or single writer.
	  Source: src/ipc/osal_rwlock.c

config OSAL_IPC_SEMAPHORE
	bool "Semaphore support"
	default n
	help
	  Enable semaphore support.
	  Source: src/ipc/osal_semaphore.c

config OSAL_IPC_COND
	bool "Condition variable support"
	default n
	depends on OSAL_IPC_MUTEX
	help
	  Enable condition variable support.
	  Requires mutex support.
	  Source: src/ipc/osal_cond.c

config OSAL_IPC_SHM
	bool "Shared memory support"
	default n
	help
	  Enable shared memory support.
	  Source: src/ipc/osal_shm.c

config OSAL_IPC_SHM_CACHE
	bool "Shared memory cache"
	default n
	depends on OSAL_IPC_SHM
	help
	  Enable shared memory cache optimization.
	  Requires shared memory support.
	  Source: src/ipc/osal_shm_cache.c

endif # OSAL_IPC

# ============================================================================
# Library Functions
# ============================================================================

menu "Library Functions"

config OSAL_LIB_ERRNO
	bool "Error number handling"
	default n
	help
	  Enable errno operations.
	  Source: src/lib/osal_errno.c

config OSAL_LIB_HEAP
	bool "Heap memory management"
	default n
	help
	  Enable heap memory operations (malloc/free wrappers).
	  Source: src/lib/osal_heap.c

config OSAL_LIB_STDIO
	bool "Standard I/O"
	default n
	help
	  Enable standard I/O operations (printf wrappers).
	  Source: src/lib/osal_stdio.c

config OSAL_LIB_STRING
	bool "String operations"
	default n
	help
	  Enable string operations (safe string functions).
	  Source: src/lib/osal_string.c

endmenu

# ============================================================================
# System Operations
# ============================================================================

if OSAL_FILE

config OSAL_SYS_CLOCK
	bool "Clock operations"
	default n
	help
	  Enable clock operations (clock_gettime, etc).
	  Source: src/sys/osal_clock.c

config OSAL_SYS_ENV
	bool "Environment variables"
	default n
	help
	  Enable environment variable operations.
	  Source: src/sys/osal_env.c

config OSAL_SYS_FILE
	bool "File operations"
	default n
	help
	  Enable file I/O operations.
	  Source: src/sys/osal_file.c

config OSAL_SYS_PROCESS
	bool "Process management"
	default n
	help
	  Enable process management (fork, exec, etc).
	  Source: src/sys/osal_process.c

config OSAL_SYS_SCHED
	bool "Scheduler operations"
	default n
	help
	  Enable scheduler operations (priority, affinity).
	  Source: src/sys/osal_sched.c

config OSAL_SYS_SELECT
	bool "Select/poll operations"
	default n
	help
	  Enable select/poll I/O multiplexing.
	  Source: src/sys/osal_select.c

endif # OSAL_FILE

# ============================================================================
# Thread Support
# ============================================================================

if OSAL_THREAD

config OSAL_SYS_THREAD
	bool "Thread operations"
	default n
	help
	  Enable thread creation and management.
	  Source: src/sys/osal_thread.c

config OSAL_SYS_TIME
	bool "Time operations"
	default n
	help
	  Enable time operations (sleep, delay, etc).
	  Source: src/sys/osal_time.c

endif # OSAL_THREAD

# ============================================================================
# Signal Support
# ============================================================================

if OSAL_SIGNAL

config OSAL_SYS_SIGNAL
	bool "Signal handling"
	default n
	help
	  Enable signal handling operations.
	  Source: src/sys/osal_signal.c

endif # OSAL_SIGNAL

# ============================================================================
# Network Support
# ============================================================================

if OSAL_NETWORK

config OSAL_NET_SOCKET
	bool "Socket operations"
	default n
	help
	  Enable socket operations (TCP/UDP).
	  Source: src/net/osal_socket.c

config OSAL_NET_TERMIOS
	bool "Terminal I/O (termios)"
	default n
	help
	  Enable terminal I/O control.
	  Source: src/net/osal_termios.c

config OSAL_NET_PTY
	bool "Pseudo-terminal support"
	default n
	help
	  Enable pseudo-terminal creation support.
	  Source: src/net/osal_pty.c

endif # OSAL_NETWORK

# ============================================================================
# Utility Functions
# ============================================================================

menu "Utility Functions"

config OSAL_UTIL_LOG
	bool "Logging support"
	default n
	help
	  Enable logging utilities.
	  Source: src/util/osal_log.c

config OSAL_UTIL_VERSION
	bool "Version information"
	default n
	help
	  Enable version information.
	  Source: src/util/osal_version.c

endmenu

endif # OSAL_OS_POSIX
```

## core/user/pdi/Config.in
```kconfig
# PDI (Peripheral Driver Interface) Configuration

menuconfig PDI
	bool "PDI (Peripheral Driver Interface)"
	default n
	help
	  Userspace API library for the kernel PDM module.

	  PDI owns the userspace API surface and is organized by peripheral.
	  MCU access wraps open/ioctl/close for /dev/pdm_mcu.

if PDI

config PDI_BUILD_STATIC
	bool "Build static library (.a)"
	default y

config PDI_BUILD_SHARED
	bool "Build shared library (.so)"
	default n

endif # PDI
```

## core/utest/Config.in
```kconfig
# UTEST (Unit Test Framework) Configuration

menuconfig UTEST
	bool "UTEST (Unit Test Framework)"
	default n
	select OSAL
	help
	  Lightweight unit test framework for ES-Middleware.
	  Provides test registration, assertions, mocking, and reporting.

	  This is a core testing infrastructure that can be used by
	  all products (CCM, etc.) for writing unit tests, integration
	  tests, performance tests, and stress tests.

	  Features:
	  - Test discovery and registration
	  - Rich assertion macros
	  - Mock functions support
	  - Performance measurement
	  - Stress testing utilities
	  - Parameterized tests
	  - Test metadata and filtering

	  Required for CONFIG_BUILD_TESTING=y.

	  If unsure, say Y when building tests.

if UTEST

config UTEST_VERBOSE
	bool "Verbose test output"
	default n
	help
	  Enable detailed test execution output.
	  Shows test setup/teardown and timing information.

config UTEST_COLOR
	bool "Colorized test output"
	default y
	help
	  Enable colored terminal output for test results.
	  Makes PASS/FAIL results easier to read.

config UTEST_MAX_TESTS
	int "Maximum number of tests"
	default 1024
	range 64 4096
	help
	  Maximum number of test cases that can be registered.
	  Increase this if you have many test cases.

config UTEST_MAX_NAME_LEN
	int "Maximum test name length"
	default 128
	range 32 256
	help
	  Maximum length of test case names.

endif # UTEST
```

## defconfig
```kconfig
CONFIG_BUILD_TYPE_DEBUG=y
CONFIG_OSAL_MAX_TASKS=128
CONFIG_OSAL_MAX_QUEUES=64
CONFIG_OSAL_MAX_MUTEXES=64
CONFIG_OSAL_DEBUG_LOGGING=y
CONFIG_HAL_I2C=y
CONFIG_HAL_SPI=y
```

## docs/buildroot/Config.in
```kconfig
config BR2_PACKAGE_LPF
	bool "lpf"
	depends on BR2_LINUX_KERNEL
	depends on BR2_TOOLCHAIN_HAS_THREADS
	depends on BR2_USE_MMU
	depends on BR2_INSTALL_LIBSTDCPP
	help
	  LPF is a generic Linux peripheral framework
	  with a Kconfig+CMake/Kbuild build system. It provides OSAL,
	  LPF HW, LPF Core, LPF peripheral runtime, PDI, ACONFIG, and
	  runtime configuration layers for Linux systems.

if BR2_PACKAGE_LPF

config BR2_PACKAGE_LPF_DEFCONFIG
	string "Kconfig defconfig to use"
	default "kernel_x86_modules_defconfig"
	help
	  Specify which LPF configuration to use.
	  Defconfigs are provided under configs/.

choice
	prompt "Build type"
	default BR2_PACKAGE_LPF_BUILD_TYPE_RELEASE

config BR2_PACKAGE_LPF_BUILD_TYPE_RELEASE
	bool "Release"

config BR2_PACKAGE_LPF_BUILD_TYPE_DEBUG
	bool "Debug"

config BR2_PACKAGE_LPF_BUILD_TYPE_RELWITHDEBINFO
	bool "RelWithDebInfo"

endchoice

config BR2_PACKAGE_LPF_BUILD_TYPE
	string
	default "Release" if BR2_PACKAGE_LPF_BUILD_TYPE_RELEASE
	default "Debug" if BR2_PACKAGE_LPF_BUILD_TYPE_DEBUG
	default "RelWithDebInfo" if BR2_PACKAGE_LPF_BUILD_TYPE_RELWITHDEBINFO

config BR2_PACKAGE_LPF_INSTALL_HEADERS
	bool "Install development headers"
	default n
	help
	  Install development headers to $(STAGING_DIR)/usr/include/.
	  Only needed for packages that depend on LPF.

config BR2_PACKAGE_LPF_MENUCONFIG
	bool "Enable interactive menuconfig"
	help
	  Add host-kconfig-frontends dependency to enable interactive
	  configuration via 'make lpf-menuconfig'.

endif # BR2_PACKAGE_LPF

comment "LPF needs Linux kernel and a toolchain w/ threads, C++, MMU"
	depends on !BR2_LINUX_KERNEL || !BR2_TOOLCHAIN_HAS_THREADS || \
		!BR2_USE_MMU || !BR2_INSTALL_LIBSTDCPP
```

## docs/buildroot/package/pdm/Config.in
```kconfig
config BR2_PACKAGE_PDM
	bool "pdm"
	depends on BR2_LINUX_KERNEL
	depends on BR2_TOOLCHAIN_HAS_THREADS
	depends on BR2_USE_MMU
	help
	  PDM is a Linux peripheral access framework with a
	  Kconfig+CMake/Kbuild build system. It provides the PDM kernel
	  module, UAPI headers, and PDI layers for Linux systems.

if BR2_PACKAGE_PDM

config BR2_PACKAGE_PDM_DEFCONFIG
	string "Kconfig defconfig to use"
	default ""
	help
	  Specify which PDM defconfig to load before building.
	  Product external trees should set this to a product-specific
	  PDM defconfig, for example imx6ull_modules_defconfig.

choice
	prompt "Build type"
	default BR2_PACKAGE_PDM_BUILD_TYPE_RELEASE

config BR2_PACKAGE_PDM_BUILD_TYPE_RELEASE
	bool "Release"

config BR2_PACKAGE_PDM_BUILD_TYPE_DEBUG
	bool "Debug"

config BR2_PACKAGE_PDM_BUILD_TYPE_RELWITHDEBINFO
	bool "RelWithDebInfo"

endchoice

config BR2_PACKAGE_PDM_BUILD_TYPE
	string
	default "Release" if BR2_PACKAGE_PDM_BUILD_TYPE_RELEASE
	default "Debug" if BR2_PACKAGE_PDM_BUILD_TYPE_DEBUG
	default "RelWithDebInfo" if BR2_PACKAGE_PDM_BUILD_TYPE_RELWITHDEBINFO

config BR2_PACKAGE_PDM_INSTALL_HEADERS
	bool "Install development headers"
	default n
	help
	  Install development headers to $(STAGING_DIR)/usr/include/pdm/.
	  Only needed for packages that depend on PDM.

endif # BR2_PACKAGE_PDM

comment "PDM needs Linux kernel and a toolchain w/ threads, MMU"
	depends on !BR2_LINUX_KERNEL || !BR2_TOOLCHAIN_HAS_THREADS || \
		!BR2_USE_MMU
```

## docs/buildroot/packages/ems/Config.in
```kconfig
config BR2_PACKAGE_EMS
	bool "ems"
	depends on BR2_TOOLCHAIN_HAS_THREADS
	depends on !BR2_STATIC_LIBS
	help
	  EMS (Embedded Middleware System) is a lightweight embedded software
	  framework providing hardware abstraction and peripheral drivers.

	  Features:
	  - OSAL: Operating System Abstraction Layer
	  - HAL: Hardware Abstraction Layer (CAN, UART, I2C, SPI)
	  - PCL: Peripheral Configuration Library
	  - PDL: Peripheral Driver Layer
	  - PMC: Payload Management Controller (5-process application)

	  https://github.com/wanguo99/EMS

config BR2_PACKAGE_EMS_SAMPLE_APP
	bool "install sample application"
	depends on BR2_PACKAGE_EMS
	default y
	help
	  Install the EMS sample application to /usr/bin/sample_app

config BR2_PACKAGE_EMS_PMC
	bool "install PMC application"
	depends on BR2_PACKAGE_EMS
	default y
	help
	  Install PMC (Payload Management Controller) application.

	  PMC is a 5-process architecture application:
	  - pmc_comm: Communication process
	  - pmc_collector: Data collection process
	  - pmc_health: Health monitoring process
	  - pmc_supervisor: Process supervisor
	  - pmc_logger: Log management process

config BR2_PACKAGE_EMS_TESTS
	bool "install unit tests"
	depends on BR2_PACKAGE_EMS
	help
	  Build and install the EMS unit test suite to /usr/bin/ems-test

comment "ems needs a toolchain w/ threads, dynamic library"
	depends on !BR2_TOOLCHAIN_HAS_THREADS || BR2_STATIC_LIBS
```
