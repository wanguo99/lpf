## core/tm_cache/Kconfig
```kconfig
# TM_CACHE (Telemetry Cache) Configuration

menuconfig TM_CACHE
	bool "TM_CACHE (Telemetry Cache)"
	default n
	select OSAL
	help
	  Telemetry Cache provides runtime data caching for telemetry systems.

	  TM_CACHE is a runtime data management module that:
	  - Caches telemetry data for fast access (<50μs read time)
	  - Manages data freshness and validity
	  - Supports multi-process access (IPC via shared memory)
	  - Provides CRC32 checksums for data integrity

	  Architecture:
	  - Telemetry processes write data to cache (background updates)
	  - Telecommand processes read from cache (fast response <2ms)
	  - Cache tracks timestamps, freshness, and statistics

	  Use cases:
	  - Satellite telemetry systems requiring fast response
	  - Multi-process systems with shared telemetry data
	  - Systems with strict timing requirements

	  Memory footprint: ~300 bytes per cache entry

	  Dependencies: OSAL only (no hardware dependencies)

	  Recommended: Enable for systems requiring telemetry caching

	  If unsure, say N.

if TM_CACHE

menu "TM_CACHE Build Configuration"

config TM_CACHE_BUILD_STATIC
	bool "Build static library (.a)"
	default n
	help
	  Build TM_CACHE as a static library (libtm_cache.a).

	  Static linking advantages:
	  - No runtime dependencies
	  - Slightly faster

	  Recommended: Enable for embedded systems

config TM_CACHE_BUILD_SHARED
	bool "Build shared library (.so)"
	default n
	help
	  Build TM_CACHE as a shared library (libtm_cache.so).

	  Shared library advantages:
	  - Can update cache implementation without recompiling apps
	  - Smaller executable size
	  - Code sharing between processes

	  Recommended: Enable for multi-application systems

endmenu

menu "TM_CACHE Configuration"

config TM_CACHE_MAX_ENTRIES
	int "Maximum number of cache entries"
	default 256
	range 1 4096
	help
	  Maximum number of telemetry entries that can be cached.

	  Memory impact: ~300 bytes per entry
	  Total memory: TM_CACHE_MAX_ENTRIES × 300 bytes

	  Recommended values:
	  - Small systems: 64-128 entries (~20-40KB)
	  - Medium systems: 256 entries (~80KB)
	  - Large systems: 512-1024 entries (~160-320KB)

	  Note: Set this to the maximum number of telemetry points
	  your system will manage.

endmenu

endif # TM_CACHE
```

## core/user/aconfig/Config.in
```kconfig
# ACONFIG (Application Configuration Layer) Configuration

menuconfig ACONFIG
	bool "ACONFIG (Application Configuration Layer)"
	default n
	depends on OSAL
	help
	  Application Configuration Layer provides read-only access to
	  product-defined application configuration tables.

	  ACONFIG is the top layer of the ES-Middleware SDK stack, providing:
	  - Business function metadata containers
	  - Application-level mapping table access
	  - Separation between product configuration and core middleware logic
	  - Query-only configuration management

	  Architecture:
	  Products compile a concrete g_aconfig_table into the ACONFIG component
	  through ACONFIG_EXTRA_SRCS. Runtime code queries that table through
	  ACONFIG_GetTable(); it does not register, unregister, reload, or mutate
	  ACONFIG data through core APIs.

	  Memory footprint: small code footprint + product configuration tables

	  Use cases:
	  - Fixed application-level mapping tables
	  - Products that need a core-owned query API over product metadata
	  - Systems where configuration is generated or compiled at build time

	  Dependencies: OSAL

	  Note: Enable OSAL first in "Core Modules" menu.
	  ACONFIG provides configuration query only. Runtime data caching
	  (telemetry cache) belongs in a separate module.

	  Recommended: Enable for application-level development

	  If unsure, say Y.

if ACONFIG

menu "ACONFIG Build Configuration"

config ACONFIG_BUILD_STATIC
	bool "Build static library (.a)"
	default n
	help
	  Build ACONFIG as a static library (libaconfig.a).

	  Static linking advantages:
	  - No runtime dependencies
	  - Configuration tables embedded in executable
	  - Slightly faster

	  Recommended: Enable for embedded systems with fixed configurations

config ACONFIG_BUILD_SHARED
	bool "Build shared library (.so)"
	default n
	help
	  Build ACONFIG as a shared library (libaconfig.so).

	  Shared library advantages:
	  - Smaller executable size
	  - Code sharing between processes

	  Note: configuration data is still read-only from ACONFIG's public API.

	  Recommended: Enable for multi-application systems

endmenu

menu "ACONFIG Configuration"

config ACONFIG_MAX_DEVICES
	int "Maximum number of devices"
	default 64
	range 1 256
	help
	  Maximum number of devices described by the product ACONFIG table.

	  This value is available to product configuration sources that size
	  generated mapping tables.

	  Recommended values:
	  - RTOS Minimal: 8-16 devices
	  - Linux Minimal: 32 devices
	  - Linux Standard: 64 devices
	  - Linux Full: 128-256 devices

endmenu

endif # ACONFIG
```
