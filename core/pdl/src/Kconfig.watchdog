## core/pdl/src/Kconfig.watchdog
```kconfig
# PDL Watchdog 驱动配置

if PDL_WATCHDOG_SUPPORT

config PDL_WATCHDOG
	bool "Watchdog driver"
	default y
	help
	  Enable watchdog peripheral driver.
	  Source: src/pdl_watchdog.c

endif # PDL_WATCHDOG_SUPPORT
```

## core/pdl/src/pdl_bmc/Kconfig
```kconfig
# PDL BMC 驱动配置

if PDL_BMC_SUPPORT

menu "BMC Driver Configuration"

config PDL_BMC
	bool "BMC core driver"
	default y
	help
	  Enable BMC core driver functions.
	  Source: src/pdl_bmc/pdl_bmc.c

config PDL_BMC_IPMI
	bool "BMC IPMI protocol"
	default y
	help
	  Enable BMC IPMI protocol support.
	  Source: src/pdl_bmc/pdl_bmc_ipmi.c

config PDL_BMC_REDFISH
	bool "BMC Redfish protocol"
	default y
	help
	  Enable BMC Redfish protocol support.
	  Source: src/pdl_bmc/pdl_bmc_redfish.c

config PDL_BMC_TRANSPORT
	bool "BMC transport layer"
	default y
	help
	  Enable BMC transport layer (UART/Ethernet).
	  Source: src/pdl_bmc/pdl_bmc_transport.c

endmenu

endif # PDL_BMC_SUPPORT
```

## core/pdl/src/pdl_ccm/Config.in
```kconfig
# PDL_CCM (Communication Control Module) Configuration

if PDL_CCM_SUPPORT

config PDL_CCM_MAX_MSG_SIZE
	int "Maximum CCM message size (bytes)"
	default 4096
	range 256 65536
	help
	  Maximum size of a single CCM message payload.

	  This defines the buffer size for sending and receiving messages.
	  Larger values allow bigger messages but consume more memory.

	  Typical values:
	  - 1024: Small control messages
	  - 4096: Standard messages (default)
	  - 16384: Large data transfers

	  Memory impact: 2 * MAX_MSG_SIZE per CCM instance
	  (one buffer for TX, one for RX)

config PDL_CCM_DEFAULT_TIMEOUT_MS
	int "Default CCM timeout (milliseconds)"
	default 5000
	range 100 60000
	help
	  Default timeout for CCM send/receive operations.

	  This timeout applies to both TCP connect and data transfer.
	  Can be overridden per-instance via configuration.

	  Typical values:
	  - 1000: Fast local network
	  - 5000: Standard network (default)
	  - 10000: Slow or congested network

config PDL_CCM_AUTO_RECONNECT
	bool "Enable automatic reconnection"
	default y
	help
	  Automatically attempt to reconnect when connection is lost.

	  When enabled, CCM will periodically try to re-establish
	  connection to the PMC if the link goes down.

	  Reconnection interval: 5 seconds

	  Recommended: Enable for production systems

config PDL_CCM_DEBUG
	bool "Enable CCM debug logging"
	default n
	help
	  Enable verbose debug logging for CCM operations.

	  This logs all message send/receive operations, connection
	  state changes, and protocol details.

	  Warning: Generates significant log output

	  Recommended: Enable only for debugging

endif # PDL_CCM_SUPPORT
```

## core/pdl/src/pdl_mcu/Config.in
```kconfig
# PDL MCU 驱动配置

if PDL_MCU_SUPPORT

config PDL_MCU_CAN_SUPPORT
	bool "MCU peripheral via CAN"
	default y
	select HAL_CAN
	select OSAL_NETWORK
	help
	  Enable MCU peripheral support via CAN bus.

	  CAN-based MCU communication provides:
	  - Multi-drop network (multiple MCUs on one bus)
	  - Robust error detection (CRC, bit stuffing)
	  - Priority-based arbitration
	  - Up to 1 Mbps data rate

	  Memory footprint: ~6KB

	  Use cases:
	  - Automotive-style distributed control
	  - Industrial automation networks
	  - Systems with multiple MCU modules

	  Dependencies: HAL_CAN, OSAL_NETWORK

	  Recommended: Enable for CAN-based systems

config PDL_MCU_UART_SUPPORT
	bool "MCU peripheral via UART"
	default n
	select HAL_UART
	select OSAL_NETWORK
	help
	  Enable MCU peripheral support via UART.

	  UART-based MCU communication provides:
	  - Simple point-to-point connection
	  - Lower cost (no CAN transceiver needed)
	  - Flexible baud rates
	  - Easy debugging (can monitor with serial terminal)

	  Memory footprint: ~5KB

	  Use cases:
	  - Single MCU module systems
	  - Cost-sensitive designs
	  - Debug and development

	  Dependencies: HAL_UART, OSAL_NETWORK

	  Recommended: Enable for UART-based systems

menu "MCU Driver Configuration (Expert)"
	visible if EXPERT

config PDL_MCU
	bool "MCU core driver"
	default y if PDL_MCU_CAN_SUPPORT || PDL_MCU_UART_SUPPORT
	help
	  Enable MCU core driver functions.
	  Source: src/pdl_mcu/pdl_mcu.c

	  Automatically enabled when transport is selected.

config PDL_MCU_CAN
	bool "MCU CAN transport"
	default y if PDL_MCU_CAN_SUPPORT
	depends on HAL_CAN
	help
	  Enable MCU CAN bus transport.
	  Source: src/pdl_mcu/pdl_mcu_can.c

config PDL_MCU_SERIAL
	bool "MCU serial transport"
	default y if PDL_MCU_UART_SUPPORT
	depends on HAL_UART
	help
	  Enable MCU serial (UART) transport.
	  Source: src/pdl_mcu/pdl_mcu_serial.c

config PDL_MCU_PROTOCOL
	bool "MCU protocol handler"
	default y if PDL_MCU_CAN_SUPPORT || PDL_MCU_UART_SUPPORT
	help
	  Enable MCU communication protocol handler.
	  Source: src/pdl_mcu/pdl_mcu_protocol.c

endmenu

endif # PDL_MCU_SUPPORT
```

## core/pdl/src/pdl_mcu/Kconfig
```kconfig
# PDL MCU 驱动配置

if PDL_MCU_SUPPORT

menu "MCU Driver Configuration"

config PDL_MCU
	bool "MCU core driver"
	default n
	help
	  Enable MCU core driver functions.
	  Source: src/pdl_mcu/pdl_mcu.c

config PDL_MCU_CAN
	bool "MCU CAN transport"
	default n
	depends on HAL_CAN
	help
	  Enable MCU CAN bus transport.
	  Source: src/pdl_mcu/pdl_mcu_can.c

config PDL_MCU_SERIAL
	bool "MCU serial transport"
	default n
	depends on HAL_UART
	help
	  Enable MCU serial (UART) transport.
	  Source: src/pdl_mcu/pdl_mcu_serial.c

config PDL_MCU_PROTOCOL
	bool "MCU protocol handler"
	default n
	help
	  Enable MCU communication protocol handler.
	  Source: src/pdl_mcu/pdl_mcu_protocol.c

endmenu

endif # PDL_MCU_SUPPORT
```

## core/pdl/src/pdl_pmc/Config.in
```kconfig
# PDL_PMC (Communication Control Module) Configuration

if PDL_PMC_SUPPORT

config PDL_PMC_MAX_MSG_SIZE
	int "Maximum PMC message size (bytes)"
	default 4096
	range 256 65536
	help
	  Maximum size of a single PMC message payload.

	  This defines the buffer size for sending and receiving messages.
	  Larger values allow bigger messages but consume more memory.

	  Typical values:
	  - 1024: Small control messages
	  - 4096: Standard messages (default)
	  - 16384: Large data transfers

	  Memory impact: 2 * MAX_MSG_SIZE per PMC instance
	  (one buffer for TX, one for RX)

config PDL_PMC_DEFAULT_TIMEOUT_MS
	int "Default PMC timeout (milliseconds)"
	default 5000
	range 100 60000
	help
	  Default timeout for PMC send/receive operations.

	  This timeout applies to both TCP connect and data transfer.
	  Can be overridden per-instance via configuration.

	  Typical values:
	  - 1000: Fast local network
	  - 5000: Standard network (default)
	  - 10000: Slow or congested network

config PDL_PMC_AUTO_RECONNECT
	bool "Enable automatic reconnection"
	default y
	help
	  Automatically attempt to reconnect when connection is lost.

	  When enabled, PMC will periodically try to re-establish
	  connection to the PMC if the link goes down.

	  Reconnection interval: 5 seconds

	  Recommended: Enable for production systems

config PDL_PMC_DEBUG
	bool "Enable PMC debug logging"
	default n
	help
	  Enable verbose debug logging for PMC operations.

	  This logs all message send/receive operations, connection
	  state changes, and protocol details.

	  Warning: Generates significant log output

	  Recommended: Enable only for debugging

endif # PDL_PMC_SUPPORT
```

## core/pdl/src/pdl_satellite/Config.in
```kconfig
# PDL Satellite 驱动配置

if PDL_SATELLITE_SUPPORT

menu "Satellite Driver Configuration"

config PDL_SATELLITE
	bool "Satellite core driver"
	default n
	help
	  Enable satellite core driver functions.
	  Source: src/pdl_satellite/pdl_satellite.c

config PDL_SATELLITE_CAN
	bool "Satellite CAN transport"
	default n
	depends on HAL_CAN
	help
	  Enable satellite CAN bus transport.
	  Source: src/pdl_satellite/pdl_satellite_can.c

endmenu

endif # PDL_SATELLITE_SUPPORT
```

## core/pdl/src/pdl_satellite/Kconfig
```kconfig
# PDL Satellite 驱动配置

if PDL_SATELLITE_SUPPORT

menu "Satellite Driver Configuration"

config PDL_SATELLITE
	bool "Satellite core driver"
	default y
	help
	  Enable satellite core driver functions.
	  Source: src/pdl_satellite/pdl_satellite.c

config PDL_SATELLITE_CAN
	bool "Satellite CAN transport"
	default y
	depends on HAL_CAN
	help
	  Enable satellite CAN bus transport.
	  Source: src/pdl_satellite/pdl_satellite_can.c

endmenu

endif # PDL_SATELLITE_SUPPORT
```

## core/prl/Config.in
```kconfig
config PRL
    bool "Enable PRL (Protocol Layer)"
    default y
    depends on OSAL
    help
      Enable Protocol Layer for unified device communication.
      PRL provides protocol encoding/decoding for all internal devices:
      - MCU: Microcontroller
      - PMC: Communication Controller Management
      - PMC: Payload Management Controller
      - GSC: Ground Station Controller
      - POWER: Power Management Board

if PRL

config PRL_BUILD_SHARED
    bool "Build PRL as shared library"
    default y
    help
      Build PRL as a shared library (.so) instead of static library (.a).

menu "Device Protocol Selection"

config PRL_MCU
    bool "Enable MCU Device Protocol"
    default y
    help
      Enable protocol for Microcontroller (MCU) devices.
      Supports version query, status query, reset, power control, etc.

config PRL_PMC
    bool "Enable PMC Device Protocol"
    default y
    help
      Enable protocol for Communication Controller Management (PMC) devices.
      Supports telemetry, telecommand, time sync, orbit/attitude data, etc.

config PRL_PMC
    bool "Enable PMC Device Protocol"
    default y
    help
      Enable protocol for Payload Management Controller (PMC) devices.
      Supports telemetry, command, firmware update, node management, etc.

config PRL_GSC
    bool "Enable GSC Device Protocol"
    default y
    help
      Enable protocol for Ground Station Controller (GSC) devices.
      Supports telemetry, command, file transfer, database sync, etc.

config PRL_POWER
    bool "Enable POWER Device Protocol"
    default y
    help
      Enable protocol for Power Management Board (POWER) devices.
      Supports power on/off, voltage/current query, alarm, etc.

endmenu

menu "Protocol Features"

config PRL_CRC_CHECK
    bool "Enable CRC16 checksum"
    default y
    help
      Enable CRC16-CCITT checksum for all protocol packets.

config PRL_SEQUENCE_CHECK
    bool "Enable sequence number check"
    default y
    help
      Enable sequence number validation for packet ordering.

config PRL_TIMESTAMP_CHECK
    bool "Enable timestamp validation"
    default n
    help
      Enable timestamp validation for packet freshness.

config PRL_MAX_PAYLOAD_SIZE
    int "Maximum payload size (bytes)"
    default 4096
    range 256 65536
    help
      Maximum payload size for protocol packets.
      Larger values allow bigger messages but consume more memory.

endmenu

endif # PRL
```

## core/prl/Kconfig
```kconfig
config PRL
    bool "Enable PRL (Protocol Layer)"
    default y
    depends on OSAL
    help
      Enable Protocol Layer for inter-product communication.
      PRL provides protocol encoding/decoding for:
      - GSC-PMC: Ground Station <-> Payload Management Controller
      - PMC-CCM: Payload Management Controller <-> Communication Controller
      - CCM-Satellite: Communication Controller <-> Satellite Platform
      - CCM-Power: Communication Controller <-> Power Management Board

if PRL

config PRL_BUILD_SHARED
    bool "Build PRL as shared library"
    default y
    help
      Build PRL as a shared library (.so) instead of static library (.a).

menu "Protocol Selection"

config PRL_GSC_PMC
    bool "Enable GSC-PMC Protocol"
    default y
    help
      Enable protocol between Ground Station Controller and
      Payload Management Controller.
      Transport: 10GbE Ethernet

config PRL_PMC_CCM
    bool "Enable PMC-CCM Protocol"
    default y
    help
      Enable protocol between Payload Management Controller and
      Communication Controller Management.
      Transport: 1GbE Ethernet

config PRL_CCM_SATELLITE
    bool "Enable CCM-Satellite Protocol"
    default y
    help
      Enable protocol between Communication Controller Management
      and Satellite Platform.
      Transport: CAN Bus + OC Commands

config PRL_CCM_POWER
    bool "Enable CCM-Power Protocol"
    default y
    help
      Enable protocol between Communication Controller Management
      and Power Management Board.
      Transport: CAN Bus

endmenu

menu "Protocol Features"

config PRL_CRC_CHECK
    bool "Enable CRC16 checksum"
    default y
    help
      Enable CRC16-CCITT checksum for all protocol packets.

config PRL_SEQUENCE_CHECK
    bool "Enable sequence number check"
    default y
    help
      Enable sequence number validation for packet ordering.

config PRL_TIMESTAMP_CHECK
    bool "Enable timestamp validation"
    default n
    help
      Enable timestamp validation for packet freshness.

config PRL_MAX_PAYLOAD_SIZE
    int "Maximum payload size (bytes)"
    default 4096
    range 256 65536
    help
      Maximum payload size for protocol packets.
      Larger values allow bigger messages but consume more memory.

endmenu

endif # PRL
```

## core/test/Config.in
```kconfig
# Test Framework Configuration

menuconfig TEST_FRAMEWORK
	bool "Test Framework"
	default n
	select OSAL
	help
	  Comprehensive test framework for ES-Middleware.
	  Provides test registration, assertions, mocking, and reporting.

	  This is a core testing infrastructure that can be used by
	  all products (CCM, etc.) for writing various types of tests:
	  - Unit tests
	  - Integration tests
	  - Performance tests
	  - Stress tests
	  - System tests

	  Features:
	  - Test discovery and registration
	  - Rich assertion macros
	  - Mock functions support
	  - Performance measurement
	  - Stress testing utilities
	  - Parameterized tests
	  - Test metadata and filtering

	  Required for CONFIG_BUILD_TESTING=y.

	  If unsure, say Y when building tests.

if TEST_FRAMEWORK

config TEST_FRAMEWORK_VERBOSE
	bool "Verbose test output"
	default n
	help
	  Enable detailed test execution output.
	  Shows test setup/teardown and timing information.

config TEST_FRAMEWORK_COLOR
	bool "Colorized test output"
	default y
	help
	  Enable colored terminal output for test results.
	  Makes PASS/FAIL results easier to read.

config TEST_FRAMEWORK_MAX_TESTS
	int "Maximum number of tests"
	default 1024
	range 64 4096
	help
	  Maximum number of test cases that can be registered.
	  Increase this if you have many test cases.

config TEST_FRAMEWORK_MAX_NAME_LEN
	int "Maximum test name length"
	default 128
	range 32 256
	help
	  Maximum length of test case names.

endif # TEST_FRAMEWORK
```
