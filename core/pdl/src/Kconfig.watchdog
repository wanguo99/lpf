## docs/devicetree/bindings/lpf/linux-peripheral-framework.yaml
```yaml
# SPDX-License-Identifier: GPL-2.0
%YAML 1.2
---
$id: http://lpf.local/schemas/lpf/linux-peripheral-framework.yaml#
$schema: http://devicetree.org/meta-schemas/core.yaml#

title: Linux Peripheral Framework Runtime Configuration

maintainers:
  - LPF maintainers

description: |
  LPF runtime configuration describes product, project, and peripheral instance
  data consumed by the integrated runtime in lpf_core.ko. The Device Tree backend converts
  the nodes below into the same normalized lpf_config model used by the static
  backend.

properties:
  compatible:
    oneOf:
      - const: lpf,linux-peripheral-framework
      - const: linux-peripheral-framework
        deprecated: true
      - const: lpf,platform-config
        deprecated: true

  platform-name:
    $ref: /schemas/types.yaml#/definitions/string
    description: Platform family name.

  chip-name:
    $ref: /schemas/types.yaml#/definitions/string
    description: SoC or chip name.

  project-name:
    $ref: /schemas/types.yaml#/definitions/string
    description: Product project line.

  product-name:
    $ref: /schemas/types.yaml#/definitions/string
    description: Product identifier.

  config-version:
    $ref: /schemas/types.yaml#/definitions/string
    description: Configuration schema/content version used by the product.

  mcu:
    type: object
    additionalProperties: false
    description: MCU peripheral instances.
    patternProperties:
      "^[a-zA-Z0-9][a-zA-Z0-9,_-]*$":
        $ref: "#/$defs/mcu-node"

  led:
    type: object
    additionalProperties: false
    description: LED peripheral instances.
    patternProperties:
      "^[a-zA-Z0-9][a-zA-Z0-9,_-]*$":
        $ref: "#/$defs/led-node"

required:
  - compatible
  - platform-name
  - chip-name
  - project-name
  - product-name
  - config-version

additionalProperties: false

$defs:
  mcu-node:
    type: object
    additionalProperties: false
    properties:
      label:
        $ref: /schemas/types.yaml#/definitions/string
        description: Stable LPF device name such as mcu0.

      interface:
        enum:
          - can
          - serial
        default: can

      device:
        $ref: /schemas/types.yaml#/definitions/string
        description: CAN interface name or UART device identifier.

      bitrate:
        $ref: /schemas/types.yaml#/definitions/uint32
        default: 500000

      rx-timeout-ms:
        $ref: /schemas/types.yaml#/definitions/uint32
        default: 1000

      tx-timeout-ms:
        $ref: /schemas/types.yaml#/definitions/uint32
        default: 1000

      tx-id:
        $ref: /schemas/types.yaml#/definitions/uint32
        default: 0

      rx-id:
        $ref: /schemas/types.yaml#/definitions/uint32
        default: 0

      baudrate:
        $ref: /schemas/types.yaml#/definitions/uint32
        default: 115200

      data-bits:
        $ref: /schemas/types.yaml#/definitions/uint32
        minimum: 5
        maximum: 8
        default: 8

      stop-bits:
        $ref: /schemas/types.yaml#/definitions/uint32
        minimum: 1
        maximum: 2
        default: 1

      parity:
        enum:
          - none
          - odd
          - even
        default: none

      flow-control:
        enum:
          - none
          - hw
          - sw
        default: none

      cmd-timeout-ms:
        $ref: /schemas/types.yaml#/definitions/uint32
        default: 1000

      retry-count:
        $ref: /schemas/types.yaml#/definitions/uint32
        default: 3

    required:
      - label
      - interface
      - device

  led-node:
    type: object
    additionalProperties: false
    properties:
      label:
        $ref: /schemas/types.yaml#/definitions/string
        description: Stable LPF device name such as led0 or status.

      control:
        enum:
          - gpio
          - pwm
        default: gpio

      max-brightness:
        $ref: /schemas/types.yaml#/definitions/uint32
        default: 255

      default-brightness:
        $ref: /schemas/types.yaml#/definitions/uint32
        default: 0

      gpio:
        $ref: /schemas/types.yaml#/definitions/uint32
        description: LPF GPIO number for gpio-controlled LEDs.

      pin-mux:
        $ref: /schemas/types.yaml#/definitions/uint32
        default: 0

      active-low:
        type: boolean

      pull-up:
        type: boolean

      pull-down:
        type: boolean

      consumer:
        $ref: /schemas/types.yaml#/definitions/string
        description: PWM consumer name for pwm-controlled LEDs.

      period-ns:
        $ref: /schemas/types.yaml#/definitions/uint32
        description: PWM period in nanoseconds.

      polarity-inversed:
        type: boolean

    required:
      - label
      - control
      - max-brightness

examples:
  - |
    lpf {
        compatible = "lpf,linux-peripheral-framework";
        platform-name = "linux";
        chip-name = "am6254";
        project-name = "h200";
        product-name = "gateway";
        config-version = "1.0.0";

        mcu {
            mcu0 {
                label = "mcu0";
                interface = "can";
                device = "can0";
                bitrate = <500000>;
                rx-timeout-ms = <1000>;
                tx-timeout-ms = <1000>;
                tx-id = <0x100>;
                rx-id = <0x101>;
                cmd-timeout-ms = <1000>;
                retry-count = <3>;
            };

            mcu1 {
                label = "mcu1";
                interface = "serial";
                device = "ttyS1";
                baudrate = <115200>;
                data-bits = <8>;
                stop-bits = <1>;
                parity = "none";
                flow-control = "none";
            };
        };

        led {
            status {
                label = "status";
                control = "gpio";
                gpio = <42>;
                active-low;
                max-brightness = <1>;
                default-brightness = <0>;
            };

            panel {
                label = "panel";
                control = "pwm";
                consumer = "backlight";
                period-ns = <1000000>;
                max-brightness = <255>;
                default-brightness = <32>;
            };
        };
    };
...
```

## kernel/hal/Config.in
```kconfig
# Transitional HAL capability configuration.
#
# These symbols now select hardware capability objects that are linked into
# lpf_peripheral_runtime.ko. The standalone HAL module boundary has been
# removed; the hal_* API names are transitional until they are migrated to
# LPF HW APIs.

# =============================================================================
# Platform Configuration
# =============================================================================

menu "Platform Configuration"

config PLATFORM_LINUX
	bool "Linux platform"
	default n
	depends on OS_LINUX
	help
	  Enable Linux hardware access support.

	  Uses Linux kernel interfaces:
	  - SocketCAN kernel sockets for CAN bus
	  - TTY, GPIO, I2C, and SPI kernel subsystems

	  Suitable for: Any Linux system with standard kernel drivers
	  Examples: AM625, i.MX6/8, Raspberry Pi, x86 Linux

	  Memory: ~10KB driver code

	  Note: Requires appropriate kernel drivers and in-kernel bus support.

endmenu

# =============================================================================
# Driver Configuration (Fine-grained per-driver control)
# =============================================================================

menu "Driver Configuration"

menuconfig HAL_CAN
	bool "CAN bus support"
	default n
	depends on LPF_PERIPHERAL_RUNTIME
	help
	  Enable CAN (Controller Area Network) bus driver.

	  CAN is a robust vehicle bus standard designed for microcontrollers
	  and devices to communicate without a host computer.

	  Features:
	  - Send/receive CAN frames (standard and extended ID)
	  - Configure bit rate and timing
	  - Hardware filtering support
	  - Error handling and bus-off recovery

	  Memory footprint: ~8KB

	  Use cases:
	  - Automotive communication
	  - Industrial automation
	  - Embedded platform communication over CAN

	  Platform support: Linux kernel SocketCAN interface

menuconfig HAL_UART
	bool "UART support"
	default n
	depends on LPF_PERIPHERAL_RUNTIME
	help
	  Enable UART/serial port driver.

	  UART (Universal Asynchronous Receiver-Transmitter) provides
	  serial communication for RS-232, RS-485, and TTL interfaces.

	  Features:
	  - Configurable baud rate (9600 - 921600+)
	  - Data bits, stop bits, parity control
	  - Hardware/software flow control
	  - Non-blocking I/O

	  Memory footprint: ~6KB

	  Use cases:
	  - Debug console
	  - GPS receivers
	  - Sensor communication
	  - Modem control

	  Platform support: Linux kernel TTY subsystem and character device I/O

menuconfig HAL_I2C
	bool "I2C support"
	default n
	depends on LPF_PERIPHERAL_RUNTIME
	help
	  Enable I2C (Inter-Integrated Circuit) bus driver.

	  I2C is a multi-master, multi-slave serial communication bus
	  for connecting low-speed peripherals.

	  Features:
	  - Master mode operation
	  - 7-bit and 10-bit addressing
	  - Standard (100kHz) and Fast (400kHz) modes
	  - Read/write transactions

	  Memory footprint: ~5KB

	  Use cases:
	  - Temperature sensors
	  - EEPROMs
	  - Real-time clocks (RTC)
	  - ADC/DAC converters

	  Platform support: Linux kernel I2C adapter transfer API

menuconfig HAL_SPI
	bool "SPI support"
	default n
	depends on LPF_PERIPHERAL_RUNTIME
	help
	  Enable SPI (Serial Peripheral Interface) bus driver.

	  SPI is a synchronous serial communication interface for
	  high-speed short-distance communication.

	  Features:
	  - Master mode operation
	  - Configurable clock polarity and phase
	  - Multiple chip select support
	  - Full-duplex communication

	  Memory footprint: ~5KB

	  Use cases:
	  - Flash memory (NOR/NAND)
	  - SD cards
	  - Display controllers
	  - High-speed ADCs

	  Platform support: Linux kernel SPI device transfer API

menuconfig HAL_GPIO
	bool "GPIO support"
	default n
	depends on LPF_PERIPHERAL_RUNTIME
	help
	  Enable GPIO (General Purpose I/O) driver.

	  GPIO provides digital input/output control for pins.

	  Features:
	  - Input/output direction control
	  - Read/write pin state
	  - Pull-up/pull-down configuration
	  - Interrupt support (edge/level triggered)

	  Memory footprint: ~4KB

	  Use cases:
	  - LED control
	  - Button input
	  - Chip select signals
	  - Hardware reset control

	  Platform support: Linux kernel GPIO and IRQ APIs

menuconfig HAL_PWM
	bool "PWM support"
	default n
	depends on LPF_PERIPHERAL_RUNTIME
	help
	  Enable PWM (Pulse Width Modulation) driver.

	  PWM provides duty-cycle based output control for LEDs, buzzers,
	  backlights, and other simple actuators.

	  Features:
	  - Configure period and duty cycle
	  - Enable/disable output
	  - Normal and inversed polarity

	  Platform support: Linux kernel PWM consumer API

endmenu

menu "Self Test Configuration"

config HAL_MOCK_SELFTEST
	bool "Build HAL mock backend self-test module"
	depends on LPF_SOC_ADAPTER_MOCK && LPF_PERIPHERAL_RUNTIME
	select HAL_CAN
	select HAL_UART
	select HAL_I2C
	select HAL_SPI
	select HAL_GPIO
	select HAL_PWM
	help
	  Build hal_mock_selftest.ko. Loading this module runs HAL GPIO,
	  PWM, CAN, serial, I2C, and SPI operation checks through the mock
	  SoC adapter. It is intended for development and CI configurations
	  that need no live hardware.

endmenu
```

## kernel/lpf-configs/Config.in
```kconfig
# LPF Static Config Module Configuration

config LPF_CONFIGS
	tristate "Build selected LPF static config module"
	default m
	depends on LPF_CORE
	depends on m
	help
	  Build lpf_configs.ko from the static platform configuration selected
	  below. This is the C-config equivalent of providing a product DTS:
	  only the selected product configuration is compiled into the module.

choice
	prompt "Selected LPF static config"
	default LPF_CONFIG_UBUNTU_X86_MOCK_MODULES if LPF_SOC_ADAPTER_MOCK
	default LPF_CONFIG_IMX6ULL_MODULES if ARCH_ARM32
	default LPF_CONFIG_UBUNTU_X86_MODULES
	depends on LPF_CONFIGS
	help
	  Select the single static platform configuration compiled into
	  lpf_configs.ko.

config LPF_CONFIG_IMX6ULL_MODULES
	bool "imx6ull/modules v1"

config LPF_CONFIG_UBUNTU_X86_MODULES
	bool "ubuntu/x86_modules v1"

config LPF_CONFIG_UBUNTU_X86_MOCK_MODULES
	bool "ubuntu/x86_mock_modules v1"

endchoice
```

## kernel/lpf-runtime/Config.in
```kconfig
# LPF Runtime Configuration

menuconfig LPF_RUNTIME
	bool "LPF integrated peripheral runtime"
	default y
	depends on LPF_CORE
	help
	  Link the integrated LPF runtime into lpf_core.ko. This runtime hosts
	  the reusable LPF peripheral services selected below and the runtime
	  configuration backend used to create LPF devices. It keeps framework
	  services in one core/driver module instead of splitting one kernel
	  module per peripheral. Static platform configuration can be provided
	  by the separate lpf_configs.ko module or by Device Tree.

	  If unsure, say Y when enabling LPF peripheral services.

if LPF_RUNTIME

config LPF_CONFIGS
	tristate "Build selected LPF static config module"
	default m
	depends on m
	help
	  Build lpf_configs.ko from the static platform configuration selected
	  below. This is the C-config equivalent of providing a product DTS:
	  only the selected product configuration is compiled into the module.

choice
	prompt "Selected LPF static config"
	default LPF_CONFIG_KERNEL_X86_MOCK_MODULES if LPF_SOC_ADAPTER_MOCK
	default LPF_CONFIG_KERNEL_X86_MODULES
	depends on LPF_CONFIGS
	help
	  Select the single static platform configuration compiled into
	  lpf_configs.ko.

config LPF_CONFIG_KERNEL_X86_MODULES
	bool "kernel/x86_modules v1"

config LPF_CONFIG_KERNEL_X86_MOCK_MODULES
	bool "kernel/x86_mock_modules v1"

endchoice

source "kernel/lpf-runtime/hw/Config.in"

menuconfig LPF_MCU_SERVICE
	bool "LPF MCU peripheral service"
	default n
	depends on LPF_RUNTIME
	select LPF_PROTOCOL
	select LPF_PROTOCOL_MCU
	select LPF_HW_CAN
	select LPF_HW_UART
	help
	  Enable the LPF MCU peripheral service. MCU instances are created from
	  normalized LPF_CONFIG entries and exposed through LPF device lifecycle,
	  /dev/lpf/mcuN, sysfs attributes, and debugfs commands.

source "kernel/lpf-runtime/peripheral/mcu/Config.in"

menuconfig LPF_LED_SERVICE
	bool "LPF LED peripheral service"
	default n
	depends on LPF_RUNTIME
	select LPF_HW_GPIO
	select LPF_HW_PWM
	help
	  Enable the LPF LED peripheral service. LED instances are created from
	  normalized LPF_CONFIG entries and exposed through LPF device lifecycle,
	  /dev/lpf/ledN, sysfs attributes, and debugfs commands.

source "kernel/lpf-runtime/peripheral/led/Config.in"

menu "LPF Runtime Test Configuration"

config LPF_CONFIG_OF_SELFTEST
	bool "Build LPF Device Tree config runtime self-test"
	default n
	depends on LPF_SOC_ADAPTER_MOCK
	help
	  Link the LPF Device Tree config self-test into
	  lpf_core.ko. The test contributes an entry to the LPF
	  runtime entry section and validates the LPF Device Tree
	  parser through Linux OF accessors on kernels with CONFIG_OF and
	  CONFIG_OF_DYNAMIC enabled. Kernels without live OF support skip the
	  runtime overlay check, so the same mock defconfig can be used in a
	  broader kernel matrix.

endmenu

endif # LPF_RUNTIME

menu "LPF Core Test Configuration"

config LPF_DUMMY_SERVICE_SELFTEST
	tristate "Build LPF dummy service self-test module"
	default n
	depends on LPF_CORE && LPF_SOC_ADAPTER_MOCK
	depends on m
	help
	  Build lpf_dummy_service_selftest.ko. Loading this module registers
	  a temporary dummy LPF driver and device to validate LPF Core
	  lifecycle, discovery, capability lookup, state/error transitions,
	  event delivery, and removal cleanup without requiring live hardware.

endmenu
```
