## kernel/pdm-core/peripheral/mcu/Config.in
```kconfig
# LPF MCU service configuration

if LPF_MCU_SERVICE

config LPF_MCU_MAX_DEVICES
	int "Maximum number of MCU devices"
	default 4
	range 1 16
	help
	  Maximum number of MCU devices that can be managed simultaneously.
	  Each device requires approximately 200 bytes of RAM.

config LPF_MCU_TRANSPORT_CAN
	bool "LPF MCU CAN transport"
	default y
	depends on LPF_HW_CAN
	help
	  Enable the CAN-backed transport implementation used by the LPF MCU
	  service for LPF_CONFIG_MCU_INTERFACE_CAN entries.

config LPF_MCU_TRANSPORT_UART
	bool "LPF MCU UART transport"
	default y
	depends on LPF_HW_UART
	help
	  Enable the UART-backed transport implementation used by the LPF MCU
	  service for LPF_CONFIG_MCU_INTERFACE_SERIAL entries.

endif # LPF_MCU_SERVICE
```

## kernel/pdm/Config.in
```kconfig
# PDM Module Configuration

menuconfig PDM
	tristate "PDM kernel device model"
	default m
	depends on m
	help
	  PDM provides a Linux bus_type implementation for PDM devices.
	  Device configuration uses Device Tree exclusively.

	  If unsure, say Y when enabling PDM peripheral services.

if PDM


menu "PDM logging"

config PDM_LOGGING_ENABLE
	bool "Enable PDM kernel logging"
	default y
	help
	  Enable LOG_* output inside pdm.ko. When disabled, PDM logging calls
	  are compiled out of the module.

if PDM_LOGGING_ENABLE

choice
	prompt "PDM kernel log level"
	default PDM_LOG_LEVEL_INFO if BUILD_TYPE_DEBUG
	default PDM_LOG_LEVEL_WARN if BUILD_TYPE_RELEASE
	default PDM_LOG_LEVEL_INFO
	help
	  Select the minimum PDM log priority compiled into pdm.ko.

config PDM_LOG_LEVEL_FATAL
	bool "FATAL - fatal errors only"

config PDM_LOG_LEVEL_ERROR
	bool "ERROR - errors and above"

config PDM_LOG_LEVEL_WARN
	bool "WARN - warnings and above"

config PDM_LOG_LEVEL_INFO
	bool "INFO - informational and above"

config PDM_LOG_LEVEL_DEBUG
	bool "DEBUG - debug and above"

endchoice

endif # PDM_LOGGING_ENABLE

endmenu

menu "Target kernel feature availability"

config PDM_TARGET_HAS_CAN_RAW
	bool "Target kernel provides CAN RAW sockets"
	default y
	help
	  Enable this when the target kernel has PF_CAN RAW socket support.
	  Disable it for kernels built without CONFIG_CAN_RAW so CAN backends
	  cannot be selected accidentally.

config PDM_TARGET_HAS_SERIAL_DEV_BUS
	bool "Target kernel provides UART serdev"
	default y
	help
	  Enable this when the target kernel has CONFIG_SERIAL_DEV_BUS.

config PDM_TARGET_HAS_I2C
	bool "Target kernel provides I2C client support"
	default y
	help
	  Enable this when the target kernel has CONFIG_I2C.

config PDM_TARGET_HAS_SPI
	bool "Target kernel provides SPI client support"
	default y
	help
	  Enable this when the target kernel has CONFIG_SPI.

config PDM_TARGET_HAS_GPIOLIB
	bool "Target kernel provides gpiolib"
	default y
	help
	  Enable this when the target kernel has CONFIG_GPIOLIB.

config PDM_TARGET_HAS_PWM
	bool "Target kernel provides PWM support"
	default y
	help
	  Enable this when the target kernel has CONFIG_PWM.

endmenu

config PDM_MANAGER_DEVNODE_MODE
	string "PDM manager device node mode"
	default "0660"
	help
	  Octal permission mode applied to /dev/pdm_manager. Production
	  builds should use group ownership through udev, devtmpfs policy,
	  or the product init system instead of world-writable access.

config PDM_INSTANCE_DEVNODE_MODE
	string "PDM instance device node mode"
	default "0660"
	help
	  Octal permission mode applied to per-instance PDM character device nodes
	  under /dev/pdm/, such as /dev/pdm/mcu0 and /dev/pdm/led0.

	  Product builds should keep this conservative and assign device group
	  ownership with udev, devtmpfs policy, or the product init system.
	  Development-only builds that intentionally need broad local access can
	  override this to "0666".

config PDM_DIAG_CONTROL
	bool "Writable PDM proc/debugfs diagnostic controls"
	default n
	help
	  Build writable /proc/pdm and debugfs control files for MCU/LED
	  diagnostics. This is intended for development and factory bring-up.
	  Product builds should leave it disabled and rely on /dev/pdm_manager
	  plus read-only sysfs attributes for diagnostics.

config PDM_MOCK_DEVICES
	bool "Synthetic PDM devices for module smoke tests"
	default n
	help
	  Create in-kernel mock PDM MCU and LED devices when pdm.ko loads.
	  This is intended for x86 smoke tests that do not have Device Tree
	  PDM child nodes. Product builds should leave this disabled.

config PDM_MCU_CAN
	bool "PDM MCU CAN RAW transport"
	default y
	depends on PDM_TARGET_HAS_CAN_RAW
	help
	  Enable the CAN RAW transport backend for MCU devices bound to a CAN
	  controller through a Device Tree phandle. Enable this only when the
	  target kernel provides CONFIG_CAN_RAW.

config PDM_MCU_UART_SERDEV
	bool "PDM MCU UART serdev transport"
	default y
	depends on PDM_TARGET_HAS_SERIAL_DEV_BUS
	help
	  Register a serdev client driver for MCU devices described below a UART
	  controller node. Enable this only when the target kernel provides
	  CONFIG_SERIAL_DEV_BUS. UART path-based fallback is not supported.

config PDM_MCU_I2C
	bool "PDM MCU I2C transport"
	default y
	depends on PDM_TARGET_HAS_I2C
	help
	  Register an I2C client driver for MCU devices described below an I2C
	  controller node. Enable this only when the target kernel provides
	  CONFIG_I2C.

config PDM_MCU_SPI
	bool "PDM MCU SPI transport"
	default y
	depends on PDM_TARGET_HAS_SPI
	help
	  Register an SPI client driver for MCU devices described below an SPI
	  controller node. Enable this only when the target kernel provides
	  CONFIG_SPI.

config PDM_LED_GPIO
	bool "PDM LED GPIO backend"
	default y
	depends on PDM_TARGET_HAS_GPIOLIB
	help
	  Enable the GPIO control backend for LED devices described under the
	  PDM bus controller with compatible "pdm,led-gpio". Enable this only
	  when the target kernel provides CONFIG_GPIOLIB.

config PDM_LED_PWM
	bool "PDM LED PWM backend"
	default y
	depends on PDM_TARGET_HAS_PWM
	help
	  Enable the PWM control backend for LED devices described under the
	  PDM bus controller with compatible "pdm,led-pwm". Enable this only
	  when the target kernel provides CONFIG_PWM.

endif # PDM
```

## kernel/pdm/src/led/Config.in
```kconfig
if PDM_LED_SUPPORT

config PDM_LED_MAX_DEVICES
	int "Maximum LED devices"
	default 8
	range 1 256
	help
	  Maximum number of configured LED devices managed by pdm.ko.

endif # PDM_LED_SUPPORT
```

## kernel/pdm/src/mcu/Config.in
```kconfig
# PDM MCU 驱动配置

if PDM_MCU_SUPPORT

menu "MCU Driver Configuration"

config PDM_MCU_MAX_DEVICES
	int "Maximum number of MCU devices"
	default 4
	range 1 16
	help
	  Maximum number of MCU devices that can be managed simultaneously.
	  Each device requires approximately 200 bytes of RAM.

endmenu

endif # PDM_MCU_SUPPORT
```

## products/Config.in
```kconfig
# ============================================================================
# Products Configuration
# ============================================================================
# This file organizes all product configurations in a hierarchical menu
# structure, similar to Linux kernel's drivers/ subsystem.
# ============================================================================

menu "Products"

# Source individual product Config.in files
# Each product defines its own menuconfig entry for a collapsible submenu

source "products/pmc/Config.in"
# source "products/samples/Config.in"  # Not yet implemented

endmenu
```

## products/ccm/Config.in
```kconfig
# ============================================================================
# CCM Product Configuration
# ============================================================================
# CCM (Central Control Module) is a satellite payload control and data
# management system designed for H200 platform with AM625 SoC.
# ============================================================================

menu "CCM Product"

# ============================================================================
# Platform Configuration
# ============================================================================

menu "Platform Configuration"

choice
    prompt "Select Platform"
    default PROJECT_H200_100P_AM625
    help
      Select the hardware platform for CCM product.

config PROJECT_H200_100P_AM625
    bool "H200 100P AM625 Platform"
    help
      TI AM625 SoC based H200 100P carrier board.
      Provides ACONFIG and PCONFIG configuration for AM625 platform.

config PROJECT_H200_200P
    bool "H200 200P Platform"
    help
      H200 200P platform configuration.

endchoice

# Note: PROJECT_NAME is defined globally in the root Config.in
# It automatically derives the correct value based on the platform choice above.

endmenu

# ============================================================================
# Product Components
# ============================================================================

menu "Product Libraries"

source "products/ccm/libs/libccm/Config.in"

endmenu

# ============================================================================
# Applications
# ============================================================================

menu "Applications"

source "products/ccm/apps/app_collector/Config.in"
source "products/ccm/apps/app_comm/Config.in"
source "products/ccm/apps/app_health/Config.in"
source "products/ccm/apps/app_logger/Config.in"
source "products/ccm/apps/app_supervisor/Config.in"

# Test Application (Debug/Verification)
source "products/ccm/apps/test_call_chain/Config.in"

endmenu

endmenu
```

## products/ccm/Kconfig
```kconfig
# ============================================================================
# CCM Product Configuration
# ============================================================================
# CCM (Central Control Module) is a satellite payload control and data
# management system designed for H200 platform with AM625 SoC.
# ============================================================================

menu "CCM Product"

# ============================================================================
# Platform Configuration
# ============================================================================

menu "Platform Configuration"

choice
    prompt "Select Platform"
    default PROJECT_H200_100P_AM625
    help
      Select the hardware platform for CCM product.

config PROJECT_H200_100P_AM625
    bool "H200 100P AM625 Platform"
    help
      TI AM625 SoC based H200 100P carrier board.
      Provides ACL and PCL configuration for AM625 platform.

config PROJECT_H200_200P
    bool "H200 200P Platform"
    help
      H200 200P platform configuration.

endchoice

config PROJECT_NAME
    string
    default "h200_100p_am625" if PROJECT_H200_100P_AM625
    default "h200_200p" if PROJECT_H200_200P
    help
      Project configuration directory name.
      Used by CMake to locate platform config files.

endmenu

# ============================================================================
# Product Components
# ============================================================================

menu "Product Libraries"

source "products/ccm/libs/libccm/Kconfig"

endmenu

# ============================================================================
# Applications
# ============================================================================

menu "Applications"

source "products/ccm/apps/app_collector/Kconfig"
source "products/ccm/apps/app_comm/Kconfig"
source "products/ccm/apps/app_health/Kconfig"
source "products/ccm/apps/app_logger/Kconfig"
source "products/ccm/apps/app_supervisor/Kconfig"

endmenu

endmenu
```

## products/ccm/apps/app_collector/Kconfig
```kconfig
config APP_COLLECTOR
    bool "Enable CCM Collector Application"
    default n
    select OSAL
    select HAL
    select PCL
    select PDL
    select ACL
    select H200_AM625
    select LIBCCM
    help
      CCM data collector application.
      Collects telemetry data from satellite platform and stores to local storage.
```

## products/ccm/apps/app_comm/Kconfig
```kconfig
config APP_COMM
    bool "Enable CCM Communication Application"
    default n
    select OSAL
    select HAL
    select PCL
    select PDL
    select ACL
    select H200_AM625
    select LIBCCM
    help
      CCM communication application.
      Handles communication between satellite platform and ground station.
```

## products/ccm/apps/app_health/Config.in
```kconfig
config APP_HEALTH
    bool "Enable CCM Health Monitor Application"
    default n
    select OSAL
    select HAL
    select PCL
    select PDL
    select ACL
    select H200_AM625
    select LIBCCM
    help
      CCM health monitoring application.
      Monitors system health and reports status.
```

## products/ccm/apps/app_logger/Config.in
```kconfig
config APP_LOGGER
    bool "Enable CCM Logger Application"
    default n
    select OSAL
    select HAL
    select PCL
    select PDL
    select ACL
    select H200_AM625
    select LIBCCM
    help
      CCM logging application.
      Manages system logs and diagnostic data.
```

## products/ccm/apps/app_supervisor/Config.in
```kconfig
config APP_SUPERVISOR
    bool "Enable CCM Supervisor Application"
    default n
    select OSAL
    select HAL
    select PCL
    select PDL
    select ACL
    select H200_AM625
    select LIBCCM
    help
      CCM supervisor application.
      Supervises and manages other CCM applications.
```

## products/ccm/apps/app_test/Config.in
```kconfig
config APP_TEST
	bool "Test Call Chain Application"
	default n
	depends on OSAL && HAL && PDL && PCONFIG && ACONFIG
	help
	  Complete call chain test application.

	  This application tests the complete call chain from APP layer
	  through ACONFIG, PDL, PCONFIG to HAL layer.

	  Test functions:
	    - APP_TestCallChain_MCU_CAN() - Test MCU CAN interface
	    - APP_TestCallChain_MCU_Serial() - Test MCU Serial interface
	    - APP_TestCallChain_BMC() - Test BMC interface
	    - APP_RunAllTests() - Run all tests

	  This is a debug/verification tool and should not be included
	  in production builds.
```

## products/ccm/apps/test_call_chain/Config.in
```kconfig
config TEST_CALL_CHAIN
	bool "Test Call Chain Application"
	default n
	depends on OSAL && HAL && PDL && PCONFIG && ACONFIG
	help
	  Complete call chain test application.

	  This application tests the complete call chain from APP layer
	  through ACONFIG, PDL, PCONFIG to HAL layer.

	  Test functions:
	    - TestCallChain_MCU_CAN() - Test MCU CAN interface
	    - TestCallChain_MCU_Serial() - Test MCU Serial interface
	    - TestCallChain_BMC() - Test BMC interface
	    - TestCallChain_RunAll() - Run all tests

	  This is a debug/verification tool and should not be included
	  in production builds.
```

## products/ccm/components/h200_am625/Kconfig
```kconfig
config H200_AM625
    bool "Enable H200 AM625 Platform Support"
    default y
    select OSAL
    select HAL
    select PCL
    select PDL
    select ACL
    help
      Platform-specific support for H200 AM625 carrier board.
      Provides ACL and PCL configurations for TI AM625 SoC.

config H200_AM625_BUILD_SHARED
    bool "Build h200_am625 as shared library"
    depends on H200_AM625
    default n
    help
      Build h200_am625 as a shared library (.so) instead of static library (.a).
```

## products/ccm/components/libccm/Kconfig
```kconfig
config LIBCCM
    bool "Enable libccm (CCM Product Library)"
    default y
    select OSAL
    help
      CCM product library providing IPC and protocol support.
      This is a product-specific component for CCM applications.

config LIBCCM_BUILD_SHARED
    bool "Build libccm as shared library"
    depends on LIBCCM
    default n
    help
      Build libccm as a shared library (.so) instead of static library (.a).
```
