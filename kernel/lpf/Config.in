## kernel/lpf/Config.in
```kconfig
# LPF Core Configuration

menuconfig LPF_CORE
	bool "LPF core device model"
	default n
	depends on OSAL
	help
	  LPF Core owns the framework device and driver registry used by
	  peripheral services. It provides a stable LPF device model above
	  kernel-version and SoC-specific adapter layers, plus snapshot device
	  discovery by stable name and capability.

	  It also contains the initial kernel compatibility wrappers and
	  selected SoC adapter used by LPF hardware access paths.

	  Required by the LPF peripheral runtime and services.

	  If unsure, say Y when enabling LPF peripheral services.

if LPF_CORE

choice
	prompt "Default LPF SoC adapter"
	default LPF_SOC_ADAPTER_GENERIC_LINUX
	help
	  Select the SoC adapter registered by LPF Core during module
	  initialization. Product builds should normally use the generic Linux
	  backend or a future SoC-specific backend. Test builds can select the
	  mock backend to validate HAL and peripheral-service paths without
	  live hardware.

config LPF_SOC_ADAPTER_GENERIC_LINUX
	bool "Generic Linux SoC adapter"
	help
	  Use standard Linux kernel subsystem wrappers for GPIO, PWM, I2C, SPI,
	  CAN, and serial access.

config LPF_SOC_ADAPTER_MOCK
	bool "Mock SoC adapter"
	help
	  Use an in-kernel mock backend for GPIO, PWM, I2C, SPI, CAN, and
	  serial access. This is intended for framework tests and development
	  builds that need deterministic behavior without real peripherals.

endchoice

menu "LPF Protocol Configuration"

config LPF_PROTOCOL
	bool "LPF peripheral protocol support"
	default n
	help
	  Enable the LPF-owned protocol encoder/decoder used by peripheral
	  services that need framed communication.

	  The protocol layer is part of LPF infrastructure and is linked into
	  lpf_core.ko so services hosted by the integrated LPF peripheral
	  runtime can share the same packet framing implementation.

config LPF_PROTOCOL_MCU
	bool "MCU protocol messages"
	default n
	depends on LPF_PROTOCOL
	help
	  Enable MCU message definitions for the LPF peripheral protocol.

config LPF_PROTOCOL_CRC_CHECK
	bool "Enable CRC16 checksum"
	default y
	depends on LPF_PROTOCOL
	help
	  Enable CRC16-CCITT checksum support for protocol packets.

config LPF_PROTOCOL_SEQUENCE_CHECK
	bool "Enable sequence number check"
	default y
	depends on LPF_PROTOCOL
	help
	  Enable sequence number helpers for packet ordering.

config LPF_PROTOCOL_MAX_PAYLOAD_SIZE
	int "Maximum protocol payload size (bytes)"
	default 4096
	range 256 65536
	depends on LPF_PROTOCOL
	help
	  Maximum payload size for LPF protocol packets.

endmenu

menuconfig LPF_PERIPHERAL_RUNTIME
	bool "LPF peripheral runtime module"
	default n
	help
	  Build the integrated LPF peripheral runtime module. This module hosts
	  the reusable LPF peripheral services selected below and the runtime
	  configuration backend used to create LPF devices. It keeps framework
	  services in one runtime boundary instead of splitting one kernel
	  module per peripheral.

	  If unsure, say Y when enabling LPF peripheral services.

menuconfig LPF_MCU_SERVICE
	bool "LPF MCU peripheral service"
	default n
	depends on LPF_PERIPHERAL_RUNTIME
	select LPF_PROTOCOL
	select LPF_PROTOCOL_MCU
	select HAL_CAN
	select HAL_UART
	help
	  Enable the LPF MCU peripheral service. MCU instances are created from
	  normalized PCONFIG entries and exposed through LPF device lifecycle,
	  /dev/lpf/mcuN, sysfs attributes, and debugfs commands.

source "kernel/lpf/peripheral/mcu/Config.in"
source "kernel/lpf/transport/mcu/Config.in"

menuconfig LPF_LED_SERVICE
	bool "LPF LED peripheral service"
	default n
	depends on LPF_PERIPHERAL_RUNTIME
	select HAL_GPIO
	select HAL_PWM
	help
	  Enable the LPF LED peripheral service. LED instances are created from
	  normalized PCONFIG entries and exposed through LPF device lifecycle,
	  /dev/lpf/ledN, sysfs attributes, and debugfs commands.

source "kernel/lpf/peripheral/led/Config.in"

endif # LPF_CORE
```

## kernel/lpf/hw/Config.in
```kconfig
# LPF HW configuration

menu "Platform Configuration"

config PLATFORM_LINUX
	bool "Linux platform"
	default n
	depends on OS_LINUX
	help
	  Enable Linux hardware access support.

	  Uses Linux kernel interfaces:
	  - SocketCAN kernel sockets for CAN bus
	  - TTY, GPIO, I2C, and SPI kernel subsystems

	  Suitable for Linux systems with standard kernel drivers.

endmenu

menu "LPF HW Configuration"

config LPF_HW_CAN
	bool "LPF HW CAN transport support"
	default n
	depends on LPF_PERIPHERAL_RUNTIME
	help
	  Enable the LPF HW CAN transport path used by peripheral services.

config LPF_HW_UART
	bool "LPF HW UART transport support"
	default n
	depends on LPF_PERIPHERAL_RUNTIME
	help
	  Enable the LPF HW UART transport path used by peripheral services.

config LPF_HW_I2C
	bool "LPF HW I2C bus support"
	default n
	depends on LPF_PERIPHERAL_RUNTIME
	help
	  Enable the LPF HW I2C bus path used by peripheral services.

config LPF_HW_SPI
	bool "LPF HW SPI bus support"
	default n
	depends on LPF_PERIPHERAL_RUNTIME
	help
	  Enable the LPF HW SPI bus path used by peripheral services.

config LPF_HW_GPIO
	bool "LPF HW GPIO control support"
	default n
	depends on LPF_PERIPHERAL_RUNTIME
	help
	  Enable the LPF HW GPIO control path used by peripheral services.

config LPF_HW_PWM
	bool "LPF HW PWM control support"
	default n
	depends on LPF_PERIPHERAL_RUNTIME
	help
	  Enable the LPF HW PWM control path used by peripheral services.

config LPF_HW_MOCK_SELFTEST
	bool "Build LPF HW mock backend self-test module"
	depends on LPF_SOC_ADAPTER_MOCK && LPF_PERIPHERAL_RUNTIME
	select LPF_HW_CAN
	select LPF_HW_UART
	select LPF_HW_I2C
	select LPF_HW_SPI
	select LPF_HW_GPIO
	select LPF_HW_PWM
	help
	  Build lpf_hw_mock_selftest.ko. Loading this module runs LPF HW
	  GPIO, PWM, CAN, UART, I2C, and SPI operation checks through the
	  mock SoC adapter.

endmenu
```

## kernel/lpf/peripheral/mcu/Config.in
```kconfig
# LPF MCU service configuration

if LPF_MCU_SERVICE

config LPF_MCU_MAX_DEVICES
	int "Maximum number of MCU devices"
	default 4
	range 1 16
	help
	  Maximum number of MCU devices that can be managed simultaneously.
	  Each device requires approximately 200 bytes of RAM.

endif # LPF_MCU_SERVICE
```

## kernel/lpf/transport/mcu/Config.in
```kconfig
# LPF MCU transport configuration

if LPF_MCU_SERVICE

config LPF_MCU_TRANSPORT_CAN
	bool "LPF MCU CAN transport"
	default y
	depends on HAL_CAN
	help
	  Enable the CAN-backed transport implementation used by the LPF MCU
	  service for PCONFIG_MCU_INTERFACE_CAN entries.

config LPF_MCU_TRANSPORT_UART
	bool "LPF MCU UART transport"
	default y
	depends on HAL_UART
	help
	  Enable the UART-backed transport implementation used by the LPF MCU
	  service for PCONFIG_MCU_INTERFACE_SERIAL entries.

endif # LPF_MCU_SERVICE
```

## kernel/pconfig/Config.in
```kconfig
# PCONFIG (Peripheral Configuration Library) Configuration

menuconfig PCONFIG
	bool "PCONFIG (Peripheral Configuration Library)"
	default n
	depends on OSAL
	help
	  Peripheral Configuration Library selects a platform configuration
	  backend and exposes normalized hardware configuration to LPF kernel
	  services.

	  PCONFIG describes the physical hardware configuration of a platform
	  (board variant, peripheral connections, pin mappings, etc.) in a
	  structured, data-driven way.

	  Key features:
	  - Platform-specific hardware descriptions
	  - Backend-based configuration loading
	  - Device Tree backend for SoC/product board descriptions
	  - Built-in static product tables
	  - Normalized peripheral configuration list
	  - Query-only platform configuration API for consumers

	  Memory footprint: small code footprint + product configuration data

	  Use cases:
	  - Fixed product hardware descriptions
	  - Multi-board product variants selected by a PCONFIG backend
	  - Hardware configuration for LPF peripheral services
	  - Peripheral lookup by index or platform/product name

	  Dependencies: OSAL (for basic services)

	  Note: Enable OSAL first in "Core Modules" menu.
	  LPF peripheral services must not depend on concrete product table symbols
	  or backend implementations.

	  Recommended: Enable for products with hardware configuration tables

	  If unsure, say Y.
```

## kernel/pdm-configs/Config.in
```kconfig
# LPF Configuration Module Configuration

config LPF_CONFIGS
	tristate "LPF configuration engine and data providers"
	default m
	depends on OSAL
	depends on m
	help
	  Build lpf_configs.ko. This module owns LPF configuration loading,
	  backend selection, validation, normalization, and the unified
	  configured-device node table consumed by lpf_core.ko.

	  Static platform configuration tables and Device Tree parsing are both
	  implemented inside this module.

if LPF_CONFIGS

config LPF_CONFIG_SOURCE_STATIC
	bool "Enable static platform config provider"
	default y
	help
	  Enable the compiled static platform configuration provider.

config LPF_CONFIG_SOURCE_DT
	bool "Enable Device Tree config provider"
	default y if OF
	depends on OF
	help
	  Enable the Device Tree configuration provider.

menu "LPF Static Platform Config Selection"

depends on LPF_CONFIG_SOURCE_STATIC

choice
	prompt "Selected LPF static config"
	default LPF_CONFIG_UBUNTU_X86_MOCK_MODULES if LPF_SOC_ADAPTER_MOCK
	default LPF_CONFIG_IMX6ULL_MODULES if ARCH_ARM32
	default LPF_CONFIG_UBUNTU_X86_MODULES
	help
	  Select the single static platform configuration compiled into
	  lpf_configs.ko.

config LPF_CONFIG_IMX6ULL_MODULES
	bool "imx6ull/modules v1"

config LPF_CONFIG_UBUNTU_X86_MODULES
	bool "ubuntu/x86_modules v1"

config LPF_CONFIG_UBUNTU_X86_MOCK_MODULES
	bool "ubuntu/x86_mock_modules v1"

endchoice

endmenu

config LPF_CONFIG_OF_SELFTEST
	bool "Build LPF Device Tree config self-test"
	default n
	depends on LPF_CONFIG_SOURCE_DT
	depends on LPF_SOC_ADAPTER_MOCK
	help
	  Build the LPF Device Tree configuration self-test into
	  lpf_configs.ko. This validates the LPF Device Tree parser through
	  Linux OF accessors on kernels with CONFIG_OF enabled.

endif # LPF_CONFIGS
```

## kernel/pdm-core/Config.in
```kconfig
# PDM Core Configuration

menuconfig PDM_CORE
	tristate "PDM core device model"
	default m
	depends on OSAL
	# depends on PDM_CONFIGS  # 已删除：不再依赖 pdm_configs
	depends on m
	help
	  PDM Core owns the framework device and driver registry used by
	  peripheral services. It provides a stable PDM device model above
	  kernel-version and SoC-specific adapter layers, plus snapshot device
	  discovery by stable name and capability.

	  Device configuration now uses Device Tree exclusively.

	  It also contains the initial kernel compatibility wrappers and
	  selected SoC adapter used by PDM hardware access paths.

	  Required by the PDM runtime and services.

	  If unsure, say Y when enabling PDM peripheral services.

if PDM_CORE

config PDM_INSTANCE_DEVNODE_MODE
	string "PDM instance device node mode"
	default "0660"
	help
	  Octal permission mode applied to per-instance PDM misc device nodes
	  under /dev/pdm/, such as /dev/pdm/mcu0 and /dev/pdm/led0.

	  Product builds should keep this conservative and assign device group
	  ownership with udev, devtmpfs policy, or the product init system.
	  Development-only builds that intentionally need broad local access can
	  override this to "0666".

choice
	prompt "Default PDM SoC adapter"
	default PDM_SOC_ADAPTER_GENERIC_LINUX
	help
	  Select the SoC adapter registered by PDM Core during module
	  initialization. Product builds should normally use the generic Linux
	  backend or a future SoC-specific backend. Test builds can select the
	  mock backend to validate PDM HW and peripheral-service paths without
	  live hardware.

config PDM_SOC_ADAPTER_GENERIC_LINUX
	bool "Generic Linux SoC adapter"
	help
	  Use standard Linux kernel subsystem wrappers for GPIO, PWM, I2C, SPI,
	  CAN, and serial access.

config PDM_SOC_ADAPTER_MOCK
	bool "Mock SoC adapter"
	help
	  Use an in-kernel mock backend for GPIO, PWM, I2C, SPI, CAN, and
	  serial access. This is intended for framework tests and development
	  builds that need deterministic behavior without real peripherals.

endchoice

menu "PDM Protocol Configuration"

config PDM_PROTOCOL
	bool "PDM peripheral protocol support"
	default n
	help
	  Enable the PDM-owned protocol encoder/decoder used by peripheral
	  services that need framed communication.

	  The protocol layer is part of PDM infrastructure and is linked into
	  pdm_core.ko so services hosted by the integrated PDM peripheral
	  runtime can share the same packet framing implementation.

config PDM_PROTOCOL_MCU
	bool "MCU protocol messages"
	default n
	depends on PDM_PROTOCOL
	help
	  Enable MCU message definitions for the PDM peripheral protocol.

config PDM_PROTOCOL_CRC_CHECK
	bool "Enable CRC16 checksum"
	default y
	depends on PDM_PROTOCOL
	help
	  Enable CRC16-CCITT checksum support for protocol packets.

config PDM_PROTOCOL_SEQUENCE_CHECK
	bool "Enable sequence number check"
	default y
	depends on PDM_PROTOCOL
	help
	  Enable sequence number helpers for packet ordering.

config PDM_PROTOCOL_MAX_PAYLOAD_SIZE
	int "Maximum protocol payload size (bytes)"
	default 4096
	range 256 65536
	depends on PDM_PROTOCOL
	help
	  Maximum payload size for PDM protocol packets.

endmenu

menuconfig PDM_RUNTIME
	bool "PDM integrated peripheral runtime"
	default y
	depends on PDM_CORE
	help
	  Link the integrated PDM runtime into pdm_core.ko. This runtime hosts
	  the reusable PDM peripheral services selected below and the runtime
	  configuration backend used to create PDM devices. It keeps framework
	  services in one core/driver module instead of splitting one kernel
	  module per peripheral. Static platform configuration can be provided
	  by the separate pdm_configs.ko module or by Device Tree.

	  If unsure, say Y when enabling PDM peripheral services.

if PDM_RUNTIME

source "kernel/pdm-core/hw/Config.in"

menuconfig PDM_MCU_SERVICE
	bool "PDM MCU peripheral service"
	default n
	depends on PDM_RUNTIME
	select PDM_PROTOCOL
	select PDM_PROTOCOL_MCU
	select PDM_HW_CAN
	select PDM_HW_UART
	help
	  Enable the PDM MCU peripheral service. MCU instances are created from
	  normalized PDM_CONFIG entries and exposed through PDM device lifecycle,
	  /dev/pdm/mcuN, sysfs attributes, and debugfs commands.

source "kernel/pdm-core/peripheral/mcu/Config.in"

menuconfig PDM_LED_SERVICE
	bool "PDM LED peripheral service"
	default n
	depends on PDM_RUNTIME
	select PDM_HW_GPIO
	select PDM_HW_PWM
	help
	  Enable the PDM LED peripheral service. LED instances are created from
	  normalized PDM_CONFIG entries and exposed through PDM device lifecycle,
	  /dev/pdm/ledN, sysfs attributes, and debugfs commands.

source "kernel/pdm-core/peripheral/led/Config.in"

endif # PDM_RUNTIME

menu "PDM Core Test Configuration"

config PDM_DUMMY_SERVICE_SELFTEST
	tristate "Build PDM dummy service self-test module"
	default n
	depends on PDM_CORE && PDM_SOC_ADAPTER_MOCK
	depends on m
	help
	  Build pdm_dummy_service_selftest.ko. Loading this module registers
	  a temporary dummy PDM driver and device to validate PDM Core
	  lifecycle, discovery, capability lookup, state/error transitions,
	  event delivery, and removal cleanup without requiring live hardware.

endmenu

endif # PDM_CORE
```

## kernel/pdm-core/peripheral/led/Config.in
```kconfig
if LPF_LED_SERVICE

config LPF_LED_MAX_DEVICES
	int "Maximum LED devices"
	default 8
	range 1 256
	help
	  Maximum number of configured LED devices managed by the LPF LED
	  peripheral service.

endif # LPF_LED_SERVICE
```
