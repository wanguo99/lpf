## products/ccm_product/configs/h200_100p_v2_defconfig
```kconfig
# H200-100P V2 Product Configuration
# 增强型号：添加健康监控

# 启用的应用
CONFIG_APP_COLLECTOR=y
CONFIG_APP_COMM=y
CONFIG_APP_HEALTH=y
CONFIG_APP_LOGGER=n
CONFIG_APP_SUPERVISOR=n

# SDK 组件（必需）
CONFIG_OSAL=y
CONFIG_HAL=y
CONFIG_PCL=y
CONFIG_PDL=y
CONFIG_ACL=y

# 产品组件（必需）
CONFIG_H200_AM625=y
CONFIG_LIBCCM=y

# 平台配置
CONFIG_OS_LINUX=y
CONFIG_ARCH_ARM64=y
CONFIG_PCL_PLATFORM_TI_AM625=y
CONFIG_PCL_PRODUCT_H200_100P=y
```
