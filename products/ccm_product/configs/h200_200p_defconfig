## products/ctest/performance/pconfig/Config.in
```kconfig
# PCONFIG Performance Test Configuration
#
# Measures platform configuration layer performance.
# Tests configuration loading, parsing, and device mapping speed.

if TEST_PERFORMANCE_PCONFIG

config TEST_PERF_PCONFIG
	bool "PCONFIG basic performance tests"
	default y
	help
	  Basic PCONFIG performance test suite.

	  Measures:
	    - Platform config query performance
	    - Peripheral config query performance
	    - CAN config query performance

	  Runtime: 1-2 seconds
	  Hardware: None
	  Dependencies: CONFIG_PCONFIG
	  Tags: performance
	  Test file: test_perf_pconfig.c

menu "PCONFIG Performance Tests"

config TEST_PERF_PCONFIG_PARSE
	bool "Configuration parsing performance tests"
	default n
	help
	  Configuration file parsing speed benchmarks.

	  Measures:
	    - JSON/XML parsing throughput
	    - Large file parsing (MB range)
	    - Schema validation overhead
	    - Error detection speed

	  Runtime: 2-3 seconds
	  Hardware: None
	  Dependencies: CONFIG_PCONFIG
	  Tags: performance, parsing
	  Test file: test_perf_pconfig_parse.c

config TEST_PERF_PCONFIG_LOOKUP
	bool "Device lookup performance tests"
	default n
	help
	  Device table lookup speed benchmarks.

	  Measures:
	    - Device ID lookup latency
	    - Device name resolution speed
	    - Configuration query performance
	    - Large device table handling

	  Runtime: 1-2 seconds
	  Hardware: None
	  Dependencies: CONFIG_PCONFIG
	  Tags: performance, lookup
	  Test file: test_perf_pconfig_lookup.c

endmenu

endif # TEST_PERFORMANCE_PCONFIG
```

## products/ctest/performance/pdl/Config.in
```kconfig
# PDL Performance Test Configuration
#
# Measures PDL device driver performance and protocol efficiency.
# Tests peripheral driver layer throughput and latency.

if TEST_PERFORMANCE_PDL

menu "PDL Performance Tests"

config TEST_PERF_PDL
	bool "PDL综合性能测试"
	default y
	help
	  PDL层综合性能测试套件。

	  测试内容：
	    - 外设驱动基础性能基准测试
	    - 协议处理性能测试
	    - 设备通信性能验证

	  运行时间: 3-5 秒
	  硬件要求: Mock设备或模拟环境
	  依赖项: CONFIG_PDL
	  标签: performance, pdl
	  测试文件: test_perf_pdl.c

config TEST_PERF_PDL_MCU
	bool "MCU device performance tests"
	default n
	help
	  MCU communication performance benchmarks.

	  Measures:
	    - Command execution latency
	    - Telemetry read throughput
	    - Bulk data transfer speed
	    - Protocol overhead analysis

	  Runtime: 2-4 seconds
	  Hardware: Mock MCU device
	  Dependencies: CONFIG_PDL_MCU
	  Tags: performance, pdl
	  Test file: test_perf_pdl_mcu.c

config TEST_PERF_PDL_PROTOCOL
	bool "Protocol encoding/decoding performance tests"
	default n
	help
	  PDL protocol layer performance benchmarks.

	  Measures:
	    - Message encoding speed
	    - Message decoding speed
	    - CRC calculation overhead
	    - Serialization/deserialization efficiency
	    - Protocol buffer reuse optimization

	  Runtime: 2-3 seconds
	  Hardware: None
	  Dependencies: CONFIG_PDL
	  Tags: performance, protocol
	  Test file: test_perf_pdl_protocol.c

endmenu

endif # TEST_PERFORMANCE_PDL
```

## products/ctest/stress/Config.in
```kconfig
# Stress Test Configuration
#
# Stress tests push components to their limits to verify stability,
# robustness, and resource exhaustion handling under extreme conditions.
#
# Organization:
#   - stress/Config.in (this file) - Entry point, sources layer configs
#   - stress/osal/Config.in - OSAL stress tests
#   - stress/hal/Config.in - HAL stress tests
#   - stress/pconfig/Config.in - PCONFIG stress tests
#   - stress/aconfig/Config.in - ACONFIG stress tests

if TEST_STRESS

menu "Stress Tests"

config TEST_STRESS_ALL
	bool "Enable all stress tests"
	default y
	select TEST_STRESS_OSAL if TEST_OSAL
	select TEST_STRESS_HAL if TEST_HAL
	select TEST_STRESS_PCONFIG if TEST_PCONFIG
	select TEST_STRESS_ACONFIG if TEST_ACONFIG
	help
	  Enable all stress tests at once.
	  Disabling this allows individual layer selection below.

	  Stress tests verify:
	    - Behavior under resource exhaustion
	    - Stability under high concurrency
	    - Memory leak detection under load
	    - Recovery from error conditions
	    - System limits (threads, files, connections)

	  Warning: Stress tests consume significant resources and may
	  take several minutes to complete. They may temporarily degrade
	  system performance.

	  Runtime: Varies by test (typically 10-60 seconds per test)
	  Tags: slow, stress, heavy

# Source layer-specific Config.in files
if TEST_OSAL
	source "products/ctest/stress/osal/Config.in"
endif

if TEST_HAL
	source "products/ctest/stress/hal/Config.in"
endif

if TEST_PCONFIG
	source "products/ctest/stress/pconfig/Config.in"
endif

if TEST_ACONFIG
	source "products/ctest/stress/aconfig/Config.in"
endif

endmenu

endif # TEST_STRESS
```

## products/ctest/stress/aconfig/Config.in
```kconfig
# ACONFIG Stress Test Configuration
#
# Tests application configuration layer under extreme conditions.
# Verifies concurrent access, performance baselines, and stability.

menu "ACONFIG Stress Tests"

config TEST_STRESS_ACONFIG
	bool "ACONFIG comprehensive stress tests"
	default y
	help
	  Comprehensive stress testing for ACONFIG module.

	  Includes:
	    - Concurrent query operations (TC/TM)
	    - Large table performance baseline
	    - Long-running stability tests
	    - High-frequency throughput tests

	  Tests thread-safety, performance, and memory stability
	  under various stress conditions.

	  Runtime: 30-60 seconds total
	  Hardware: None (in-memory only)
	  Dependencies: CONFIG_ACONFIG
	  Tags: stress, concurrency, performance
	  Test file: test_stress_aconfig.c

config TEST_STRESS_ACONFIG_CONCURRENT
	bool "Concurrent query stress tests"
	default y
	help
	  Multi-threaded concurrent query operations.

	  Tests:
	    - TC query from 10+ concurrent threads
	    - TM query from 10+ concurrent threads
	    - Mixed TC/TM queries (16 threads)
	    - Statistics query from 8 threads
	    - 10000+ iterations per thread

	  Verifies:
	    - Thread-safe read operations
	    - rwlock correctness
	    - No race conditions
	    - 99.9%+ success rate
	    - Zero errors under load

	  Runtime: 5-15 seconds
	  Hardware: None (in-memory only)
	  Dependencies: CONFIG_ACONFIG
	  Tags: stress, concurrency, thread-safety
	  Test file: test_stress_aconfig.c

config TEST_STRESS_ACONFIG_PERFORMANCE
	bool "Large table performance tests"
	default y
	help
	  Performance baseline for O(n) sparse array lookup.

	  Tests:
	    - 100 TC entries, 200 TM entries
	    - Random access patterns
	    - 4 threads, 1000 iterations
	    - Latency measurement per query

	  Verifies:
	    - O(n) lookup behavior
	    - Acceptable average latency
	    - Performance consistency
	    - No performance cliffs

	  Runtime: 5-10 seconds
	  Hardware: None
	  Dependencies: CONFIG_ACONFIG
	  Tags: stress, performance, baseline
	  Test file: test_stress_aconfig.c

config TEST_STRESS_ACONFIG_STABILITY
	bool "Long-running stability tests"
	default y
	help
	  Extended duration operation for leak detection.

	  Tests:
	    - 10 second continuous operation
	    - 8 threads mixed queries
	    - Memory stability monitoring
	    - Resource leak detection

	  Verifies:
	    - No memory leaks
	    - Consistent performance over time
	    - 99.9%+ success rate
	    - System stability

	  Runtime: 10-15 seconds
	  Hardware: None
	  Dependencies: CONFIG_ACONFIG
	  Tags: stress, stability, leak-detection
	  Test file: test_stress_aconfig.c

config TEST_STRESS_ACONFIG_THROUGHPUT
	bool "High-frequency throughput tests"
	default y
	help
	  Maximum query throughput measurement.

	  Tests:
	    - 20 threads, 50000 iterations
	    - High-frequency mixed queries
	    - Operations per second measurement

	  Verifies:
	    - Sustained high throughput
	    - 99.9%+ success rate
	    - Throughput baseline established

	  Runtime: 10-20 seconds
	  Hardware: None
	  Dependencies: CONFIG_ACONFIG
	  Tags: stress, performance, throughput
	  Test file: test_stress_aconfig.c

endmenu
```

## products/ctest/stress/osal/Config.in
```kconfig
# OSAL Stress Test Configuration
#
# Tests OSAL components under extreme load and resource pressure.
# Verifies stability, leak-free operation, and graceful degradation.

config TEST_STRESS_OSAL
	bool "OSAL stress tests"
	depends on TEST_STRESS && TEST_OSAL
	default y if TEST_STRESS_ALL
	help
	  Comprehensive stress tests for OSAL layer.

	  Test scenarios:
	    - Atomic operations under high contention (20+ threads)
	    - Mutex lock contention (50+ threads competing)
	    - Semaphore rapid post/wait cycles
	    - Condition variable signaling storms
	    - Thread creation/destruction stress (100+ threads)
	    - Memory allocation/deallocation cycles
	    - Time operations from multiple threads
	    - String operations under concurrency
	    - File I/O concurrent access
	    - CRC computation performance
	    - Mixed operations workload

	  Verifies:
	    - Correctness under concurrent access
	    - No memory leaks during stress
	    - No deadlocks or race conditions
	    - Performance characteristics (throughput, latency)
	    - Graceful handling of resource limits
	    - System stability after stress

	  Test count: 11 stress scenarios
	  Runtime: ~90 seconds total
	  Hardware: None (uses /tmp for file tests)
	  Dependencies: CONFIG_OSAL
	  Tags: stress, concurrency, performance, slow

if TEST_STRESS_OSAL

menu "OSAL Stress Test Options"

config TEST_STRESS_OSAL_THREAD_COUNT
	int "Default thread count for concurrency tests"
	default 20
	range 1 200
	help
	  Number of concurrent threads to use in stress tests.

	  Higher values create more contention but may hit system limits.
	  Recommended: 10-50 for typical systems, 20 is balanced.

config TEST_STRESS_OSAL_DURATION_SEC
	int "Default duration for time-based tests (seconds)"
	default 10
	range 1 300
	help
	  How long to run each time-based stress test.

	  Longer durations better detect memory leaks and rare race conditions.
	  Recommended: 5-30 seconds, 10 is balanced.

config TEST_STRESS_OSAL_ITERATIONS
	int "Default iterations for count-based tests"
	default 10000
	range 100 10000000
	help
	  Number of iterations for count-based stress tests.

	  Higher values provide better statistical confidence.
	  Recommended: 1000-100000, 10000 is balanced.

config TEST_STRESS_OSAL_VERBOSE
	bool "Enable verbose output during stress tests"
	default n
	help
	  Print detailed progress and metrics during test execution.

	  Useful for debugging but increases test runtime.
	  Disable for CI/CD pipelines.

config TEST_STRESS_OSAL_ATOMIC
	bool "Atomic operations stress"
	default y
	help
	  Test atomic operations under high contention.

	  Scenarios:
	    - Concurrent atomic_inc from 20 threads
	    - fetch_add/fetch_sub combinations
	    - compare_exchange_strong under contention

	  Verifies lock-free correctness and performance.
	  Runtime: ~10 seconds

config TEST_STRESS_OSAL_MUTEX
	bool "Mutex contention stress"
	default y
	help
	  Test mutex under extreme contention.

	  Scenarios:
	    - 50 threads competing for single mutex
	    - Millions of lock/unlock cycles

	  Verifies no deadlocks and fair scheduling.
	  Runtime: ~10 seconds

config TEST_STRESS_OSAL_SEMAPHORE
	bool "Semaphore signaling stress"
	default y
	help
	  Test semaphore post/wait under load.

	  Scenarios:
	    - Rapid post/wait cycles
	    - Multiple producers and consumers

	  Verifies correct counting and wake-up behavior.
	  Runtime: ~5 seconds

config TEST_STRESS_OSAL_CONDITION
	bool "Condition variable stress"
	default y
	help
	  Test condition variables under signaling storms.

	  Scenarios:
	    - Many threads waiting and signaling
	    - Signal/broadcast interleaving

	  Verifies no lost wake-ups or spurious signals.
	  Runtime: ~5 seconds

config TEST_STRESS_OSAL_THREAD
	bool "Thread creation stress"
	default y
	help
	  Test thread creation/destruction at scale.

	  Scenarios:
	    - Rapidly create 100 threads
	    - Measure creation throughput

	  Verifies no resource leaks and proper cleanup.
	  Runtime: ~5 seconds

config TEST_STRESS_OSAL_MEMORY
	bool "Memory allocation stress"
	default y
	help
	  Test memory allocator under concurrent load.

	  Scenarios:
	    - Concurrent alloc/free from 20 threads
	    - Various allocation sizes (16B - 16KB)
	    - Millions of allocation cycles

	  Verifies no memory leaks and allocator performance.
	  Runtime: ~10 seconds

config TEST_STRESS_OSAL_TIME
	bool "Time operations stress"
	default y
	help
	  Test time functions from multiple threads.

	  Scenarios:
	    - Concurrent get_tick_count calls
	    - get_monotonic_time verification
	    - get_local_time thread safety

	  Verifies thread safety and monotonicity.
	  Runtime: ~5 seconds

config TEST_STRESS_OSAL_STRING
	bool "String operations stress"
	default y
	help
	  Test string functions under concurrent access.

	  Scenarios:
	    - Concurrent snprintf formatting
	    - strcmp/strcpy operations
	    - strlen calculations

	  Verifies thread safety and correctness.
	  Runtime: ~5 seconds

config TEST_STRESS_OSAL_FILE
	bool "File I/O stress"
	default y
	help
	  Test file operations under concurrent load.

	  Scenarios:
	    - Multiple threads creating/writing/reading files
	    - Concurrent file descriptor usage
	    - Rapid create/delete cycles in /tmp

	  Verifies no fd leaks and proper file handling.
	  Runtime: ~5 seconds
	  Note: Creates temporary files in /tmp

config TEST_STRESS_OSAL_CRC
	bool "CRC computation stress"
	default y
	help
	  Test CRC functions under concurrent load.

	  Scenarios:
	    - Concurrent CRC16 and CRC32 calculations
	    - Various data sizes

	  Verifies thread safety and performance.
	  Runtime: ~5 seconds

config TEST_STRESS_OSAL_MIXED
	bool "Mixed operations stress"
	default y
	help
	  Test mixed workload combining multiple operations.

	  Scenarios:
	    - 30 threads performing diverse operations
	    - Mutex, semaphore, memory, time, string ops
	    - Simulates real application workload

	  Verifies overall system stability under realistic load.
	  Runtime: ~10 seconds

endmenu

endif # TEST_STRESS_OSAL
```
