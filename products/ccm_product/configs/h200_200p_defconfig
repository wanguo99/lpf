## products/ctest/system/osal/Config.in
```kconfig
# OSAL System Test Configuration
#
# Cross-module integration tests for OSAL components.
# Tests interactions between multiple OSAL subsystems.

if TEST_SYSTEM_OSAL

menu "OSAL System Tests"

config TEST_SYSTEM_OSAL_CORE
	bool "Core system integration tests"
	default y
	help
	  Core OSAL system integration tests.

	  Tests:
	    - Multi-thread coordination (producer-consumer)
	    - IPC end-to-end (threads + shared memory + semaphores)
	    - Resource management full flow (allocation/use/cleanup)
	    - System startup/shutdown flow (worker threads lifecycle)

	  Verifies:
	    - Correct synchronization across subsystems
	    - Resource lifecycle management
	    - Graceful startup and shutdown
	    - No resource leaks

	  Runtime: 5-10 seconds
	  Hardware: None
	  Dependencies: CONFIG_OSAL
	  Tags: integration, core, lifecycle
	  Test file: test_system_osal.c

config TEST_SYSTEM_OSAL_THREADING_IPC
	bool "Thread + IPC integration tests"
	default y
	help
	  Integration tests for threading with IPC mechanisms.

	  Tests:
	    - Producer-consumer pattern with condition variables
	    - Thread pool with semaphore coordination
	    - Shared memory access from multiple threads
	    - Condition variable wakeup patterns

	  Verifies:
	    - Correct thread synchronization
	    - IPC data integrity
	    - Deadlock-free operation
	    - Wakeup reliability

	  Runtime: 10-15 seconds
	  Hardware: None
	  Dependencies: CONFIG_OSAL
	  Tags: integration, threading, ipc
	  Test file: test_system_osal_threading_ipc.c

config TEST_SYSTEM_OSAL_FILE_THREAD
	bool "File I/O + Threading integration tests"
	default y
	help
	  Concurrent file operations from multiple threads.

	  Tests:
	    - Multiple threads reading same file
	    - Multiple threads writing to separate files
	    - File locking coordination
	    - File position tracking per thread
	    - File descriptor cleanup

	  Verifies:
	    - Thread-safe file operations
	    - No file corruption
	    - Correct file position tracking
	    - Proper fd cleanup

	  Runtime: 10-15 seconds
	  Hardware: Requires filesystem
	  Dependencies: CONFIG_OSAL
	  Tags: integration, filesystem, threading
	  Test file: test_system_osal_file_thread.c

config TEST_SYSTEM_OSAL_PROCESS_IPC
	bool "Process + IPC integration tests"
	default n
	help
	  Inter-process communication tests.

	  Tests:
	    - Parent-child communication via pipes
	    - Shared memory between processes
	    - Semaphore-based process synchronization
	    - Signal-based process coordination
	    - Process group operations

	  Verifies:
	    - Correct IPC across process boundaries
	    - Process cleanup on exit
	    - Signal delivery to processes
	    - Shared resource cleanup

	  Runtime: 15-20 seconds
	  Hardware: None
	  Dependencies: CONFIG_OSAL
	  Tags: integration, process, ipc
	  Test file: test_system_osal_process_ipc.c

	  Note: Disabled by default as it requires fork() which may
	        not be available in all environments.

config TEST_SYSTEM_OSAL_REALTIME
	bool "Real-time scheduling integration tests"
	default n
	help
	  Real-time thread scheduling and priority tests.

	  Tests:
	    - RT thread priority enforcement
	    - Priority inheritance with mutexes
	    - CPU affinity with RT threads
	    - RT thread + Timer interaction
	    - Scheduler policy interactions

	  Verifies:
	    - Priority ordering correctness
	    - Priority inversion avoidance
	    - Deterministic wakeup latency
	    - CPU affinity enforcement

	  Runtime: 10-15 seconds
	  Hardware: None (RT scheduler may not be available)
	  Dependencies: CONFIG_OSAL
	  Tags: integration, realtime, scheduling
	  Test file: test_system_osal_realtime.c

	  Note: Disabled by default as RT features may require
	        root privileges or RT kernel.

endmenu

endif # TEST_SYSTEM_OSAL
```

## products/ctest/system/pconfig/Config.in
```kconfig
# PCONFIG System Test Configuration
#
# Platform configuration layer integration tests.
# Tests PCONFIG with underlying HAL and PDL components.

if TEST_SYSTEM_PCONFIG

menu "PCONFIG System Tests"

config TEST_SYSTEM_PCONFIG_HAL
	bool "PCONFIG + HAL integration tests"
	default n
	help
	  Platform configuration with HAL driver initialization.

	  Tests:
	    - Device tree → HAL driver initialization
	    - Pin configuration application
	    - Clock configuration validation
	    - Bus parameters (baud rate, speed)
	    - Hardware resource allocation

	  Verifies:
	    - HAL drivers initialized per config
	    - Correct parameter application
	    - Configuration validation errors caught
	    - Resource allocation correctness

	  Runtime: 3-5 seconds
	  Hardware: Mock devices
	  Dependencies: CONFIG_PCONFIG, CONFIG_HAL
	  Tags: integration, config, hal
	  Test file: test_system_pconfig_hal.c

config TEST_SYSTEM_PCONFIG_PDL
	bool "PCONFIG + PDL integration tests"
	default n
	help
	  Platform configuration with PDL device mapping.

	  Tests:
	    - Device configuration → PDL device creation
	    - Device ID mapping
	    - Protocol parameter configuration
	    - Multi-device setup from config
	    - Configuration update without restart

	  Verifies:
	    - PDL devices match configuration
	    - Correct device ID assignment
	    - Protocol parameters applied
	    - Dynamic reconfiguration support

	  Runtime: 3-5 seconds
	  Hardware: Mock devices
	  Dependencies: CONFIG_PCONFIG, CONFIG_PDL
	  Tags: integration, config, pdl
	  Test file: test_system_pconfig_pdl.c

config TEST_SYSTEM_PCONFIG_RUNTIME
	bool "Runtime configuration change tests"
	default n
	help
	  Dynamic configuration changes at runtime.

	  Tests:
	    - Hot-reload configuration files
	    - Device reconfiguration without restart
	    - Configuration rollback on error
	    - Partial configuration updates
	    - Configuration validation before apply

	  Verifies:
	    - Safe runtime reconfiguration
	    - No device state corruption
	    - Correct rollback behavior
	    - Validation prevents bad config

	  Runtime: 5-10 seconds
	  Hardware: Mock devices
	  Dependencies: CONFIG_PCONFIG
	  Tags: integration, config, dynamic
	  Test file: test_system_pconfig_runtime.c

endmenu

endif # TEST_SYSTEM_PCONFIG
```

## products/ctest/system/pdl/Config.in
```kconfig
# PDL System Test Configuration
#
# Cross-device integration tests for PDL components.
# Tests multi-device scenarios and protocol interactions.

if TEST_SYSTEM_PDL

menu "PDL System Tests"

config TEST_SYSTEM_PDL_MULTIDEVICE
	bool "Multi-device concurrent operations"
	default y
	help
	  Concurrent operations across multiple PDL devices.

	  Tests:
	    - Simultaneous MCU, BMC, Satellite commands
	    - Interleaved command/response sequences
	    - Device priority handling
	    - Concurrent telemetry collection
	    - Cross-device timing interactions

	  Verifies:
	    - Device independence (no interference)
	    - Correct command routing
	    - Response correlation correctness
	    - No message cross-contamination

	  Runtime: 5-10 seconds
	  Hardware: Multiple mock devices
	  Dependencies: CONFIG_PDL
	  Tags: integration, pdl, multidevice
	  Test file: test_system_pdl_multidevice.c

config TEST_SYSTEM_PDL_PROTOCOL_STACK
	bool "Full protocol stack integration tests"
	default y
	help
	  End-to-end protocol stack tests (PRL + PDL + HAL).

	  Tests:
	    - Application data → PRL encode → PDL send → HAL transmit
	    - HAL receive → PDL process → PRL decode → Application
	    - Error injection at each layer
	    - Layer-to-layer data integrity
	    - Protocol state machine coordination

	  Verifies:
	    - Correct data flow through all layers
	    - No data corruption between layers
	    - Error propagation correctness
	    - Layer boundary validation

	  Runtime: 5-10 seconds
	  Hardware: Mock devices
	  Dependencies: CONFIG_PDL, CONFIG_PRL, CONFIG_HAL
	  Tags: integration, protocol, stack
	  Test file: test_system_pdl_protocol_stack.c

config TEST_SYSTEM_PDL_BUS_SHARING
	bool "Shared bus arbitration tests"
	default n
	help
	  Multiple PDL devices sharing same physical bus.

	  Tests:
	    - CAN bus with MCU + BMC + Satellite
	    - Serial bus with multiple devices
	    - Bus arbitration fairness
	    - Collision detection and recovery
	    - Bus congestion handling

	  Verifies:
	    - Fair bus access for all devices
	    - No message collisions
	    - Correct bus error handling
	    - Performance under congestion

	  Runtime: 5-10 seconds
	  Hardware: Shared bus configuration
	  Dependencies: CONFIG_PDL, CONFIG_HAL
	  Tags: integration, bus, arbitration
	  Test file: test_system_pdl_bus_sharing.c

config TEST_SYSTEM_PDL_ERROR_PROPAGATION
	bool "Cross-device error propagation tests"
	default n
	help
	  Error handling across multiple devices.

	  Tests:
	    - Device error impact on other devices
	    - Error recovery coordination
	    - Cascading failure prevention
	    - Error isolation verification
	    - System recovery after device failure

	  Verifies:
	    - Errors don't propagate incorrectly
	    - Failed device doesn't affect others
	    - Correct error reporting
	    - System stability during failures

	  Runtime: 5-10 seconds
	  Hardware: Mock devices with error injection
	  Dependencies: CONFIG_PDL
	  Tags: integration, error, robustness
	  Test file: test_system_pdl_error_propagation.c

config TEST_SYSTEM_PDL_TELEMETRY
	bool "Multi-device telemetry collection tests"
	default n
	help
	  Concurrent telemetry collection from multiple devices.

	  Tests:
	    - Simultaneous telemetry from all devices
	    - Telemetry aggregation correctness
	    - Timestamp synchronization
	    - High-frequency telemetry bursts
	    - Telemetry buffer management

	  Verifies:
	    - No telemetry loss under load
	    - Correct device attribution
	    - Timestamp accuracy
	    - Buffer overflow handling

	  Runtime: 5-10 seconds
	  Hardware: Mock devices
	  Dependencies: CONFIG_PDL
	  Tags: integration, telemetry
	  Test file: test_system_pdl_telemetry.c

config TEST_SYSTEM_PDL_CCM
	bool "CCM device integration tests"
	default y
	depends on PDL_CCM_SUPPORT
	help
	  Comprehensive CCM communication driver integration tests.

	  Tests:
	    - CCM initialization and basic communication
	    - Telemetry data transmission
	    - Telecommand handling
	    - Node management operations
	    - Power domain control
	    - Status query operations
	    - Connection status and statistics
	    - Callback registration and invocation

	  Verifies:
	    - CCM driver initialization with Ethernet interface
	    - Telemetry/command callback mechanism
	    - Node start/stop/restart operations
	    - Power on/off/query commands
	    - Heartbeat transmission
	    - Connection status monitoring
	    - Communication statistics tracking
	    - Proper cleanup and deinitialization

	  Runtime: 5-10 seconds
	  Hardware: CCM device or mock interface
	  Dependencies: CONFIG_PDL_CCM_SUPPORT
	  Tags: integration, ccm, telemetry, command
	  Test file: test_system_pdl_ccm.c

endmenu

endif # TEST_SYSTEM_PDL
```

## products/ctest/system/prl/Config.in
```kconfig
# PRL System Test Configuration
#
# System integration tests for PRL protocol layer.
# Tests realistic communication scenarios and interaction with other layers.

if TEST_SYSTEM_PRL

menu "PRL System Tests"

config TEST_SYSTEM_PRL_REQUEST_RESPONSE
	bool "Request-response communication pattern"
	default y
	help
	  End-to-end request-response communication scenarios.

	  Tests:
	    - PMC → MCU request with response
	    - PMC → PMC telemetry request
	    - GSC → Multiple devices queries
	    - ACK flag handling in request-response
	    - Sequence number correlation
	    - Timeout and retry scenarios

	  Verifies:
	    - Complete encode-decode-response cycle
	    - PRL_BuildResponse correctness
	    - Sequence number preservation in responses
	    - Flag handling (NEED_ACK/IS_ACK)
	    - Response payload integrity

	  Runtime: 2-5 seconds
	  Dependencies: CONFIG_PRL
	  Tags: integration, prl, request-response
	  Test file: test_system_prl_request_response.c

config TEST_SYSTEM_PRL_ROUTING
	bool "Packet routing and fast extraction"
	default y
	help
	  Packet routing using fast extraction APIs.

	  Tests:
	    - Multi-device packet routing by device type
	    - Fast device/message type extraction
	    - Sequence-based deduplication
	    - Routing table lookup simulation
	    - High-frequency packet classification

	  Verifies:
	    - PRL_GetDeviceType performance
	    - PRL_GetMessageType accuracy
	    - PRL_GetSequence for duplicate detection
	    - PRL_ValidatePacket for quick validation
	    - Routing decisions without full decode

	  Runtime: 2-5 seconds
	  Dependencies: CONFIG_PRL
	  Tags: integration, prl, routing, performance
	  Test file: test_system_prl_routing.c

config TEST_SYSTEM_PRL_MULTIDEVICE
	bool "Multi-device concurrent communication"
	default y
	help
	  Concurrent communication between multiple devices.

	  Tests:
	    - Simultaneous MCU, PMC, PMC, GSC communication
	    - Interleaved encode/decode operations
	    - Device type isolation
	    - Concurrent sequence number generation
	    - Message type diversity handling

	  Verifies:
	    - No cross-device interference
	    - Sequence numbers remain unique
	    - Device type routing correctness
	    - Thread-safe sequence generation
	    - Message integrity under concurrency

	  Runtime: 3-8 seconds
	  Dependencies: CONFIG_PRL, TEST_OSAL
	  Tags: integration, prl, concurrency, multidevice
	  Test file: test_system_prl_multidevice.c

config TEST_SYSTEM_PRL_ERROR_RECOVERY
	bool "Error handling and recovery scenarios"
	default y
	help
	  Error injection and recovery testing.

	  Tests:
	    - Corrupted packet handling
	    - Invalid device type rejection
	    - CRC mismatch detection
	    - Buffer overflow protection
	    - Partial packet handling
	    - Protocol version mismatch

	  Verifies:
	    - Graceful error handling
	    - Error code correctness
	    - PRL_GetErrorString accuracy
	    - System stability after errors
	    - No resource leaks on errors

	  Runtime: 2-5 seconds
	  Dependencies: CONFIG_PRL
	  Tags: integration, prl, error, robustness
	  Test file: test_system_prl_error_recovery.c

config TEST_SYSTEM_PRL_LIFECYCLE
	bool "Module lifecycle and state management"
	default y
	help
	  PRL initialization, operation, and cleanup.

	  Tests:
	    - PRL_Init → operations → PRL_Deinit cycle
	    - Multiple init/deinit cycles
	    - Operations without explicit init
	    - Sequence number persistence across init
	    - PRL_ResetSequence functionality
	    - PRL_GetCurrentSequence accuracy

	  Verifies:
	    - Proper resource initialization
	    - Clean shutdown without leaks
	    - State consistency across lifecycle
	    - Sequence number management
	    - Module re-initialization safety

	  Runtime: 1-3 seconds
	  Dependencies: CONFIG_PRL
	  Tags: integration, prl, lifecycle
	  Test file: test_system_prl_lifecycle.c

config TEST_SYSTEM_PRL_PROTOCOL_STACK
	bool "Full protocol stack integration (HAL + PRL)"
	default n
	depends on TEST_HAL
	help
	  Integration with HAL layer for realistic communication.

	  Tests:
	    - PRL encode → HAL CAN transmit simulation
	    - HAL CAN receive → PRL decode
	    - PRL encode → HAL UART transmit simulation
	    - End-to-end data flow through layers
	    - Protocol overhead measurement

	  Verifies:
	    - Seamless HAL/PRL integration
	    - No data corruption between layers
	    - Proper buffer management
	    - Performance characteristics
	    - Real-world usage patterns

	  Runtime: 3-8 seconds
	  Hardware: Mock HAL CAN/UART
	  Dependencies: CONFIG_PRL, CONFIG_HAL
	  Tags: integration, prl, hal, stack
	  Test file: test_system_prl_protocol_stack.c

endmenu

endif # TEST_SYSTEM_PRL
```
