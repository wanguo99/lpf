## products/ctest/unit/Config.in
```kconfig
# Unit Test Configuration
#
# This file provides fine-grained control over individual unit test files.
# Each test file can be independently enabled/disabled through menuconfig.

if TEST_UNIT

# Source layer-specific Config.in files
source "products/ctest/unit/osal/Config.in"
source "products/ctest/unit/hal/Config.in"
source "products/ctest/unit/pdi/Config.in"
source "products/ctest/unit/pdm/Config.in"
source "products/ctest/unit/pconfig/Config.in"
source "products/ctest/unit/aconfig/Config.in"

endif # TEST_UNIT
```

## products/ctest/unit/aconfig/Config.in
```kconfig
# ACONFIG Unit Test Configuration
#
# Fine-grained control for individual ACONFIG test files.
# Each option corresponds to a single test_aconfig_*.c file.

if TEST_ACONFIG

menu "ACONFIG Unit Tests"

config TEST_ACONFIG_ALL
	bool "Enable all ACONFIG unit tests"
	default y
	select TEST_ACONFIG_API
	select TEST_ACONFIG_EXTENDED
	select TEST_ACONFIG_HWID
	help
	  Enable all ACONFIG unit tests at once.
	  Disabling this allows individual test selection below.

config TEST_ACONFIG_API
	bool "ACONFIG API tests"
	default y
	help
	  Test ACONFIG API operations (init, telecommand, telemetry query).

	  Coverage:
	    - Application configuration initialization
	    - Telecommand (TC) lookup by ID and name
	    - Telemetry (TM) lookup by ID and name
	    - Device mapping (business function to hardware device)
	    - Configuration table iteration
	    - TC/TM enumeration
	    - Runtime configuration queries
	    - Error handling for invalid lookups

	  Runtime: <100ms
	  Hardware: None
	  Dependencies: CONFIG_ACONFIG
	  Tags: fast
	  Test file: test_aconfig_api.c

config TEST_ACONFIG_EXTENDED
	bool "ACONFIG extended API tests"
	default y
	help
	  Test extended ACONFIG APIs (GetInvalidationMap, GetStatistics).

	  Coverage:
	    - ACONFIG_GetInvalidationMap (normal, empty, buffer overflow)
	    - ACONFIG_GetStatistics (normal, empty table, invalid params)
	    - ACONFIG_PrintConfig (debugging function)
	    - ACONFIG_RegisterTable error handling
	    - Table overwriting behavior
	    - Empty table edge cases
	    - User context preservation
	    - Large sparse array performance baseline

	  Runtime: <200ms
	  Hardware: None
	  Dependencies: CONFIG_ACONFIG
	  Tags: fast
	  Test file: test_aconfig_extended.c

config TEST_ACONFIG_HWID
	bool "ACONFIG HWID management tests"
	default y
	help
	  Test ACONFIG HWID-based configuration loading.

	  Coverage:
	    - ACONFIG_FindTableByHWID (universal, specific, no table)
	    - ACONFIG_LoadByHWID (with/without PDL support)
	    - HWID structure field validation
	    - HWID matching edge cases
	    - Multiple HWID support lists
	    - Universal table (hwid_count=0) matching

	  Runtime: <100ms
	  Hardware: None
	  Dependencies: CONFIG_ACONFIG
	  Tags: fast
	  Test file: test_aconfig_hwid.c

endmenu

endif # TEST_ACONFIG
```
