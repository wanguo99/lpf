## products/ccm_product/configs/h200_200p_defconfig
```kconfig
# H200-200P Product Configuration
# 旗舰型号：启用所有应用

# 启用的应用
CONFIG_APP_COLLECTOR=y
CONFIG_APP_COMM=y
CONFIG_APP_HEALTH=y
CONFIG_APP_LOGGER=y
CONFIG_APP_SUPERVISOR=y

# SDK 组件（必需）
CONFIG_OSAL=y
CONFIG_HAL=y
CONFIG_PCL=y
CONFIG_PDL=y
CONFIG_ACL=y

# 产品组件（必需）
CONFIG_H200_AM625=y
CONFIG_LIBCCM=y

# 平台配置
CONFIG_OS_LINUX=y
CONFIG_ARCH_ARM64=y
CONFIG_PCL_PLATFORM_TI_AM625=y
CONFIG_PCL_PRODUCT_H200_200P=y
```

## products/core-tests/performance/aconfig/Config.in
```kconfig
# ACL Performance Test Configuration
#
# Measures application configuration layer performance.
# Tests telecommand/telemetry mapping and processing speed.

if TEST_PERFORMANCE_ACL

menu "ACL Performance Tests"

config TEST_PERF_ACL_TC
	bool "Telecommand processing performance tests"
	default n
	help
	  Telecommand mapping and validation speed benchmarks.

	  Measures:
	    - TC ID lookup latency
	    - Parameter validation overhead
	    - Command routing performance
	    - TC queue processing throughput

	  Runtime: 2-3 seconds
	  Hardware: None
	  Dependencies: CONFIG_ACL
	  Tags: performance, telecommand
	  Test file: test_perf_aconfig_tc.c

config TEST_PERF_ACL_TM
	bool "Telemetry collection performance tests"
	default n
	help
	  Telemetry mapping and collection speed benchmarks.

	  Measures:
	    - TM ID lookup latency
	    - Data format conversion overhead
	    - Telemetry aggregation performance
	    - High-frequency sampling throughput

	  Runtime: 2-3 seconds
	  Hardware: None
	  Dependencies: CONFIG_ACL
	  Tags: performance, telemetry
	  Test file: test_perf_aconfig_tm.c

endmenu

endif # TEST_PERFORMANCE_ACL
```

## products/ctest/Config.in
```kconfig
# ============================================================================
# Core Modules Test Suite Configuration
# ============================================================================
# This test product provides comprehensive testing for all core SDK modules:
#   - OSAL (Operating System Abstraction Layer)
#   - HAL (Hardware Abstraction Layer)
#   - PDI (Peripheral Driver Interface)
#   - PCONFIG (Platform Configuration)
#   - ACONFIG (Application Configuration)
#
# Test categories:
#   - Unit: Individual component/function testing
#   - Performance: Benchmarking and profiling
#   - Stress: Stability and resource exhaustion testing
#   - System: Integration and end-to-end testing
# ============================================================================

config TEST_UNIT
	bool "Build unit tests"
	depends on BUILD_TESTING
	default n
	help
	  Build unit tests for all modules.
	  Unit tests verify individual functions and components in isolation.

if TEST_UNIT

config TEST_OSAL
	bool "Build OSAL unit tests"
	select OSAL
	default n
	help
	  Build OSAL layer unit tests.
	  This will automatically enable the OSAL module.

	  Fine-grained control over individual OSAL test files is available
	  in the OSAL Unit Tests submenu.

config TEST_HAL
	bool "Build HAL unit tests"
	depends on OSAL  # HAL depends on OSAL
	select HAL
	default n
	help
	  Build HAL layer unit tests.
	  This will automatically enable the HAL module.

	  Note: HAL requires OSAL, so enable OSAL first.

	  Fine-grained control over individual HAL test files is available
	  in the HAL Unit Tests submenu.

config TEST_PDI
	bool "Build PDI unit tests"
	depends on OSAL
	select PDI
	default n
	help
	  Build PDI userspace API unit tests.
	  This will automatically enable the PDI module.

	  PDI wraps the ioctl ABI exposed by the kernel PDM module. These
	  unit tests cover userspace API validation and do not require the
	  kernel module to be loaded.

	  Fine-grained control over individual PDI test files is available
	  in the PDI Unit Tests submenu.

config TEST_PDM
	bool "Build PDM internal unit tests"
	depends on PDM
	default n
	help
	  Build PDM internal unit tests.

	  These tests cover PDM-owned implementation details that are linked
	  into pdm.ko, such as the internal peripheral protocol. They are not
	  tests for the userspace PDI ioctl API.

	  Fine-grained control over individual PDM test files is available
	  in the PDM Unit Tests submenu.

config TEST_ACONFIG
	bool "Build ACONFIG unit tests"
	depends on OSAL  # ACONFIG dependency
	select ACONFIG
	default n
	help
	  Build ACONFIG layer unit tests.
	  This will automatically enable the ACONFIG module.

	  Note: ACONFIG requires OSAL, so enable OSAL first.

	  Fine-grained control over individual ACONFIG test files is available
	  in the ACONFIG Unit Tests submenu.

config TEST_PCONFIG
	bool "Build PCONFIG unit tests"
	depends on OSAL  # PCONFIG basic dependency
	select PCONFIG
	default n
	help
	  Build PCONFIG layer unit tests.
	  This will automatically enable the PCONFIG module.

	  Note: PCONFIG requires OSAL.

	  Fine-grained control over individual PCONFIG test files is available
	  in the PCONFIG Unit Tests submenu.

# Source fine-grained unit test configurations
source "products/ctest/unit/Config.in"

endif # TEST_UNIT

config TEST_PERFORMANCE
	bool "Build performance tests"
	depends on BUILD_TESTING
	default n
	help
	  Build performance tests for all modules.
	  Performance tests measure throughput, latency, and resource usage.

if TEST_PERFORMANCE

config TEST_PERFORMANCE_OSAL
	bool "Build OSAL performance tests"
	select OSAL
	default y
	help
	  Build OSAL layer performance tests.

config TEST_PERFORMANCE_HAL
	bool "Build HAL performance tests"
	select HAL
	default y
	help
	  Build HAL layer performance tests.

config TEST_PERFORMANCE_PCONFIG
	bool "Build PCONFIG performance tests"
	depends on OSAL  # PCONFIG dependency
	select PCONFIG
	default n
	help
	  Build PCONFIG layer performance tests.

	  Note: PCONFIG requires OSAL.

config TEST_PERFORMANCE_ACONFIG
	bool "Build ACONFIG performance tests"
	select ACONFIG
	default n
	help
	  Build ACONFIG layer performance tests.

# Source fine-grained performance test configurations
source "products/ctest/performance/Config.in"

endif # TEST_PERFORMANCE

config TEST_STRESS
	bool "Build stress tests"
	depends on BUILD_TESTING
	default n
	help
	  Build stress tests for all modules.
	  Stress tests verify system behavior under heavy load and extremes.

if TEST_STRESS

config TEST_STRESS_OSAL
	bool "Build OSAL stress tests"
	select OSAL
	default n
	help
	  Build OSAL layer stress tests.

config TEST_STRESS_HAL
	bool "Build HAL stress tests"
	select HAL
	default n
	help
	  Build HAL layer stress tests.

config TEST_STRESS_PCONFIG
	bool "Build PCONFIG stress tests"
	depends on OSAL  # PCONFIG dependency
	select PCONFIG
	default n
	help
	  Build PCONFIG layer stress tests.

	  Note: PCONFIG requires OSAL.

config TEST_STRESS_ACONFIG
	bool "Build ACONFIG stress tests"
	select ACONFIG
	default n
	help
	  Build ACONFIG layer stress tests.

# Source fine-grained stress test configurations
source "products/ctest/stress/Config.in"

endif # TEST_STRESS

config TEST_SYSTEM
	bool "Build system tests"
	depends on BUILD_TESTING
	default n
	help
	  Build system tests for all modules.
	  System tests verify end-to-end functionality and module interactions.

if TEST_SYSTEM

config TEST_SYSTEM_OSAL
	bool "Build OSAL system tests"
	select OSAL
	default n
	help
	  Build OSAL layer system tests.

config TEST_SYSTEM_HAL
	bool "Build HAL system tests"
	select HAL
	default n
	help
	  Build HAL layer system tests.

config TEST_SYSTEM_PCONFIG
	bool "Build PCONFIG system tests"
	depends on OSAL  # PCONFIG dependency
	select PCONFIG
	default n
	help
	  Build PCONFIG layer system tests.

	  Note: PCONFIG requires OSAL.

config TEST_SYSTEM_ACONFIG
	bool "Build ACONFIG system tests"
	select ACONFIG
	default n
	help
	  Build ACONFIG layer system tests.

config TEST_INTEGRATION
	bool "Build integration tests"
	default n
	help
	  Build integration tests verifying interactions between modules.

# Source fine-grained system and integration test configurations
source "products/ctest/system/Config.in"

endif # TEST_SYSTEM
```

## products/ctest/performance/Config.in
```kconfig
# Performance Test Configuration
#
# Performance tests measure throughput, latency, and resource usage
# under typical and high-load conditions.
#
# Organization:
#   - performance/Config.in (this file) - Entry point, sources layer configs
#   - performance/osal/Config.in - OSAL performance tests
#   - performance/hal/Config.in - HAL performance tests
#   - performance/pdl/Config.in - PDL performance tests
#   - performance/pconfig/Config.in - PCONFIG performance tests
#   - performance/aconfig/Config.in - ACONFIG performance tests

if TEST_PERFORMANCE

menu "Performance Tests"

config TEST_PERFORMANCE_ALL
	bool "Enable all performance tests"
	default y
	select TEST_PERFORMANCE_OSAL if TEST_OSAL
	select TEST_PERFORMANCE_HAL if TEST_HAL
	select TEST_PERFORMANCE_PDL if TEST_PDL
	select TEST_PERFORMANCE_PCONFIG if TEST_PCONFIG
	select TEST_PERFORMANCE_ACONFIG if TEST_ACONFIG
	help
	  Enable all performance tests at once.
	  Disabling this allows individual layer selection below.

	  Performance tests measure:
	    - Throughput (operations per second)
	    - Latency (min/max/avg/p99)
	    - Resource usage (CPU, memory)
	    - Scalability under load

	  Runtime: Varies by test (typically 1-10 seconds per test)
	  Tags: slow, performance

# Source layer-specific Config.in files
if TEST_OSAL
	source "products/ctest/performance/osal/Config.in"
endif

if TEST_HAL
	source "products/ctest/performance/hal/Config.in"
endif

if TEST_PDL
	source "products/ctest/performance/pdl/Config.in"
endif

if TEST_PCONFIG
	source "products/ctest/performance/pconfig/Config.in"
endif

if TEST_ACONFIG
	source "products/ctest/performance/aconfig/Config.in"
endif

endmenu

endif # TEST_PERFORMANCE
```

## products/ctest/performance/aconfig/Config.in
```kconfig
# ACONFIG Performance Test Configuration
#
# Measures application configuration layer performance.
# Tests telecommand/telemetry mapping and processing speed.

if TEST_PERFORMANCE_ACONFIG

menu "ACONFIG Performance Tests"

config TEST_PERF_ACONFIG
	bool "ACONFIG performance tests"
	default y
	help
	  Application configuration layer performance benchmarks.

	  Measures:
	    - TC/TM lookup performance
	    - Configuration query latency
	    - Mapping table performance

	  Runtime: 2-3 seconds
	  Hardware: None
	  Dependencies: CONFIG_ACONFIG
	  Tags: performance, aconfig
	  Test file: test_perf_aconfig.c

config TEST_PERF_ACONFIG_TC
	bool "Telecommand processing performance tests"
	default n
	help
	  Telecommand mapping and validation speed benchmarks.

	  Measures:
	    - TC ID lookup latency
	    - Parameter validation overhead
	    - Command routing performance
	    - TC queue processing throughput

	  Runtime: 2-3 seconds
	  Hardware: None
	  Dependencies: CONFIG_ACONFIG
	  Tags: performance, telecommand
	  Test file: test_perf_aconfig_tc.c

config TEST_PERF_ACONFIG_TM
	bool "Telemetry collection performance tests"
	default n
	help
	  Telemetry mapping and collection speed benchmarks.

	  Measures:
	    - TM ID lookup latency
	    - Data format conversion overhead
	    - Telemetry aggregation performance
	    - High-frequency sampling throughput

	  Runtime: 2-3 seconds
	  Hardware: None
	  Dependencies: CONFIG_ACONFIG
	  Tags: performance, telemetry
	  Test file: test_perf_aconfig_tm.c

endmenu

endif # TEST_PERFORMANCE_ACONFIG
```

## products/ctest/performance/osal/Config.in
```kconfig
# OSAL Performance Test Configuration
#
# Measures OSAL component performance under load.
# Tests measure throughput, latency, and scalability.

if TEST_PERFORMANCE_OSAL

menu "OSAL Performance Tests"

config TEST_PERF_OSAL
	bool "OSAL综合性能测试"
	default y
	help
	  OSAL层综合性能测试套件。

	  测试内容：
	    - 基础API性能基准测试
	    - 跨模块集成性能测试
	    - 常见使用场景性能验证

	  运行时间: 3-5 秒
	  硬件要求: 无
	  依赖项: CONFIG_OSAL
	  标签: performance, osal
	  测试文件: test_perf_osal.c

config TEST_PERF_OSAL_MUTEX
	bool "Mutex performance tests"
	default n
	help
	  Dedicated mutex performance tests.

	  Measures:
	    - Lock/unlock latency (uncontended)
	    - Lock contention overhead
	    - Trylock performance
	    - Recursive mutex overhead
	    - Priority inheritance impact

	  Runtime: 2-3 seconds
	  Hardware: None
	  Dependencies: CONFIG_OSAL
	  Tags: performance, mutex
	  Test file: test_perf_osal_mutex.c

config TEST_PERF_OSAL_THREAD
	bool "Thread performance tests"
	default n
	help
	  Thread creation, scheduling, and context switching performance.

	  Measures:
	    - Thread creation time
	    - Thread join overhead
	    - Context switch latency
	    - Thread-local storage access time
	    - Scheduler overhead

	  Runtime: 3-5 seconds
	  Hardware: None
	  Dependencies: CONFIG_OSAL
	  Tags: performance, threading
	  Test file: test_perf_osal_thread.c

config TEST_PERF_OSAL_SEMAPHORE
	bool "Semaphore performance tests"
	default n
	help
	  Semaphore performance benchmarks.

	  Measures:
	    - Post/wait latency
	    - Trywait overhead
	    - Timed wait performance
	    - Multi-thread contention

	  Runtime: 2-3 seconds
	  Hardware: None
	  Dependencies: CONFIG_OSAL
	  Tags: performance, ipc
	  Test file: test_perf_osal_semaphore.c

config TEST_PERF_OSAL_COND
	bool "Condition variable performance tests"
	default n
	help
	  Condition variable performance benchmarks.

	  Measures:
	    - Signal latency
	    - Broadcast overhead
	    - Wait/timed wait performance
	    - Predicate evaluation overhead

	  Runtime: 2-3 seconds
	  Hardware: None
	  Dependencies: CONFIG_OSAL
	  Tags: performance, ipc
	  Test file: test_perf_osal_cond.c

config TEST_PERF_OSAL_HEAP
	bool "Heap memory performance tests"
	default n
	help
	  Memory allocation/deallocation performance.

	  Measures:
	    - malloc/free throughput
	    - calloc performance
	    - realloc overhead
	    - Small vs large allocation patterns
	    - Memory fragmentation impact

	  Runtime: 2-4 seconds
	  Hardware: None
	  Dependencies: CONFIG_OSAL
	  Tags: performance, memory
	  Test file: test_perf_osal_heap.c

config TEST_PERF_OSAL_FILE
	bool "File I/O performance tests"
	default n
	help
	  File system operation performance.

	  Measures:
	    - Sequential read/write throughput
	    - Random access performance
	    - Open/close overhead
	    - Seek operation latency
	    - Sync/fsync impact

	  Runtime: 3-5 seconds
	  Hardware: Requires filesystem
	  Dependencies: CONFIG_OSAL
	  Tags: performance, filesystem, slow
	  Test file: test_perf_osal_file.c

config TEST_PERF_OSAL_ATOMIC
	bool "Atomic operation performance tests"
	default n
	help
	  Atomic operation throughput benchmarks.

	  Measures:
	    - Atomic load/store performance
	    - Atomic add/sub throughput
	    - Compare-and-swap latency
	    - Different sizes (8/16/32/64-bit)

	  Runtime: 1-2 seconds
	  Hardware: None
	  Dependencies: CONFIG_OSAL
	  Tags: performance, atomic
	  Test file: test_perf_osal_atomic.c

config TEST_PERF_OSAL_TIME
	bool "Time operation performance tests"
	default n
	help
	  Time and clock operation performance.

	  Measures:
	    - gettimeofday overhead
	    - clock_gettime latency
	    - Sleep accuracy and overhead
	    - Timer resolution

	  Runtime: 2-3 seconds
	  Hardware: None
	  Dependencies: CONFIG_OSAL
	  Tags: performance, timing
	  Test file: test_perf_osal_time.c

endmenu

endif # TEST_PERFORMANCE_OSAL
```
