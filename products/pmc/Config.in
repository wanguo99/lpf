## products/pmc/Config.in
```kconfig
# ============================================================================
# PMC Product Configuration
# ============================================================================
# PMC (Central Control Module) is a satellite payload control and data
# management system designed for H200 platform with AM625 SoC.
# ============================================================================

menu "PMC Product"

# ============================================================================
# Platform Configuration
# ============================================================================

menu "Platform Configuration"

choice
    prompt "Select Platform"
    default PROJECT_H200_100P_AM625
    help
      Select the hardware platform for PMC product.

config PROJECT_H200_100P_AM625
    bool "H200 100P AM625 Platform"
    help
      TI AM625 SoC based H200 100P carrier board.
      Provides ACONFIG and PCONFIG configuration for AM625 platform.

config PROJECT_H200_200P
    bool "H200 200P Platform"
    help
      H200 200P platform configuration.

endchoice

# Note: PROJECT_NAME is defined globally in the root Config.in
# It automatically derives the correct value based on the platform choice above.

endmenu

# ============================================================================
# Product Components
# ============================================================================

menu "Product Libraries"

source "products/pmc/libs/libpmc/Config.in"

endmenu

# ============================================================================
# Applications
# ============================================================================

menu "Applications"

source "products/pmc/apps/app_collector/Config.in"
source "products/pmc/apps/app_comm/Config.in"
source "products/pmc/apps/app_health/Config.in"
source "products/pmc/apps/app_logger/Config.in"
source "products/pmc/apps/app_supervisor/Config.in"

# Test Application (Debug/Verification)
source "products/pmc/apps/test_call_chain/Config.in"

endmenu

endmenu
```

## products/pmc/apps/app_collector/Config.in
```kconfig
config APP_COLLECTOR
    bool "Enable PMC Collector Application"
    default n
    select OSAL
    select HAL
    select PCONFIG
    select PDL
    select ACONFIG
    select H200_AM625
    select LIBPMC
    help
      PMC data collector application.
      Collects telemetry data from satellite and stores locally.
```

## products/pmc/apps/app_comm/Config.in
```kconfig
config APP_COMM
    bool "Enable PMC Communication Application"
    default n
    select OSAL
    select HAL
    select PCONFIG
    select PDL
    select ACONFIG
    select H200_AM625
    select LIBPMC
    help
      PMC communication application.
      Handles communication between satellite platform and ground station.
```

## products/pmc/apps/app_health/Config.in
```kconfig
config APP_HEALTH
    bool "Enable PMC Health Monitor Application"
    default n
    select OSAL
    select HAL
    select PCONFIG
    select PDL
    select ACONFIG
    select H200_AM625
    select LIBPMC
    help
      PMC health monitoring application.
      Monitors system health and reports status.
```

## products/pmc/apps/app_logger/Config.in
```kconfig
config APP_LOGGER
    bool "Enable PMC Logger Application"
    default n
    select OSAL
    select HAL
    select PCONFIG
    select PDL
    select ACONFIG
    select H200_AM625
    select LIBPMC
    help
      PMC logging application.
      Manages system logs and diagnostic data.
```

## products/pmc/apps/app_supervisor/Config.in
```kconfig
config APP_SUPERVISOR
    bool "Enable PMC Supervisor Application"
    default n
    select OSAL
    select HAL
    select PCONFIG
    select PDL
    select ACONFIG
    select H200_AM625
    select LIBPMC
    help
      PMC supervisor application.
      Supervises and manages other PMC applications.
```

## products/pmc/libs/libpmc/Config.in
```kconfig
config LIBPMC
    bool "Enable libpmc (PMC Product Library)"
    default y
    select OSAL
    help
      PMC product library providing IPC and protocol support.
      This is a product-specific component for PMC applications.

config LIBPMC_BUILD_SHARED
    bool "Build libpmc as shared library"
    depends on LIBPMC
    default n
    help
      Build libpmc as a shared library (.so) instead of static library (.a).
```

## products/sample/apps/app_demo/Kconfig
```kconfig
config APP_DEMO
    bool "Enable Sample Demo Application"
    default y
    select OSAL
    help
      Sample demo application for demonstration purposes.
      This is a minimal example showing how to create a new application.
```

## products/sample/configs/default_defconfig
```kconfig
# Sample Product Default Configuration

# Core Components
CONFIG_OSAL=y
CONFIG_HAL=n
CONFIG_PCL=n
CONFIG_PDL=n
CONFIG_ACL=n

# Applications
CONFIG_APP_DEMO=y

# Build Options
CONFIG_BUILD_SHARED=y
CONFIG_BUILD_TESTING=n

# Platform
CONFIG_ARCH_X86_64=y
CONFIG_OS_LINUX=y
```

## products/samples/Kconfig
```kconfig
# 示例模块配置

config MYLIB
	bool "Enable mylib (sample library)"
	default n
	help
	  This is a sample library template.
	  Copy and modify it to create your own library.

if MYLIB

config MYLIB_BUILD_STATIC
	bool "Build static library"
	default y
	help
	  Build libmylib.a static library.

config MYLIB_BUILD_SHARED
	bool "Build shared library"
	default y
	help
	  Build libmylib.so shared library.

endif # MYLIB

config BUILD_MYAPP
	bool "Build myapp (sample application)"
	default n
	help
	  This is a sample application template.
	  Copy and modify it to create your own application.
```

## products/tests/performance/Config.in
```kconfig
# Performance Test Configuration
#
# Performance tests measure throughput, latency, and resource usage
# under typical and high-load conditions.
#
# Organization:
#   - performance/Config.in (this file) - Entry point, sources layer configs
#   - performance/osal/Config.in - OSAL performance tests
#   - performance/hal/Config.in - HAL performance tests
#   - performance/pdl/Config.in - PDL performance tests
#   - performance/pcl/Config.in - PCL performance tests
#   - performance/acl/Config.in - ACL performance tests

if TEST_PERFORMANCE

menu "Performance Tests"

config TEST_PERFORMANCE_ALL
	bool "Enable all performance tests"
	default y
	select TEST_PERFORMANCE_OSAL if TEST_OSAL
	select TEST_PERFORMANCE_HAL if TEST_HAL
	select TEST_PERFORMANCE_PDL if TEST_PDL
	select TEST_PERFORMANCE_PCL if TEST_PCL
	select TEST_PERFORMANCE_ACL if TEST_ACL
	help
	  Enable all performance tests at once.
	  Disabling this allows individual layer selection below.

	  Performance tests measure:
	    - Throughput (operations per second)
	    - Latency (min/max/avg/p99)
	    - Resource usage (CPU, memory)
	    - Scalability under load

	  Runtime: Varies by test (typically 1-10 seconds per test)
	  Tags: slow, performance

# Source layer-specific Config.in files
if TEST_OSAL
	source "products/tests/performance/osal/Config.in"
endif

if TEST_HAL
	source "products/tests/performance/hal/Config.in"
endif

if TEST_PDL
	source "products/tests/performance/pdl/Config.in"
endif

if TEST_PCL
	source "products/tests/performance/pcl/Config.in"
endif

if TEST_ACL
	source "products/tests/performance/acl/Config.in"
endif

endmenu

endif # TEST_PERFORMANCE
```

## products/tests/performance/Kconfig
```kconfig
# Performance Test Configuration
#
# Performance tests measure throughput, latency, and resource usage
# under typical and high-load conditions.
#
# Organization:
#   - performance/Kconfig (this file) - Entry point, sources layer configs
#   - performance/osal/Kconfig - OSAL performance tests
#   - performance/hal/Kconfig - HAL performance tests
#   - performance/pdl/Kconfig - PDL performance tests
#   - performance/pcl/Kconfig - PCL performance tests
#   - performance/acl/Kconfig - ACL performance tests

if TEST_PERFORMANCE

menu "Performance Tests"

config TEST_PERFORMANCE_ALL
	bool "Enable all performance tests"
	default y
	select TEST_PERFORMANCE_OSAL if TEST_OSAL
	select TEST_PERFORMANCE_HAL if TEST_HAL
	select TEST_PERFORMANCE_PDL if TEST_PDL
	select TEST_PERFORMANCE_PCL if TEST_PCL
	select TEST_PERFORMANCE_ACL if TEST_ACL
	help
	  Enable all performance tests at once.
	  Disabling this allows individual layer selection below.

	  Performance tests measure:
	    - Throughput (operations per second)
	    - Latency (min/max/avg/p99)
	    - Resource usage (CPU, memory)
	    - Scalability under load

	  Runtime: Varies by test (typically 1-10 seconds per test)
	  Tags: slow, performance

# Source layer-specific Kconfig files
if TEST_OSAL
	source "products/tests/performance/osal/Kconfig"
endif

if TEST_HAL
	source "products/tests/performance/hal/Kconfig"
endif

if TEST_PDL
	source "products/tests/performance/pdl/Kconfig"
endif

if TEST_PCL
	source "products/tests/performance/pcl/Kconfig"
endif

if TEST_ACL
	source "products/tests/performance/acl/Kconfig"
endif

endmenu

endif # TEST_PERFORMANCE
```

## products/tests/performance/hal/Config.in
```kconfig
# HAL Performance Test Configuration
#
# Measures HAL driver performance and throughput.
# Tests hardware abstraction layer efficiency.

if TEST_PERFORMANCE_HAL

menu "HAL Performance Tests"

config TEST_PERF_HAL
	bool "HAL综合性能测试"
	default y
	help
	  HAL层综合性能测试套件。

	  测试内容：
	    - 各驱动基础性能基准测试
	    - 跨驱动集成性能测试
	    - 硬件抽象层开销测试

	  运行时间: 3-5 秒
	  硬件要求: 推荐有对应硬件，但可在无硬件环境运行
	  依赖项: CONFIG_HAL
	  标签: performance, hal
	  测试文件: test_perf_hal.c

config TEST_PERF_HAL_CAN
	bool "CAN bus performance tests"
	default n
	help
	  CAN bus throughput and latency benchmarks.

	  Measures:
	    - Frame transmission throughput
	    - Reception latency
	    - Filter performance
	    - Error handling overhead
	    - Bus load vs latency

	  Runtime: 3-5 seconds
	  Hardware: CAN transceiver recommended
	  Dependencies: CONFIG_HAL_CAN
	  Tags: performance, hardware, can
	  Test file: test_perf_hal_can.c

config TEST_PERF_HAL_SERIAL
	bool "Serial port performance tests"
	default n
	help
	  UART/serial port performance benchmarks.

	  Measures:
	    - Transmit throughput at various baud rates
	    - Receive buffer handling
	    - Flow control overhead
	    - Character loss under load

	  Runtime: 3-5 seconds
	  Hardware: Serial port or loopback
	  Dependencies: CONFIG_HAL_SERIAL
	  Tags: performance, hardware, serial
	  Test file: test_perf_hal_serial.c

config TEST_PERF_HAL_SPI
	bool "SPI performance tests"
	default n
	help
	  SPI bus transfer performance benchmarks.

	  Measures:
	    - Transfer speed at various clock rates
	    - DMA vs polled mode performance
	    - Chip select overhead
	    - Full-duplex efficiency

	  Runtime: 2-4 seconds
	  Hardware: SPI device recommended
	  Dependencies: CONFIG_HAL_SPI
	  Tags: performance, hardware, spi
	  Test file: test_perf_hal_spi.c

config TEST_PERF_HAL_I2C
	bool "I2C performance tests"
	default n
	help
	  I2C bus transaction performance benchmarks.

	  Measures:
	    - Transaction throughput
	    - Read/write latency
	    - Multi-byte transfer efficiency
	    - Clock stretching impact

	  Runtime: 2-4 seconds
	  Hardware: I2C device recommended
	  Dependencies: CONFIG_HAL_I2C
	  Tags: performance, hardware, i2c
	  Test file: test_perf_hal_i2c.c

config TEST_PERF_HAL_GPIO
	bool "GPIO performance tests"
	default n
	help
	  GPIO operation performance benchmarks.

	  Measures:
	    - Pin toggle frequency
	    - Read operation latency
	    - Interrupt latency
	    - Batch operation efficiency

	  Runtime: 2-3 seconds
	  Hardware: GPIO pins
	  Dependencies: CONFIG_HAL_GPIO
	  Tags: performance, hardware, gpio
	  Test file: test_perf_hal_gpio.c

config TEST_PERF_HAL_WATCHDOG
	bool "Watchdog timer performance tests"
	default n
	help
	  Watchdog timer performance benchmarks.

	  Measures:
	    - Kick operation overhead
	    - Timer accuracy
	    - Configuration latency

	  Runtime: 1-2 seconds
	  Hardware: Watchdog hardware
	  Dependencies: CONFIG_HAL_WATCHDOG
	  Tags: performance, hardware, watchdog
	  Test file: test_perf_hal_watchdog.c

endmenu

endif # TEST_PERFORMANCE_HAL
```

## products/tests/performance/osal/Kconfig
```kconfig
# OSAL Performance Test Configuration
#
# Measures OSAL component performance under load.
# Tests measure throughput, latency, and scalability.

if TEST_PERFORMANCE_OSAL

menu "OSAL Performance Tests"

config TEST_PERF_OSAL_MUTEX
	bool "Mutex performance tests"
	default n
	help
	  Dedicated mutex performance tests.

	  Measures:
	    - Lock/unlock latency (uncontended)
	    - Lock contention overhead
	    - Trylock performance
	    - Recursive mutex overhead
	    - Priority inheritance impact

	  Runtime: 2-3 seconds
	  Hardware: None
	  Dependencies: CONFIG_OSAL
	  Tags: performance, mutex
	  Test file: test_perf_osal_mutex.c

config TEST_PERF_OSAL_THREAD
	bool "Thread performance tests"
	default n
	help
	  Thread creation, scheduling, and context switching performance.

	  Measures:
	    - Thread creation time
	    - Thread join overhead
	    - Context switch latency
	    - Thread-local storage access time
	    - Scheduler overhead

	  Runtime: 3-5 seconds
	  Hardware: None
	  Dependencies: CONFIG_OSAL
	  Tags: performance, threading
	  Test file: test_perf_osal_thread.c

config TEST_PERF_OSAL_SEMAPHORE
	bool "Semaphore performance tests"
	default n
	help
	  Semaphore performance benchmarks.

	  Measures:
	    - Post/wait latency
	    - Trywait overhead
	    - Timed wait performance
	    - Multi-thread contention

	  Runtime: 2-3 seconds
	  Hardware: None
	  Dependencies: CONFIG_OSAL
	  Tags: performance, ipc
	  Test file: test_perf_osal_semaphore.c

config TEST_PERF_OSAL_COND
	bool "Condition variable performance tests"
	default n
	help
	  Condition variable performance benchmarks.

	  Measures:
	    - Signal latency
	    - Broadcast overhead
	    - Wait/timed wait performance
	    - Predicate evaluation overhead

	  Runtime: 2-3 seconds
	  Hardware: None
	  Dependencies: CONFIG_OSAL
	  Tags: performance, ipc
	  Test file: test_perf_osal_cond.c

config TEST_PERF_OSAL_HEAP
	bool "Heap memory performance tests"
	default n
	help
	  Memory allocation/deallocation performance.

	  Measures:
	    - malloc/free throughput
	    - calloc performance
	    - realloc overhead
	    - Small vs large allocation patterns
	    - Memory fragmentation impact

	  Runtime: 2-4 seconds
	  Hardware: None
	  Dependencies: CONFIG_OSAL
	  Tags: performance, memory
	  Test file: test_perf_osal_heap.c

config TEST_PERF_OSAL_FILE
	bool "File I/O performance tests"
	default n
	help
	  File system operation performance.

	  Measures:
	    - Sequential read/write throughput
	    - Random access performance
	    - Open/close overhead
	    - Seek operation latency
	    - Sync/fsync impact

	  Runtime: 3-5 seconds
	  Hardware: Requires filesystem
	  Dependencies: CONFIG_OSAL
	  Tags: performance, filesystem, slow
	  Test file: test_perf_osal_file.c

config TEST_PERF_OSAL_ATOMIC
	bool "Atomic operation performance tests"
	default n
	help
	  Atomic operation throughput benchmarks.

	  Measures:
	    - Atomic load/store performance
	    - Atomic add/sub throughput
	    - Compare-and-swap latency
	    - Different sizes (8/16/32/64-bit)

	  Runtime: 1-2 seconds
	  Hardware: None
	  Dependencies: CONFIG_OSAL
	  Tags: performance, atomic
	  Test file: test_perf_osal_atomic.c

config TEST_PERF_OSAL_TIME
	bool "Time operation performance tests"
	default n
	help
	  Time and clock operation performance.

	  Measures:
	    - gettimeofday overhead
	    - clock_gettime latency
	    - Sleep accuracy and overhead
	    - Timer resolution

	  Runtime: 2-3 seconds
	  Hardware: None
	  Dependencies: CONFIG_OSAL
	  Tags: performance, timing
	  Test file: test_perf_osal_time.c

endmenu

endif # TEST_PERFORMANCE_OSAL
```
