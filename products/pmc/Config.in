## products/tests/system/hal/Config.in
```kconfig
# HAL System Test Configuration
#
# Cross-driver integration tests for HAL components.
# Tests multi-device scenarios and driver interactions.

if TEST_SYSTEM_HAL

menu "HAL System Tests"

config TEST_HAL_CONCURRENT_ACCESS
	bool "Concurrent multi-driver access test"
	default y
	help
	  Standalone test for concurrent HAL driver access.

	  Tests:
	    - All HAL drivers active simultaneously
	    - Concurrent operations from multiple threads
	    - Interrupt storm handling
	    - Resource contention resolution
	    - Error propagation across drivers

	  Verifies:
	    - System stability under full load
	    - No driver interference
	    - Correct error isolation
	    - Resource cleanup after errors

	  Runtime: 10-20 seconds
	  Hardware: All available HAL devices
	  Dependencies: CONFIG_HAL
	  Tags: integration, hardware, concurrency
	  Test file: test_hal_concurrent_access.c
	  Note: Compiled as separate executable (has own main)

config TEST_SYSTEM_HAL_CAN_SERIAL
	bool "CAN + Serial integration tests"
	default n
	help
	  Concurrent CAN and Serial communication.

	  Tests:
	    - Simultaneous CAN TX + Serial TX
	    - Interrupt priority between CAN and Serial
	    - Buffer management with both active
	    - Error handling coordination

	  Verifies:
	    - No message loss on either bus
	    - Correct interrupt prioritization
	    - Independent error handling

	  Runtime: 5-10 seconds
	  Hardware: CAN + Serial devices
	  Dependencies: CONFIG_HAL_CAN, CONFIG_HAL_SERIAL
	  Tags: integration, hardware, can, serial
	  Test file: test_system_hal_can_serial.c

config TEST_SYSTEM_HAL_SPI_I2C
	bool "SPI + I2C integration tests"
	default n
	help
	  Concurrent SPI and I2C operations.

	  Tests:
	    - Simultaneous SPI + I2C transfers
	    - Shared DMA resource arbitration
	    - Concurrent device access from threads
	    - Error handling independence

	  Verifies:
	    - Bus independence (no cross-talk)
	    - Correct DMA channel allocation
	    - Data integrity on both buses

	  Runtime: 5-10 seconds
	  Hardware: SPI + I2C devices
	  Dependencies: CONFIG_HAL_SPI, CONFIG_HAL_I2C
	  Tags: integration, hardware, spi, i2c
	  Test file: test_system_hal_spi_i2c.c

config TEST_SYSTEM_HAL_GPIO_INTERRUPT
	bool "GPIO interrupt + Driver interaction tests"
	default n
	help
	  GPIO interrupt handling with other driver operations.

	  Tests:
	    - GPIO IRQ during CAN transmission
	    - GPIO IRQ during Serial communication
	    - GPIO IRQ during SPI transfer
	    - Nested interrupt handling
	    - Interrupt latency with multiple drivers

	  Verifies:
	    - No missed interrupts
	    - Correct interrupt priority enforcement
	    - Driver state consistency after IRQ
	    - Acceptable interrupt latency

	  Runtime: 5-10 seconds
	  Hardware: GPIO + other devices
	  Dependencies: CONFIG_HAL_GPIO, CONFIG_HAL
	  Tags: integration, hardware, gpio, interrupt
	  Test file: test_system_hal_gpio_interrupt.c

config TEST_SYSTEM_HAL_DMA_SHARING
	bool "DMA resource sharing tests"
	default n
	help
	  DMA channel arbitration and sharing between drivers.

	  Tests:
	    - Multiple drivers requesting DMA
	    - DMA channel allocation fairness
	    - Fallback to polled mode when DMA unavailable
	    - DMA error propagation

	  Verifies:
	    - Correct DMA channel management
	    - No DMA conflicts
	    - Graceful degradation without DMA

	  Runtime: 5-10 seconds
	  Hardware: DMA-capable devices
	  Dependencies: CONFIG_HAL
	  Tags: integration, hardware, dma
	  Test file: test_system_hal_dma_sharing.c

endmenu

endif # TEST_SYSTEM_HAL
```
