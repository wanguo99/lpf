## products/tests/system/integration/Config.in
```kconfig
# Integration Test Configuration
#
# Full stack integration tests spanning all layers.
# Tests complete end-to-end system functionality.

if TEST_INTEGRATION

menu "Integration Tests"

config TEST_INTEGRATION_ALL
	bool "Enable all integration tests"
	default y
	select TEST_SYSTEM_INTEGRATION
	select TEST_INTEGRATION_E2E
	select TEST_INTEGRATION_STACK
	select TEST_INTEGRATION_MISSION
	help
	  Enable all full-stack integration tests at once.

	  Integration tests verify the complete system:
	    - All layers working together (ACONFIG→PCONFIG→PDL→PRL→HAL→OSAL)
	    - End-to-end data flows
	    - Real mission scenarios
	    - Cross-layer error handling
	    - System-wide resource management

	  Runtime: 10-60 seconds per test
	  Tags: slow, integration, e2e, heavy

config TEST_SYSTEM_INTEGRATION
	bool "Core integration test suite"
	default y
	help
	  Core full-stack integration tests.

	  Tests:
	    - Complete protocol stack (OSAL→HAL→PRL→PDL→PCL→ACL)
	    - Multi-device coordination
	    - Concurrent operations across all layers
	    - System initialization and shutdown
	    - Configuration loading and application

	  Verifies:
	    - All layers integrate correctly
	    - Data flows through entire stack
	    - No layer boundary issues
	    - System stability end-to-end

	  Runtime: 10-20 seconds
	  Hardware: Mock devices
	  Dependencies: CONFIG_OSAL, CONFIG_HAL, CONFIG_PDL
	  Tags: integration, e2e
	  Test file: test_system_integration.c

config TEST_INTEGRATION_E2E
	bool "End-to-end data flow tests"
	default n
	help
	  Complete data flow validation tests.

	  Tests:
	    - Application data → ... → Wire → ... → Application data
	    - Telecommand: Satellite → CCM → Device → Response → Satellite
	    - Telemetry: Device → CCM → Satellite
	    - Large data transfers end-to-end
	    - Error injection at each layer

	  Verifies:
	    - Data integrity through entire path
	    - Correct layer transitions
	    - Error propagation correctness
	    - Performance meets requirements

	  Runtime: 10-20 seconds
	  Hardware: Mock devices and interfaces
	  Dependencies: All layers
	  Tags: integration, e2e, dataflow
	  Test file: test_integration_e2e.c

config TEST_INTEGRATION_STACK
	bool "Full protocol stack tests"
	default n
	help
	  Complete protocol stack integration.

	  Tests:
	    - OSAL → HAL → PRL encoding → PDL processing → Device
	    - Device → PDL processing → PRL decoding → HAL → OSAL
	    - Error handling at each layer
	    - Resource management across layers
	    - Performance with all layers active

	  Verifies:
	    - Stack operates as designed
	    - No memory leaks across layers
	    - Correct abstraction boundaries
	    - Acceptable end-to-end latency

	  Runtime: 10-20 seconds
	  Hardware: Mock devices
	  Dependencies: CONFIG_OSAL, CONFIG_HAL, CONFIG_PRL, CONFIG_PDL
	  Tags: integration, stack, protocol
	  Test file: test_integration_stack.c

config TEST_INTEGRATION_MISSION
	bool "Mission scenario simulation tests"
	default n
	help
	  Real-world mission scenario simulations.

	  Tests complete mission phases:
	    - System initialization (cold boot)
	    - Device discovery and configuration
	    - Normal operations (TC/TM processing)
	    - Anomaly scenarios (device failure, timeout, error)
	    - Mode transitions (normal, safe, emergency)
	    - System shutdown (graceful)

	  Scenarios:
	    - Power-on self-test (POST)
	    - Nominal data collection
	    - Device failure recovery
	    - Bus error handling
	    - Graceful degradation
	    - Emergency safe mode

	  Verifies:
	    - Mission scenarios complete successfully
	    - Correct state machine behavior
	    - Error recovery works in context
	    - System meets mission requirements

	  Runtime: 30-60 seconds
	  Hardware: Full mock device suite
	  Dependencies: All layers
	  Tags: integration, mission, scenario, heavy, slow
	  Test file: test_integration_mission.c

config TEST_INTEGRATION_PERFORMANCE
	bool "Full system performance tests"
	default n
	help
	  End-to-end system performance validation.

	  Measures:
	    - TC processing latency (end-to-end)
	    - TM collection throughput
	    - Multi-device concurrent operations
	    - CPU and memory usage
	    - Bus utilization
	    - System response time under load

	  Verifies:
	    - Performance meets requirements
	    - System scales with device count
	    - No performance cliffs or anomalies
	    - Resource usage within limits

	  Runtime: 20-40 seconds
	  Hardware: Mock devices
	  Dependencies: All layers
	  Tags: integration, performance, e2e, slow
	  Test file: test_integration_performance.c

config TEST_INTEGRATION_ROBUSTNESS
	bool "System robustness and fault injection tests"
	default n
	help
	  Robustness testing with comprehensive fault injection.

	  Fault injection points:
	    - HAL: Device errors, timeouts, bus failures
	    - PRL: Malformed packets, CRC errors
	    - PDL: Protocol violations, unexpected responses
	    - PCL: Invalid configurations
	    - ACL: Invalid telecommands

	  Tests:
	    - Error isolation (faults don't propagate)
	    - Recovery mechanisms at each layer
	    - System stability during failures
	    - Correct error reporting end-to-end
	    - No resource leaks during error paths

	  Verifies:
	    - System remains stable under faults
	    - Errors properly contained
	    - Recovery mechanisms effective
	    - Diagnostic information accurate

	  Runtime: 20-40 seconds
	  Hardware: Mock devices with error injection
	  Dependencies: All layers
	  Tags: integration, robustness, fault, slow
	  Test file: test_integration_robustness.c

endmenu

endif # TEST_INTEGRATION
```

## products/tests/system/osal/Config.in
```kconfig
# OSAL System Test Configuration
#
# Cross-module integration tests for OSAL components.
# Tests interactions between multiple OSAL subsystems.

if TEST_SYSTEM_OSAL

menu "OSAL System Tests"

config TEST_SYSTEM_OSAL_THREADING_IPC
	bool "Thread + IPC integration tests"
	default n
	help
	  Integration tests for threading with IPC mechanisms.

	  Tests:
	    - Producer-consumer pattern with pipes
	    - Thread pool with semaphore coordination
	    - Shared memory access from multiple threads
	    - Condition variable wakeup patterns
	    - Signal delivery to specific threads

	  Verifies:
	    - Correct thread synchronization
	    - IPC data integrity
	    - Deadlock-free operation
	    - Wakeup reliability

	  Runtime: 5-10 seconds
	  Hardware: None
	  Dependencies: CONFIG_OSAL
	  Tags: integration, threading, ipc
	  Test file: test_system_osal_threading_ipc.c

config TEST_SYSTEM_OSAL_FILE_THREAD
	bool "File I/O + Threading integration tests"
	default n
	help
	  Concurrent file operations from multiple threads.

	  Tests:
	    - Multiple threads reading same file
	    - Multiple threads writing to separate files
	    - File locking coordination
	    - Directory iteration from threads
	    - File descriptor passing via IPC

	  Verifies:
	    - Thread-safe file operations
	    - No file corruption
	    - Correct file position tracking
	    - Proper fd cleanup

	  Runtime: 5-10 seconds
	  Hardware: Requires filesystem
	  Dependencies: CONFIG_OSAL
	  Tags: integration, filesystem, threading
	  Test file: test_system_osal_file_thread.c

config TEST_SYSTEM_OSAL_PROCESS_IPC
	bool "Process + IPC integration tests"
	default n
	help
	  Inter-process communication tests.

	  Tests:
	    - Parent-child communication via pipes
	    - Shared memory between processes
	    - Semaphore-based process synchronization
	    - Signal-based process coordination
	    - Process group operations

	  Verifies:
	    - Correct IPC across process boundaries
	    - Process cleanup on exit
	    - Signal delivery to processes
	    - Shared resource cleanup

	  Runtime: 5-10 seconds
	  Hardware: None
	  Dependencies: CONFIG_OSAL
	  Tags: integration, process, ipc
	  Test file: test_system_osal_process_ipc.c

config TEST_SYSTEM_OSAL_REALTIME
	bool "Real-time scheduling integration tests"
	default n
	help
	  Real-time thread scheduling and priority tests.

	  Tests:
	    - RT thread priority enforcement
	    - Priority inheritance with mutexes
	    - CPU affinity with RT threads
	    - RT thread + Timer interaction
	    - Scheduler policy interactions

	  Verifies:
	    - Priority ordering correctness
	    - Priority inversion avoidance
	    - Deterministic wakeup latency
	    - CPU affinity enforcement

	  Runtime: 5-10 seconds
	  Hardware: None (RT scheduler may not be available)
	  Dependencies: CONFIG_OSAL
	  Tags: integration, realtime, scheduling
	  Test file: test_system_osal_realtime.c

endmenu

endif # TEST_SYSTEM_OSAL
```

## products/tests/unit/Config.in
```kconfig
# Unit Test Configuration
#
# This file provides fine-grained control over individual unit test files.
# Each test file can be independently enabled/disabled through menuconfig.

if TEST_UNIT

# Source layer-specific Config.in files
source "products/tests/unit/osal/Config.in"
source "products/tests/unit/hal/Config.in"
source "products/tests/unit/pdl/Config.in"
source "products/tests/unit/prl/Config.in"
source "products/tests/unit/pconfig/Config.in"
source "products/tests/unit/aconfig/Config.in"

endif # TEST_UNIT
```

## products/tests/unit/Kconfig
```kconfig
# Unit Test Configuration
#
# This file provides fine-grained control over individual unit test files.
# Each test file can be independently enabled/disabled through menuconfig.

if TEST_UNIT

# Source layer-specific Kconfig files
source "products/tests/unit/osal/Kconfig"
source "products/tests/unit/hal/Kconfig"
source "products/tests/unit/pdl/Kconfig"
source "products/tests/unit/prl/Kconfig"
source "products/tests/unit/pconfig/Kconfig"
source "products/tests/unit/aconfig/Kconfig"

endif # TEST_UNIT
```

## products/tests/unit/aconfig/Kconfig
```kconfig
# ACONFIG Unit Test Configuration
#
# Fine-grained control for individual ACONFIG test files.
# Each option corresponds to a single test_aconfig_*.c file.

if TEST_ACONFIG

menu "ACONFIG Unit Tests"

config TEST_ACONFIG_ALL
	bool "Enable all ACONFIG unit tests"
	default y
	select TEST_ACONFIG_API
	help
	  Enable all ACONFIG unit tests at once.
	  Disabling this allows individual test selection below.

config TEST_ACONFIG_API
	bool "ACONFIG API tests"
	default y
	help
	  Test ACONFIG API operations (init, telecommand lookup, telemetry query).

	  Coverage:
	    - Application configuration initialization
	    - Telecommand (TC) lookup by ID and name
	    - Telemetry (TM) lookup by ID and name
	    - Device mapping (business function to hardware device)
	    - Configuration table iteration
	    - TC/TM enumeration
	    - Runtime configuration queries
	    - Error handling for invalid lookups

	  Runtime: <100ms
	  Hardware: None
	  Dependencies: CONFIG_ACONFIG
	  Tags: fast
	  Test file: test_aconfig_api.c

endmenu

endif # TEST_ACONFIG
```

## products/tests/unit/hal/Config.in
```kconfig
# HAL Unit Test Configuration
#
# Fine-grained control for individual HAL test files.
# Each option corresponds to a single test_hal_*.c file.

if TEST_HAL

menu "HAL Unit Tests"

config TEST_HAL_ALL
	bool "Enable all HAL unit tests"
	default y
	select TEST_HAL_CAN
	select TEST_HAL_GPIO
	select TEST_HAL_I2C
	select TEST_HAL_SERIAL
	select TEST_HAL_SPI
	select TEST_HAL_WATCHDOG
	help
	  Enable all HAL unit tests at once.
	  Disabling this allows individual test selection below.

config TEST_HAL_CAN
	bool "CAN bus tests"
	default y
	help
	  Test HAL CAN bus operations (init, send, receive, filter, error handling).

	  Coverage:
	    - CAN controller initialization and configuration
	    - Message transmission (standard and extended ID)
	    - Message reception with filtering
	    - Error frame handling
	    - Bus-off recovery
	    - Loopback mode testing
	    - Bit timing configuration

	  Runtime: <200ms
	  Hardware: Requires CAN hardware or loopback mode
	  Dependencies: CONFIG_HAL
	  Tags: hardware
	  Test file: test_hal_can.c

config TEST_HAL_GPIO
	bool "GPIO tests"
	default y
	help
	  Test HAL GPIO operations (init, set, get, toggle, interrupt).

	  Coverage:
	    - GPIO pin initialization and configuration
	    - Digital output operations (set, clear, toggle)
	    - Digital input operations (read pin state)
	    - Pin direction control (input/output)
	    - Pull-up/pull-down resistor configuration
	    - GPIO interrupt handling (edge and level triggered)
	    - Debouncing support

	  Runtime: <100ms
	  Hardware: Requires GPIO pins or simulation
	  Dependencies: CONFIG_HAL
	  Tags: hardware
	  Test file: test_hal_gpio.c

config TEST_HAL_I2C
	bool "I2C bus tests"
	default y
	help
	  Test HAL I2C bus operations (init, read, write, transfer).

	  Coverage:
	    - I2C bus initialization and configuration
	    - Master mode operations
	    - 7-bit and 10-bit addressing
	    - Single and multi-byte transfers
	    - Read and write operations
	    - Repeated start conditions
	    - Clock speed configuration
	    - Error detection and recovery

	  Runtime: <200ms
	  Hardware: Requires I2C hardware or simulation
	  Dependencies: CONFIG_HAL
	  Tags: hardware
	  Test file: test_hal_i2c.c

config TEST_HAL_SERIAL
	bool "Serial port tests"
	default y
	help
	  Test HAL serial port operations (init, send, receive, config).

	  Coverage:
	    - Serial port initialization
	    - Baud rate configuration
	    - Data bits, stop bits, parity settings
	    - Flow control (hardware and software)
	    - Synchronous and asynchronous transmission
	    - Receive buffering
	    - Loopback testing
	    - Error handling (framing, parity, overrun)

	  Runtime: <200ms
	  Hardware: Requires UART hardware or loopback
	  Dependencies: CONFIG_HAL
	  Tags: hardware
	  Test file: test_hal_serial.c

config TEST_HAL_SPI
	bool "SPI bus tests"
	default y
	help
	  Test HAL SPI bus operations (init, transfer, config).

	  Coverage:
	    - SPI bus initialization and configuration
	    - Master mode operations
	    - Clock polarity and phase (CPOL, CPHA)
	    - Bit order (MSB/LSB first)
	    - Clock speed configuration
	    - Full-duplex data transfer
	    - Chip select management
	    - Multi-slave support

	  Runtime: <200ms
	  Hardware: Requires SPI hardware or simulation
	  Dependencies: CONFIG_HAL
	  Tags: hardware
	  Test file: test_hal_spi.c

config TEST_HAL_WATCHDOG
	bool "Watchdog timer tests"
	default y
	help
	  Test HAL watchdog timer operations (init, start, stop, feed, timeout).

	  Coverage:
	    - Watchdog timer initialization
	    - Watchdog enable/disable
	    - Watchdog feed (kick) operations
	    - Timeout configuration
	    - Timeout event detection
	    - System reset on timeout
	    - Pre-timeout warnings (if supported)
	    - Watchdog status queries

	  Runtime: <500ms (includes watchdog timeout tests)
	  Hardware: Requires watchdog hardware or simulation
	  Dependencies: CONFIG_HAL
	  Tags: hardware, slow
	  Test file: test_hal_watchdog.c

endmenu

endif # TEST_HAL
```
