## products/tests/unit/prl/Config.in
```kconfig
# PRL Unit Test Configuration
#
# Fine-grained control for individual PRL test files.
# Each option corresponds to a single test_prl_*.c file.

if TEST_PRL

menu "PRL Unit Tests"

config TEST_PRL_ALL
	bool "Enable all PRL unit tests"
	default y
	select TEST_PRL_COMMON
	select TEST_PRL_DEVICE
	help
	  Enable all PRL unit tests at once.
	  Disabling this allows individual test selection below.

config TEST_PRL_COMMON
	bool "PRL common protocol tests"
	default y
	help
	  Test PRL common protocol operations (encode, decode, header, CRC).

	  Coverage:
	    - Protocol header encoding/decoding
	    - CRC16 calculation and validation
	    - Magic number and version validation
	    - Sequence number handling
	    - Timestamp generation and parsing
	    - Packet framing
	    - Error detection mechanisms

	  Runtime: <100ms
	  Hardware: None
	  Dependencies: CONFIG_PRL
	  Tags: fast
	  Test file: test_prl_common.c

config TEST_PRL_DEVICE
	bool "PRL device protocol tests"
	default y
	help
	  Test PRL device-specific protocol operations (MCU, CCM, PMC, GSC, POWER).

	  Coverage:
	    - MCU device protocol (commands, responses, telemetry)
	    - CCM device protocol (system management)
	    - PMC device protocol (payload management)
	    - GSC device protocol (ground station communication)
	    - POWER device protocol (power control)
	    - Device type identification
	    - Message type handling per device
	    - Cross-device communication patterns

	  Runtime: <200ms
	  Hardware: None
	  Dependencies: CONFIG_PRL
	  Tags: fast
	  Test file: test_prl_device.c

endmenu

endif # TEST_PRL
```

## tests/Kconfig
```kconfig
# Test Configuration

config TEST_UNIT
	bool "Build unit tests"
	depends on BUILD_TESTING
	default n
	help
	  Build unit tests for all modules.
	  Unit tests verify individual functions and components in isolation.

if TEST_UNIT

config TEST_OSAL
	bool "Build OSAL unit tests"
	select OSAL
	default n
	help
	  Build OSAL layer unit tests.
	  This will automatically enable the OSAL module.

config TEST_HAL
	bool "Build HAL unit tests"
	select HAL
	default n
	help
	  Build HAL layer unit tests.
	  This will automatically enable the HAL module.

config TEST_PCL
	bool "Build PCL unit tests"
	select PCL
	default n
	help
	  Build PCL layer unit tests.
	  This will automatically enable the PCL module.

config TEST_PDL
	bool "Build PDL unit tests"
	select PDL
	default n
	help
	  Build PDL layer unit tests.
	  This will automatically enable the PDL module.

config TEST_ACL
	bool "Build ACL unit tests"
	select ACL
	default n
	help
	  Build ACL layer unit tests.
	  This will automatically enable the ACL module.

endif # TEST_UNIT

config TEST_PERFORMANCE
	bool "Build performance tests"
	depends on BUILD_TESTING
	default n
	help
	  Build performance tests for all modules.
	  Performance tests measure throughput, latency, and resource usage.

if TEST_PERFORMANCE

config TEST_PERFORMANCE_OSAL
	bool "Build OSAL performance tests"
	select OSAL
	default n
	help
	  Build OSAL layer performance tests.

config TEST_PERFORMANCE_HAL
	bool "Build HAL performance tests"
	select HAL
	default n
	help
	  Build HAL layer performance tests.

config TEST_PERFORMANCE_PCL
	bool "Build PCL performance tests"
	select PCL
	default n
	help
	  Build PCL layer performance tests.

config TEST_PERFORMANCE_PDL
	bool "Build PDL performance tests"
	select PDL
	default n
	help
	  Build PDL layer performance tests.

config TEST_PERFORMANCE_ACL
	bool "Build ACL performance tests"
	select ACL
	default n
	help
	  Build ACL layer performance tests.

endif # TEST_PERFORMANCE

config TEST_STRESS
	bool "Build stress tests"
	depends on BUILD_TESTING
	default n
	help
	  Build stress tests for all modules.
	  Stress tests verify system behavior under heavy load and extreme conditions.

if TEST_STRESS

config TEST_STRESS_OSAL
	bool "Build OSAL stress tests"
	select OSAL
	default n
	help
	  Build OSAL layer stress tests.

config TEST_STRESS_HAL
	bool "Build HAL stress tests"
	select HAL
	default n
	help
	  Build HAL layer stress tests.

config TEST_STRESS_PCL
	bool "Build PCL stress tests"
	select PCL
	default n
	help
	  Build PCL layer stress tests.

config TEST_STRESS_PDL
	bool "Build PDL stress tests"
	select PDL
	default n
	help
	  Build PDL layer stress tests.

config TEST_STRESS_ACL
	bool "Build ACL stress tests"
	select ACL
	default n
	help
	  Build ACL layer stress tests.

endif # TEST_STRESS

config TEST_SYSTEM
	bool "Build system tests"
	depends on BUILD_TESTING
	default n
	help
	  Build system tests for all modules.
	  System tests verify end-to-end functionality and module interactions.

if TEST_SYSTEM

config TEST_SYSTEM_OSAL
	bool "Build OSAL system tests"
	select OSAL
	default n
	help
	  Build OSAL layer system tests.

config TEST_SYSTEM_HAL
	bool "Build HAL system tests"
	select HAL
	default n
	help
	  Build HAL layer system tests.

config TEST_SYSTEM_PCL
	bool "Build PCL system tests"
	select PCL
	default n
	help
	  Build PCL layer system tests.

config TEST_SYSTEM_PDL
	bool "Build PDL system tests"
	select PDL
	default n
	help
	  Build PDL layer system tests.

config TEST_SYSTEM_ACL
	bool "Build ACL system tests"
	select ACL
	default n
	help
	  Build ACL layer system tests.

config TEST_INTEGRATION
	bool "Build integration tests"
	default n
	help
	  Build integration tests that verify interactions between multiple modules.

endif # TEST_SYSTEM
```

## user/pdi/Config.in
```kconfig
# PDI (Peripheral Driver Interface) Configuration

menuconfig PDI
	bool "PDI (Peripheral Driver Interface)"
	default n
	help
	  Userspace API library for LPF kernel peripheral devices.

	  PDI owns the userspace API surface, including device discovery
	  through the LPF control node /dev/pdm_ctl and peripheral APIs such
	  as /dev/lpf/mcuN and /dev/lpf/ledN.

if PDI

config PDI_BUILD_STATIC
	bool "Build static library (.a)"
	default y

config PDI_BUILD_SHARED
	bool "Build shared library (.so)"
	default n

endif # PDI
```
