## configs/x86_64_test_defconfig
```kconfig
#
# EMS x86_64 Test Configuration
# Target: x86_64 Linux
# Purpose: Testing with all test suites enabled
# Optimization: -O2 for realistic performance testing
# Libraries: Both static and shared for comprehensive testing
#

# ============================================================================
# Build Options
# ============================================================================
CONFIG_BUILD_TYPE_DEBUG=y
CONFIG_OPT_O2=y
CONFIG_LIBRARY_BUILD_TYPE_STATIC=y
CONFIG_LIBRARY_BUILD_TYPE_DYNAMIC=y
CONFIG_INSTALL_HEADERS=y

# ============================================================================
# Target Platform
# ============================================================================
CONFIG_ARCH_X86_64=y
CONFIG_OS_LINUX=y
CONFIG_CROSS_COMPILE=""

# ============================================================================
# OSAL (Operating System Abstraction Layer)
# ============================================================================
CONFIG_OSAL=y
CONFIG_OSAL_BUILD_STATIC=y
CONFIG_OSAL_BUILD_SHARED=y

# OSAL Features (All enabled)
CONFIG_OSAL_FILE=y
CONFIG_OSAL_NETWORK=y
CONFIG_OSAL_IPC=y
CONFIG_OSAL_THREAD=y
CONFIG_OSAL_TIME=y
CONFIG_OSAL_SIGNAL=y

# OSAL Resource Limits (Generous for x86_64)
CONFIG_OSAL_MAX_TASKS=256
CONFIG_OSAL_MAX_QUEUES=128
CONFIG_OSAL_MAX_MUTEXES=128

# OSAL Debug
CONFIG_OSAL_DEBUG_LOGGING=y

# ============================================================================
# HAL (Hardware Abstraction Layer)
# ============================================================================
CONFIG_HAL=y
CONFIG_HAL_BUILD_STATIC=y
CONFIG_HAL_BUILD_SHARED=y
CONFIG_PLATFORM_GENERIC_LINUX=y

# HAL Advanced Features (All enabled)
CONFIG_HAL_DEBUG=y
CONFIG_HAL_STATISTICS=y
CONFIG_HAL_POWER_MANAGEMENT=y

# HAL Drivers (All enabled with advanced features)
CONFIG_HAL_CAN=y
CONFIG_HAL_CAN_FILTER=y
CONFIG_HAL_CAN_ERROR_HANDLING=y
CONFIG_HAL_CAN_LOOPBACK=y

CONFIG_HAL_UART=y
CONFIG_HAL_UART_FLOW_CONTROL=y
CONFIG_HAL_UART_RS485=y

CONFIG_HAL_I2C=y
CONFIG_HAL_I2C_SLAVE=y
CONFIG_HAL_I2C_10BIT_ADDR=y

CONFIG_HAL_SPI=y
CONFIG_HAL_SPI_DMA=y
CONFIG_HAL_SPI_SLAVE=y

CONFIG_HAL_GPIO=y
CONFIG_HAL_GPIO_INTERRUPT=y
CONFIG_HAL_GPIO_DEBOUNCE=y

CONFIG_HAL_WATCHDOG=y
CONFIG_HAL_WATCHDOG_PRETIMEOUT=y

# ============================================================================
# PCL (Protocol Control Layer)
# ============================================================================
CONFIG_PCL=y
CONFIG_PCL_BUILD_STATIC=y
CONFIG_PCL_BUILD_SHARED=y

# ============================================================================
# PDL (Protocol Data Layer)
# ============================================================================
CONFIG_PDL=y
CONFIG_PDL_BUILD_STATIC=y
CONFIG_PDL_BUILD_SHARED=y

# PDL Features (All enabled for testing)
CONFIG_PDL_WATCHDOG_SUPPORT=y
CONFIG_PDL_SATELLITE_SUPPORT=y
CONFIG_PDL_BMC_SUPPORT=y
CONFIG_PDL_MCU_SUPPORT=y

# ============================================================================
# ACL (Application Control Layer)
# ============================================================================
CONFIG_ACL=y
CONFIG_ACL_BUILD_STATIC=y
CONFIG_ACL_BUILD_SHARED=y

# ============================================================================
# Products - CCM
# ============================================================================
CONFIG_PRODUCT_CCM=y
CONFIG_PROJECT_H200_AM625=y

# CCM Applications (All enabled)
CONFIG_BUILD_CCM_SUPERVISOR=y
CONFIG_BUILD_CCM_COLLECTOR=y
CONFIG_BUILD_CCM_COMM=y
CONFIG_BUILD_CCM_HEALTH=y
CONFIG_BUILD_CCM_LOGGER=y

# ============================================================================
# Test Configuration
# ============================================================================
CONFIG_BUILD_TESTING=y

# Unit Tests
CONFIG_TEST_UNIT=y
CONFIG_TEST_OSAL=y
CONFIG_TEST_HAL=y
CONFIG_TEST_PCL=y
CONFIG_TEST_PDL=y
CONFIG_TEST_ACL=y

# Performance Tests
CONFIG_TEST_PERFORMANCE=y
CONFIG_TEST_PERFORMANCE_OSAL=y
CONFIG_TEST_PERFORMANCE_HAL=y
CONFIG_TEST_PERFORMANCE_PCL=y
CONFIG_TEST_PERFORMANCE_PDL=y
CONFIG_TEST_PERFORMANCE_ACL=y

# Stress Tests
CONFIG_TEST_STRESS=y
CONFIG_TEST_STRESS_OSAL=y
CONFIG_TEST_STRESS_HAL=y
CONFIG_TEST_STRESS_PCL=y
CONFIG_TEST_STRESS_PDL=y
CONFIG_TEST_STRESS_ACL=y

# System Tests
CONFIG_TEST_SYSTEM=y
CONFIG_TEST_SYSTEM_OSAL=y
CONFIG_TEST_SYSTEM_HAL=y
CONFIG_TEST_SYSTEM_PCL=y
CONFIG_TEST_SYSTEM_PDL=y
CONFIG_TEST_SYSTEM_ACL=y
CONFIG_TEST_INTEGRATION=y
```
