## configs/tests/tests_arm64_full_defconfig
```kconfig
# ============================================================================
# ARM64 Full Test Configuration
# ============================================================================
# All modules, all features, all products, all applications enabled.
# Used for comprehensive full-stack testing on ARM64 platform.
# ============================================================================

# Product Selection - Disabled for testing
# CONFIG_PRODUCT_CCM is not set

# Core Components - Full Stack
CONFIG_OSAL=y
CONFIG_TEST_FRAMEWORK=y
CONFIG_HAL=y
CONFIG_PCL=y
CONFIG_PDL=y
CONFIG_PRL=y
CONFIG_ACL=y

# Architecture and OS
CONFIG_OS_LINUX=y
CONFIG_ARCH_ARM64=y

# OSAL OS Abstraction - POSIX (derived from OS_LINUX)
CONFIG_OSAL_OS_POSIX=y

# Platform
CONFIG_PLATFORM_LINUX=y

# CCM Platform
CONFIG_PROJECT_H200_AM625=y

# Build Configuration - Dynamic Libraries
CONFIG_OSAL_BUILD_SHARED=y
CONFIG_HAL_BUILD_SHARED=y
CONFIG_PCL_BUILD_SHARED=y
CONFIG_PDL_BUILD_SHARED=y
CONFIG_PRL_BUILD_SHARED=y
CONFIG_ACL_BUILD_SHARED=y

# HAL Drivers - All Enabled
CONFIG_HAL_CAN=y
CONFIG_HAL_UART=y
CONFIG_HAL_I2C=y
CONFIG_HAL_SPI=y
CONFIG_HAL_GPIO=y
CONFIG_HAL_WATCHDOG=y

# HAL Linux Drivers - All Enabled
CONFIG_HAL_CAN_LINUX=y
CONFIG_HAL_GPIO_LINUX=y
CONFIG_HAL_I2C_LINUX=y
CONFIG_HAL_SPI_LINUX=y
CONFIG_HAL_UART_LINUX=y
CONFIG_HAL_WATCHDOG_LINUX=y

# PDL Sub-modules - All Enabled
CONFIG_PDL_SATELLITE_SUPPORT=y
CONFIG_PDL_BMC_SUPPORT=y
CONFIG_PDL_MCU_SUPPORT=y
CONFIG_PDL_WATCHDOG_SUPPORT=y
CONFIG_PDL_MISC_SUPPORT=y

# PRL Protocols - All Enabled (Updated to device-based organization)
CONFIG_PRL_MCU=y
CONFIG_PRL_CCM=y
CONFIG_PRL_PMC=y
CONFIG_PRL_GSC=y
CONFIG_PRL_POWER=y

# PRL Features - All Enabled
CONFIG_PRL_CRC_CHECK=y
CONFIG_PRL_SEQUENCE_CHECK=y
CONFIG_PRL_MAX_PAYLOAD_SIZE=4096

# PDL Satellite Drivers - All Enabled
CONFIG_PDL_SATELLITE=y
CONFIG_PDL_SATELLITE_CAN=y

# PDL BMC Drivers - All Enabled
CONFIG_PDL_BMC=y
CONFIG_PDL_BMC_IPMI=y
CONFIG_PDL_BMC_REDFISH=y
CONFIG_PDL_BMC_TRANSPORT=y

# PDL MCU Drivers - All Enabled
CONFIG_PDL_MCU=y
CONFIG_PDL_MCU_CAN_SUPPORT=y
CONFIG_PDL_MCU_UART_SUPPORT=y
CONFIG_PDL_MCU_CAN=y
CONFIG_PDL_MCU_SERIAL=y
CONFIG_PDL_MCU_PROTOCOL=y


# OSAL Features - All Enabled
CONFIG_OSAL_IPC=y
CONFIG_OSAL_FILE=y
CONFIG_OSAL_THREAD=y
CONFIG_OSAL_NETWORK=y
CONFIG_OSAL_SIGNAL=y

# OSAL IPC - All Enabled
CONFIG_OSAL_IPC_ATOMIC=y
CONFIG_OSAL_IPC_MUTEX=y
CONFIG_OSAL_IPC_RWLOCK=y
CONFIG_OSAL_IPC_SEMAPHORE=y
CONFIG_OSAL_IPC_COND=y
CONFIG_OSAL_IPC_SHM=y
CONFIG_OSAL_IPC_SHM_CACHE=y

# OSAL Library - All Enabled
CONFIG_OSAL_LIB_ERRNO=y
CONFIG_OSAL_LIB_HEAP=y
CONFIG_OSAL_LIB_STDIO=y
CONFIG_OSAL_LIB_STRING=y

# OSAL System - All Enabled
CONFIG_OSAL_SYS_CLOCK=y
CONFIG_OSAL_SYS_ENV=y
CONFIG_OSAL_SYS_FILE=y
CONFIG_OSAL_SYS_PROCESS=y
CONFIG_OSAL_SYS_SCHED=y
CONFIG_OSAL_SYS_SELECT=y
CONFIG_OSAL_SYS_SIGNAL=y
CONFIG_OSAL_SYS_THREAD=y
CONFIG_OSAL_SYS_TIME=y

# OSAL Network - All Enabled
CONFIG_OSAL_NET_SOCKET=y
CONFIG_OSAL_NET_TERMIOS=y

# OSAL Utility - All Enabled
CONFIG_OSAL_UTIL_LOG=y
CONFIG_OSAL_UTIL_VERSION=y

# Testing - Enable All Tests
CONFIG_BUILD_TESTING=y
CONFIG_TEST_UNIT=y
CONFIG_TEST_PERFORMANCE=y
CONFIG_TEST_STRESS=y
CONFIG_TEST_SYSTEM=y

# ============================================================================
# Unit Tests - All Enabled
# ============================================================================

# OSAL Unit Tests - All Enabled
CONFIG_TEST_OSAL=y
CONFIG_TEST_OSAL_ALL=y
CONFIG_TEST_OSAL_ATOMIC=y
CONFIG_TEST_OSAL_CLOCK=y
CONFIG_TEST_OSAL_COND=y
CONFIG_TEST_OSAL_ENV=y
CONFIG_TEST_OSAL_ERRNO=y
CONFIG_TEST_OSAL_FILE=y
CONFIG_TEST_OSAL_HEAP=y
CONFIG_TEST_OSAL_LOG=y
CONFIG_TEST_OSAL_MUTEX=y
CONFIG_TEST_OSAL_PROCESS=y
CONFIG_TEST_OSAL_RWLOCK=y
CONFIG_TEST_OSAL_SCHED=y
CONFIG_TEST_OSAL_SEMAPHORE=y
CONFIG_TEST_OSAL_SHM=y
CONFIG_TEST_OSAL_SIGNAL=y
CONFIG_TEST_OSAL_SOCKET=y
CONFIG_TEST_OSAL_STRESS=y
CONFIG_TEST_OSAL_STRING=y
CONFIG_TEST_OSAL_THREAD=y
CONFIG_TEST_OSAL_TIME=y
CONFIG_TEST_OSAL_VERSION=y

# HAL Unit Tests - All Enabled
CONFIG_TEST_HAL=y
CONFIG_TEST_HAL_ALL=y
CONFIG_TEST_HAL_CAN=y
CONFIG_TEST_HAL_GPIO=y
CONFIG_TEST_HAL_I2C=y
CONFIG_TEST_HAL_SERIAL=y
CONFIG_TEST_HAL_SPI=y
CONFIG_TEST_HAL_WATCHDOG=y

# PDL Unit Tests - All Enabled
CONFIG_TEST_PDL=y
CONFIG_TEST_PDL_ALL=y
CONFIG_TEST_PDL_BMC=y
CONFIG_TEST_PDL_BMC_PROTOCOL=y
CONFIG_TEST_PDL_MCU=y
CONFIG_TEST_PDL_SATELLITE=y
CONFIG_TEST_PDL_WATCHDOG=y

# PRL Unit Tests - All Enabled
CONFIG_TEST_PRL=y
CONFIG_TEST_PRL_ALL=y
CONFIG_TEST_PRL_COMMON=y
CONFIG_TEST_PRL_DEVICE=y

# PCONFIG Unit Tests - All Enabled
CONFIG_TEST_PCONFIG=y
CONFIG_TEST_PCONFIG_ALL=y
CONFIG_TEST_PCONFIG_API=y

# ACONFIG Unit Tests - All Enabled
CONFIG_TEST_ACONFIG=y
CONFIG_TEST_ACONFIG_ALL=y
CONFIG_TEST_ACONFIG_API=y

# ============================================================================
# Performance Tests - All Enabled
# ============================================================================

# OSAL Performance Tests
# Performance Tests - Module Level
CONFIG_TEST_PERFORMANCE_OSAL=y
CONFIG_TEST_PERF_OSAL=y
CONFIG_TEST_PERFORMANCE_OSAL_MUTEX=y
CONFIG_TEST_PERFORMANCE_OSAL_THREAD=y
CONFIG_TEST_PERFORMANCE_OSAL_SEMAPHORE=y
CONFIG_TEST_PERFORMANCE_OSAL_SHM=y
CONFIG_TEST_PERFORMANCE_OSAL_FILE=y

# HAL Performance Tests
CONFIG_TEST_PERFORMANCE_HAL=y
CONFIG_TEST_PERF_HAL=y
CONFIG_TEST_PERFORMANCE_HAL_CAN=y
CONFIG_TEST_PERFORMANCE_HAL_GPIO=y
CONFIG_TEST_PERFORMANCE_HAL_I2C=y
CONFIG_TEST_PERFORMANCE_HAL_SPI=y

# PDL Performance Tests
CONFIG_TEST_PERFORMANCE_PDL=y
CONFIG_TEST_PERF_PDL=y
CONFIG_TEST_PERFORMANCE_PDL_MCU=y
CONFIG_TEST_PERFORMANCE_PDL_BMC=y

# ============================================================================
# Stress Tests - All Enabled
# ============================================================================

# OSAL Stress Tests
CONFIG_TEST_STRESS_OSAL=y
CONFIG_TEST_STRESS_OSAL_THREAD=y
CONFIG_TEST_STRESS_OSAL_MEMORY=y
CONFIG_TEST_STRESS_OSAL_IPC=y

# HAL Stress Tests
CONFIG_TEST_STRESS_HAL=y
CONFIG_TEST_STRESS_HAL_CONCURRENT=y
CONFIG_TEST_STRESS_HAL_HIGH_LOAD=y

# PDL Stress Tests
CONFIG_TEST_STRESS_PDL=y
CONFIG_TEST_STRESS_PDL_DEVICE=y

# ============================================================================
# System Tests - All Enabled
# ============================================================================

# OSAL System Tests
CONFIG_TEST_SYSTEM_OSAL=y
CONFIG_TEST_SYSTEM_OSAL_CROSS_MODULE=y

# HAL System Tests
CONFIG_TEST_SYSTEM_HAL=y
CONFIG_TEST_SYSTEM_HAL_MULTI_DEVICE=y

# PDL System Tests
CONFIG_TEST_SYSTEM_PDL=y
CONFIG_TEST_SYSTEM_PDL_PROTOCOL_STACK=y

# Integration Tests
CONFIG_TEST_INTEGRATION=y
CONFIG_TEST_SYSTEM_INTEGRATION=y
CONFIG_TEST_INTEGRATION_FULL_STACK=y
CONFIG_OSAL_UTIL_CRC=y
```

## configs/tests/tests_arm64_hal_defconfig
```kconfig
# ============================================================================
# ARM64 HAL Test Configuration
# ============================================================================
# 专注于 HAL 层的 ARM64 平台测试配置
# 包含完整的 HAL 驱动和测试，基于 ARM64 架构
# ============================================================================

# Architecture and OS
CONFIG_OS_LINUX=y
CONFIG_ARCH_ARM64=y

# Platform
CONFIG_PLATFORM_LINUX=y

# Core Components - HAL Stack
CONFIG_OSAL=y
CONFIG_HAL=y
CONFIG_TEST_FRAMEWORK=y

# Build Configuration - Shared Libraries for Testing
CONFIG_OSAL_BUILD_SHARED=y
CONFIG_HAL_BUILD_SHARED=y

# HAL Drivers - All Enabled
CONFIG_HAL_CAN=y
CONFIG_HAL_UART=y
CONFIG_HAL_I2C=y
CONFIG_HAL_SPI=y
CONFIG_HAL_GPIO=y
CONFIG_HAL_WATCHDOG=y

# HAL Linux Drivers - All Enabled
CONFIG_HAL_CAN_LINUX=y
CONFIG_HAL_GPIO_LINUX=y
CONFIG_HAL_I2C_LINUX=y
CONFIG_HAL_SPI_LINUX=y
CONFIG_HAL_UART_LINUX=y
CONFIG_HAL_WATCHDOG_LINUX=y

# OSAL Features - Required for HAL
CONFIG_OSAL_IPC=y
CONFIG_OSAL_FILE=y
CONFIG_OSAL_THREAD=y
CONFIG_OSAL_NETWORK=y

# OSAL IPC - Required for HAL
CONFIG_OSAL_IPC_MUTEX=y
CONFIG_OSAL_IPC_SEMAPHORE=y
CONFIG_OSAL_IPC_ATOMIC=y

# OSAL Library - Required for HAL
CONFIG_OSAL_LIB_ERRNO=y
CONFIG_OSAL_LIB_HEAP=y
CONFIG_OSAL_LIB_STRING=y
CONFIG_OSAL_LIB_STDIO=y

# OSAL System - Required for HAL
CONFIG_OSAL_SYS_CLOCK=y
CONFIG_OSAL_SYS_FILE=y
CONFIG_OSAL_SYS_PROCESS=y
CONFIG_OSAL_SYS_THREAD=y
CONFIG_OSAL_SYS_TIME=y
CONFIG_OSAL_SYS_SELECT=y
CONFIG_OSAL_SYS_POLL=y

# OSAL Network - Required for HAL
CONFIG_OSAL_NET_SOCKET=y
CONFIG_OSAL_NET_TERMIOS=y

# OSAL Utility - Required for HAL
CONFIG_OSAL_UTIL_LOG=y

# Testing - HAL Only
CONFIG_BUILD_TESTING=y
CONFIG_TEST_UNIT=y

# HAL Unit Tests - All Enabled
CONFIG_TEST_HAL=y
CONFIG_TEST_HAL_ALL=y
CONFIG_TEST_HAL_CAN=y
CONFIG_TEST_HAL_GPIO=y
CONFIG_TEST_HAL_I2C=y
CONFIG_TEST_HAL_SERIAL=y
CONFIG_TEST_HAL_SPI=y
CONFIG_TEST_HAL_WATCHDOG=y

# Other test modules disabled
# CONFIG_TEST_OSAL is not set
# CONFIG_TEST_PDL is not set
# CONFIG_TEST_PRL is not set
# CONFIG_TEST_PCONFIG is not set
# CONFIG_TEST_ACONFIG is not set
# CONFIG_TEST_PERFORMANCE is not set
# CONFIG_TEST_STRESS is not set
# CONFIG_TEST_SYSTEM is not set

# Other Modules - Disabled
# CONFIG_PCL is not set
# CONFIG_PDL is not set
# CONFIG_PRL is not set
# CONFIG_ACL is not set

# Products - Disabled
# CONFIG_PRODUCT_CCM is not set
```

## configs/tests/tests_arm64_minimal_defconfig
```kconfig
# ============================================================================
# Minimal Configuration
# ============================================================================
# 最小化配置，仅包含核心功能
# 用于资源受限的嵌入式系统或快速原型验证
# ============================================================================

# Architecture and OS
CONFIG_OS_LINUX=y
CONFIG_ARCH_ARM64=y
CONFIG_OSAL_OS_POSIX=y

# Platform
CONFIG_PLATFORM_LINUX=y

# Core Components - Minimal
CONFIG_OSAL=y
CONFIG_TEST_FRAMEWORK=y

# Build Configuration - Static Libraries for Minimal Size
# CONFIG_OSAL_BUILD_SHARED is not set

# OSAL Features - Required for Test Framework
CONFIG_OSAL_THREAD=y
CONFIG_OSAL_FILE=y

# OSAL IPC - Required for Test Framework
CONFIG_OSAL_IPC=y
CONFIG_OSAL_IPC_MUTEX=y
CONFIG_OSAL_IPC_ATOMIC=y

# OSAL Library - Required for Test Framework
CONFIG_OSAL_LIB_ERRNO=y
CONFIG_OSAL_LIB_HEAP=y
CONFIG_OSAL_LIB_STDIO=y
CONFIG_OSAL_LIB_STRING=y

# OSAL System - Required for Test Framework
CONFIG_OSAL_SYS_CLOCK=y
CONFIG_OSAL_SYS_FILE=y
CONFIG_OSAL_SYS_PROCESS=y
CONFIG_OSAL_SYS_THREAD=y
CONFIG_OSAL_SYS_TIME=y

# OSAL Utility - Required for Test Framework
CONFIG_OSAL_UTIL_LOG=y
CONFIG_OSAL_UTIL_VERSION=y

# Testing - Enabled with Fast Tests Only
CONFIG_BUILD_TESTING=y
CONFIG_TEST_UNIT=y

# OSAL Unit Tests - Fast Tests Only (exclude stress and socket)
CONFIG_TEST_OSAL=y
# CONFIG_TEST_OSAL_ALL is not set
CONFIG_TEST_OSAL_ATOMIC=y
CONFIG_TEST_OSAL_CLOCK=y
CONFIG_TEST_OSAL_ERRNO=y
CONFIG_TEST_OSAL_LOG=y
CONFIG_TEST_OSAL_MUTEX=y
CONFIG_TEST_OSAL_STRING=y
CONFIG_TEST_OSAL_TIME=y
CONFIG_TEST_OSAL_VERSION=y
# CONFIG_TEST_OSAL_COND is not set
# CONFIG_TEST_OSAL_ENV is not set
# CONFIG_TEST_OSAL_FILE is not set
# CONFIG_TEST_OSAL_HEAP is not set
# CONFIG_TEST_OSAL_PROCESS is not set
# CONFIG_TEST_OSAL_RWLOCK is not set
# CONFIG_TEST_OSAL_SCHED is not set
# CONFIG_TEST_OSAL_SEMAPHORE is not set
# CONFIG_TEST_OSAL_SHM is not set
# CONFIG_TEST_OSAL_SIGNAL is not set
# CONFIG_TEST_OSAL_SOCKET is not set
# CONFIG_TEST_OSAL_STRESS is not set
# CONFIG_TEST_OSAL_THREAD is not set

# Other test categories disabled for minimal config
# CONFIG_TEST_HAL is not set
# CONFIG_TEST_PDL is not set
# CONFIG_TEST_PRL is not set
# CONFIG_TEST_PCONFIG is not set
# CONFIG_TEST_ACONFIG is not set
# CONFIG_TEST_PERFORMANCE is not set
# CONFIG_TEST_STRESS is not set
# CONFIG_TEST_SYSTEM is not set

# Products - All Disabled
# CONFIG_PRODUCT_CCM is not set

# HAL - Disabled
# CONFIG_HAL is not set

# PDL - Disabled
# CONFIG_PDL is not set

# PRL - Disabled
# CONFIG_PRL is not set
```

## configs/tests/tests_arm64_prl_defconfig
```kconfig
# ============================================================================
# PRL Protocol Test Configuration
# ============================================================================
# PRL 协议层测试配置
# 用于测试所有设备协议的编解码功能
# ============================================================================

# Architecture and OS
CONFIG_OS_LINUX=y
CONFIG_ARCH_ARM64=y
CONFIG_OSAL_OS_POSIX=y

# Platform
CONFIG_PLATFORM_LINUX=y

# Core Components - OSAL + PRL
CONFIG_OSAL=y
CONFIG_TEST_FRAMEWORK=y
CONFIG_PRL=y

# Build Configuration
CONFIG_OSAL_BUILD_SHARED=y
CONFIG_PRL_BUILD_SHARED=y

# PRL Protocols - All Enabled for Testing
CONFIG_PRL_MCU=y
CONFIG_PRL_CCM=y
CONFIG_PRL_PMC=y
CONFIG_PRL_GSC=y
CONFIG_PRL_POWER=y

# PRL Features - All Enabled for Testing
CONFIG_PRL_CRC_CHECK=y
CONFIG_PRL_SEQUENCE_CHECK=y
CONFIG_PRL_TIMESTAMP_CHECK=y
CONFIG_PRL_MAX_PAYLOAD_SIZE=4096

# OSAL Features - Required for PRL
CONFIG_OSAL_IPC=y
CONFIG_OSAL_THREAD=y
CONFIG_OSAL_NETWORK=y
CONFIG_OSAL_FILE=y

# OSAL IPC
CONFIG_OSAL_IPC_ATOMIC=y
CONFIG_OSAL_IPC_MUTEX=y

# OSAL Library
CONFIG_OSAL_LIB_ERRNO=y
CONFIG_OSAL_LIB_HEAP=y
CONFIG_OSAL_LIB_STDIO=y
CONFIG_OSAL_LIB_STRING=y

# OSAL System
CONFIG_OSAL_SYS_CLOCK=y
CONFIG_OSAL_SYS_ENV=y
CONFIG_OSAL_SYS_FILE=y
CONFIG_OSAL_SYS_PROCESS=y
CONFIG_OSAL_SYS_SCHED=y
CONFIG_OSAL_SYS_SELECT=y
CONFIG_OSAL_SYS_THREAD=y
CONFIG_OSAL_SYS_TIME=y

# OSAL Network
CONFIG_OSAL_NET_SOCKET=y

# OSAL Utility
CONFIG_OSAL_UTIL_LOG=y
CONFIG_OSAL_UTIL_VERSION=y

# Testing - Enabled
CONFIG_BUILD_TESTING=y
CONFIG_TEST_UNIT=y

# PRL Unit Tests - All Enabled
CONFIG_TEST_PRL=y
CONFIG_TEST_PRL_ALL=y
CONFIG_TEST_PRL_COMMON=y
CONFIG_TEST_PRL_DEVICE=y

# Other test modules disabled
# CONFIG_TEST_OSAL is not set
# CONFIG_TEST_HAL is not set
# CONFIG_TEST_PDL is not set
# CONFIG_TEST_PCONFIG is not set
# CONFIG_TEST_ACONFIG is not set
# CONFIG_TEST_PERFORMANCE is not set
# CONFIG_TEST_STRESS is not set
# CONFIG_TEST_SYSTEM is not set

# Products - All Disabled
# CONFIG_PRODUCT_CCM is not set

# HAL - Disabled
# CONFIG_HAL is not set

# PDL - Disabled
# CONFIG_PDL is not set
```

## configs/tests_x86_aconfig_defconfig
```kconfig
# ============================================================================
# ACONFIG Test Configuration
# ============================================================================
# ACONFIG (Application Configuration Layer) 测试配置
# 用于测试应用配置层功能
# ============================================================================

# Architecture and OS
CONFIG_OS_LINUX=y
CONFIG_ARCH_X86_64=y

# Platform
CONFIG_PLATFORM_LINUX=y
CONFIG_PROJECT_H200_AM625=y

# Core Components - OSAL + PCONFIG + ACL
CONFIG_OSAL=y
CONFIG_TYPES=y
CONFIG_PCONFIG=y
CONFIG_ACL=y

# Build Configuration
CONFIG_OSAL_BUILD_SHARED=y
CONFIG_PCONFIG_BUILD_SHARED=y
CONFIG_ACONFIG_BUILD_SHARED=y

# OSAL Features - Required
CONFIG_OSAL_IPC=y
CONFIG_OSAL_FILE=y
CONFIG_OSAL_THREAD=y

# OSAL IPC
CONFIG_OSAL_IPC_ATOMIC=y
CONFIG_OSAL_IPC_MUTEX=y
CONFIG_OSAL_IPC_RWLOCK=y

# OSAL Library
CONFIG_OSAL_LIB_ERRNO=y
CONFIG_OSAL_LIB_HEAP=y
CONFIG_OSAL_LIB_STDIO=y
CONFIG_OSAL_LIB_STRING=y

# OSAL System - Enable All
CONFIG_OSAL_SYS_CLOCK=y
CONFIG_OSAL_SYS_ENV=y
CONFIG_OSAL_SYS_FILE=y
CONFIG_OSAL_SYS_PROCESS=y
CONFIG_OSAL_SYS_SCHED=y
CONFIG_OSAL_SYS_SELECT=y
CONFIG_OSAL_SYS_THREAD=y
CONFIG_OSAL_SYS_TIME=y

# OSAL Utility
CONFIG_OSAL_UTIL_LOG=y
CONFIG_OSAL_UTIL_VERSION=y

# Testing - Enabled
CONFIG_BUILD_TESTING=y
CONFIG_TEST_UNIT=y

# ACONFIG Unit Tests - All Enabled
CONFIG_TEST_ACONFIG=y
CONFIG_TEST_ACONFIG_ALL=y
CONFIG_TEST_ACONFIG_API=y

# Other test modules disabled
# CONFIG_TEST_OSAL is not set
# CONFIG_TEST_HAL is not set
# CONFIG_TEST_PDL is not set
# CONFIG_TEST_PRL is not set
# CONFIG_TEST_PCONFIG is not set
# CONFIG_TEST_PERFORMANCE is not set
# CONFIG_TEST_STRESS is not set
# CONFIG_TEST_SYSTEM is not set

# Products - All Disabled
# CONFIG_PRODUCT_CCM is not set

# HAL - Disabled
# CONFIG_HAL is not set

# PDL - Disabled
# CONFIG_PDL is not set

# PRL - Disabled
# CONFIG_PRL is not set
```
