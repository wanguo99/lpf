## configs/hal_test_linux_defconfig
```kconfig
# ============================================================================
# HAL Unit Test Configuration (Linux)
# ============================================================================
# Only HAL module (and its dependency OSAL) is enabled for unit testing.
# All other modules are disabled.
# ============================================================================

# Architecture and OS
CONFIG_OS_LINUX=y
CONFIG_ARCH_X86_64=y

# Platform
CONFIG_PLATFORM_LINUX=y

# Core Modules - OSAL + HAL
CONFIG_OSAL=y
CONFIG_HAL=y
# CONFIG_PCL is not set
# CONFIG_PDL is not set
# CONFIG_ACL is not set

# OSAL Build Configuration
CONFIG_OSAL_BUILD_SHARED=y

# HAL Build Configuration
CONFIG_HAL_BUILD_SHARED=y

# HAL Drivers - Enable All
CONFIG_HAL_CAN=y
CONFIG_HAL_UART=y
CONFIG_HAL_I2C=y
CONFIG_HAL_SPI=y
CONFIG_HAL_GPIO=y
CONFIG_HAL_WATCHDOG=y

# HAL Linux Drivers - Enable All
CONFIG_HAL_CAN_LINUX=y
CONFIG_HAL_GPIO_LINUX=y
CONFIG_HAL_I2C_LINUX=y
CONFIG_HAL_SPI_LINUX=y
CONFIG_HAL_UART_LINUX=y
CONFIG_HAL_WATCHDOG_LINUX=y

# OSAL Features - Enable All (HAL dependency)
CONFIG_OSAL_IPC=y
CONFIG_OSAL_FILE=y
CONFIG_OSAL_THREAD=y
CONFIG_OSAL_NETWORK=y
CONFIG_OSAL_SIGNAL=y

# OSAL IPC
CONFIG_OSAL_IPC_ATOMIC=y
CONFIG_OSAL_IPC_MUTEX=y
CONFIG_OSAL_IPC_SEMAPHORE=y
CONFIG_OSAL_IPC_COND=y
CONFIG_OSAL_IPC_SHM=y
CONFIG_OSAL_IPC_SHM_CACHE=y

# OSAL Library
CONFIG_OSAL_LIB_ERRNO=y
CONFIG_OSAL_LIB_HEAP=y
CONFIG_OSAL_LIB_STDIO=y
CONFIG_OSAL_LIB_STRING=y

# OSAL System
CONFIG_OSAL_SYS_CLOCK=y
CONFIG_OSAL_SYS_ENV=y
CONFIG_OSAL_SYS_FILE=y
CONFIG_OSAL_SYS_PROCESS=y
CONFIG_OSAL_SYS_SCHED=y
CONFIG_OSAL_SYS_SELECT=y
CONFIG_OSAL_SYS_SIGNAL=y
CONFIG_OSAL_SYS_THREAD=y
CONFIG_OSAL_SYS_TIME=y

# OSAL Network
CONFIG_OSAL_NET_SOCKET=y
CONFIG_OSAL_NET_TERMIOS=y

# OSAL Utility
CONFIG_OSAL_UTIL_LOG=y
CONFIG_OSAL_UTIL_VERSION=y

# Testing
CONFIG_BUILD_TESTING=y

# Products - All Disabled
# CONFIG_PRODUCT_CCM is not set
```

## configs/imx6ull/imx6ull_modules_defconfig
```kconfig
# ============================================================================
# PDM kernel module build configuration
# ============================================================================

CONFIG_PROJECT_NAME="modules"
CONFIG_PROJECT_VERSION="1.0.0"

CONFIG_LINUX_ONLY=y
CONFIG_OS_LINUX=y
CONFIG_ARCH_ARM32=y
CONFIG_PLATFORM_LINUX=y

CONFIG_OSAL=m
CONFIG_PDM=m
CONFIG_OSAL_PROFILE_STANDARD=y
```

## configs/imx6ull_debug_defconfig
```kconfig
# ============================================================================
# PDM print_test build configuration
# ============================================================================

CONFIG_PROJECT_NAME="print_test"
CONFIG_PROJECT_VERSION="1.0.0"

CONFIG_OS_LINUX=y
CONFIG_ARCH_ARM32=y
CONFIG_PLATFORM_LINUX=y

CONFIG_OSAL=m
CONFIG_PDM=m
CONFIG_OSAL_PROFILE_STANDARD=y
CONFIG_PRINT_TEST=y
CONFIG_SMART_MONITOR=y
CONFIG_MEMORY_MONITOR=y
```

## configs/imx6ullevk_debug_study_defconfig
```kconfig
# ============================================================================
# PDM debug_study build configuration
# ============================================================================

CONFIG_PROJECT_NAME="debug_study"
CONFIG_PROJECT_VERSION="1.0.0"

CONFIG_OS_LINUX=y
CONFIG_ARCH_ARM32=y
CONFIG_PLATFORM_LINUX=y

CONFIG_OSAL=m
CONFIG_PDM=m
CONFIG_OSAL_PROFILE_STANDARD=y
CONFIG_DEBUG_STUDY=y
```

## configs/kernel/kernel_x86_mock_modules_defconfig
```kconfig
# ============================================================================
# x86 kernel module build configuration with mock SoC backend
# ============================================================================

CONFIG_PROJECT_NAME="x86_mock_modules"
CONFIG_PROJECT_VERSION="1.0.0"

CONFIG_LINUX_ONLY=y
CONFIG_OS_LINUX=y
CONFIG_ARCH_X86_64=y
CONFIG_PLATFORM_LINUX=y

CONFIG_OSAL=m
CONFIG_LPF_CORE=m
CONFIG_LPF_SOC_ADAPTER_MOCK=y
CONFIG_LPF_RUNTIME=y
CONFIG_LPF_CONFIGS=m
CONFIG_LPF_CONFIG_KERNEL_X86_MOCK_MODULES=y

CONFIG_LPF_HW_CAN=y
CONFIG_LPF_HW_UART=y
CONFIG_LPF_HW_I2C=y
CONFIG_LPF_HW_SPI=y
CONFIG_LPF_HW_GPIO=y
CONFIG_LPF_HW_PWM=y
CONFIG_LPF_HW_MOCK_SELFTEST=m
CONFIG_LPF_DUMMY_SERVICE_SELFTEST=m
CONFIG_LPF_CONFIG_OF_SELFTEST=y

CONFIG_LPF_MCU_SERVICE=y
CONFIG_LPF_MCU_MAX_DEVICES=4
CONFIG_LPF_MCU_TRANSPORT_CAN=y
CONFIG_LPF_MCU_TRANSPORT_UART=y
CONFIG_LPF_LED_SERVICE=y
CONFIG_LPF_LED_MAX_DEVICES=8
CONFIG_LPF_PROTOCOL=y
CONFIG_LPF_PROTOCOL_MCU=y
CONFIG_LPF_PROTOCOL_CRC_CHECK=y
CONFIG_LPF_PROTOCOL_SEQUENCE_CHECK=y
CONFIG_LPF_PROTOCOL_MAX_PAYLOAD_SIZE=4096
```

## configs/kernel/kernel_x86_modules_defconfig
```kconfig
# ============================================================================
# x86 kernel module build configuration
# ============================================================================

CONFIG_PROJECT_NAME="x86_modules"
CONFIG_PROJECT_VERSION="1.0.0"

CONFIG_LINUX_ONLY=y
CONFIG_OS_LINUX=y
CONFIG_ARCH_X86_64=y
CONFIG_PLATFORM_LINUX=y

CONFIG_OSAL=y
CONFIG_LPF_CORE=y
CONFIG_HAL=y
CONFIG_LPF_PERIPHERAL_RUNTIME=y

CONFIG_HAL_CAN=y
CONFIG_HAL_UART=y
CONFIG_HAL_I2C=y
CONFIG_HAL_SPI=y
CONFIG_HAL_GPIO=y
CONFIG_HAL_PWM=y

CONFIG_LPF_MCU_SERVICE=y
CONFIG_LPF_MCU_MAX_DEVICES=4
CONFIG_LPF_MCU_TRANSPORT_CAN=y
CONFIG_LPF_MCU_TRANSPORT_UART=y
CONFIG_LPF_LED_SERVICE=y
CONFIG_LPF_LED_MAX_DEVICES=8
CONFIG_LPF_PROTOCOL=y
CONFIG_LPF_PROTOCOL_MCU=y
CONFIG_LPF_PROTOCOL_CRC_CHECK=y
CONFIG_LPF_PROTOCOL_SEQUENCE_CHECK=y
CONFIG_LPF_PROTOCOL_MAX_PAYLOAD_SIZE=4096
```

## configs/minimal_defconfig
```kconfig
# ============================================================================
# Minimal Configuration
# ============================================================================
# 最小化配置，仅包含核心功能
# 用于资源受限的嵌入式系统或快速原型验证
# ============================================================================

# Architecture and OS
CONFIG_OS_LINUX=y
CONFIG_ARCH_X86_64=y

# Platform
CONFIG_PLATFORM_LINUX=y

# Core Components - Minimal
CONFIG_OSAL=y
CONFIG_TYPES=y

# Build Configuration - Static Libraries for Minimal Size
# CONFIG_OSAL_BUILD_SHARED is not set

# OSAL Features - Minimal Required
CONFIG_OSAL_THREAD=y

# OSAL IPC - Minimal
CONFIG_OSAL_IPC=y
CONFIG_OSAL_IPC_MUTEX=y

# OSAL Library - Minimal
CONFIG_OSAL_LIB_ERRNO=y
CONFIG_OSAL_LIB_STRING=y

# OSAL System - Minimal
CONFIG_OSAL_SYS_CLOCK=y
CONFIG_OSAL_SYS_THREAD=y
CONFIG_OSAL_SYS_TIME=y

# OSAL Utility - Minimal
CONFIG_OSAL_UTIL_LOG=y

# Testing - Disabled
# CONFIG_BUILD_TESTING is not set

# Products - All Disabled
# CONFIG_PRODUCT_CCM is not set

# HAL - Disabled
# CONFIG_HAL is not set

# PDL - Disabled
# CONFIG_PDL is not set

# PRL - Disabled
# CONFIG_PRL is not set
```

## configs/osal_test_x86_defconfig
```kconfig
# ============================================================================
# OSAL Unit Test Configuration (x86_64)
# ============================================================================
# Only OSAL module is enabled for unit testing.
# All other modules are disabled.
# ============================================================================

# Architecture and OS
CONFIG_OS_LINUX=y
CONFIG_ARCH_X86_64=y

# Core Modules - Only OSAL
CONFIG_OSAL=y
# CONFIG_HAL is not set
# CONFIG_PCL is not set
# CONFIG_PDL is not set
# CONFIG_ACL is not set

# OSAL Build Configuration
CONFIG_OSAL_BUILD_SHARED=y

# OSAL Features - Enable All
CONFIG_OSAL_IPC=y
CONFIG_OSAL_FILE=y
CONFIG_OSAL_THREAD=y
CONFIG_OSAL_NETWORK=y
CONFIG_OSAL_SIGNAL=y

# OSAL IPC - Enable All
CONFIG_OSAL_IPC_ATOMIC=y
CONFIG_OSAL_IPC_MUTEX=y
CONFIG_OSAL_IPC_SEMAPHORE=y
CONFIG_OSAL_IPC_COND=y
CONFIG_OSAL_IPC_SHM=y
CONFIG_OSAL_IPC_SHM_CACHE=y

# OSAL Library - Enable All
CONFIG_OSAL_LIB_ERRNO=y
CONFIG_OSAL_LIB_HEAP=y
CONFIG_OSAL_LIB_STDIO=y
CONFIG_OSAL_LIB_STRING=y

# OSAL System - Enable All
CONFIG_OSAL_SYS_CLOCK=y
CONFIG_OSAL_SYS_ENV=y
CONFIG_OSAL_SYS_FILE=y
CONFIG_OSAL_SYS_PROCESS=y
CONFIG_OSAL_SYS_SCHED=y
CONFIG_OSAL_SYS_SELECT=y
CONFIG_OSAL_SYS_SIGNAL=y
CONFIG_OSAL_SYS_THREAD=y
CONFIG_OSAL_SYS_TIME=y

# OSAL Network - Enable All
CONFIG_OSAL_NET_SOCKET=y
CONFIG_OSAL_NET_TERMIOS=y

# OSAL Utility - Enable All
CONFIG_OSAL_UTIL_LOG=y
CONFIG_OSAL_UTIL_VERSION=y

# Testing
CONFIG_BUILD_TESTING=y

# Products - All Disabled
# CONFIG_PRODUCT_CCM is not set
```

## configs/pmc_h200_am625_release_defconfig
```kconfig
#
# PMC H200 AM625 Release Configuration
#

# Build Options
CONFIG_BUILD_TYPE_RELEASE=y
CONFIG_OPT_O2=y

# Architecture
CONFIG_ARCH_ARM32=y

# OSAL (production limits)
CONFIG_OSAL_MAX_TASKS=64
CONFIG_OSAL_MAX_QUEUES=32
CONFIG_OSAL_MAX_MUTEXES=32

# HAL (only required drivers)
CONFIG_HAL_CAN=y
CONFIG_HAL_CAN_DEVICE="can0"
CONFIG_HAL_UART=y
CONFIG_HAL_UART_DEVICE="/dev/ttyS0"
CONFIG_HAL_UART_BAUDRATE=115200
CONFIG_HAL_GPIO=y
CONFIG_HAL_WATCHDOG=y

# PDL Modules
CONFIG_PDL_MCU_ENABLE=y
CONFIG_PDL_SATELLITE_ENABLE=y
CONFIG_PDL_BMC_ENABLE=y
CONFIG_PDL_WATCHDOG_SUPPORT=y

# Product
CONFIG_PRODUCT_PMC=y
CONFIG_PROJECT_H200_AM625=y
CONFIG_BUILD_PMC_SUPERVISOR=y
CONFIG_BUILD_PMC_COLLECTOR=y
CONFIG_BUILD_PMC_COMM=y
CONFIG_BUILD_PMC_HEALTH=y
CONFIG_BUILD_PMC_LOGGER=y
```

## configs/prl_test_defconfig
```kconfig
# ============================================================================
# PRL Protocol Test Configuration
# ============================================================================
# PRL 协议层测试配置
# 用于测试所有设备协议的编解码功能
# ============================================================================

# Architecture and OS
CONFIG_OS_LINUX=y
CONFIG_ARCH_X86_64=y

# Platform
CONFIG_PLATFORM_LINUX=y

# Core Components - OSAL + PRL
CONFIG_OSAL=y
CONFIG_TYPES=y
CONFIG_PRL=y

# Build Configuration
CONFIG_OSAL_BUILD_SHARED=y
CONFIG_PRL_BUILD_SHARED=y

# PRL Protocols - All Enabled for Testing
CONFIG_PRL_MCU=y
CONFIG_PRL_CCM=y
CONFIG_PRL_PMC=y
CONFIG_PRL_GSC=y
CONFIG_PRL_POWER=y

# PRL Features - All Enabled for Testing
CONFIG_PRL_CRC_CHECK=y
CONFIG_PRL_SEQUENCE_CHECK=y
CONFIG_PRL_TIMESTAMP_CHECK=y
CONFIG_PRL_MAX_PAYLOAD_SIZE=4096

# OSAL Features - Required for PRL
CONFIG_OSAL_IPC=y
CONFIG_OSAL_THREAD=y

# OSAL IPC
CONFIG_OSAL_IPC_ATOMIC=y
CONFIG_OSAL_IPC_MUTEX=y

# OSAL Library
CONFIG_OSAL_LIB_ERRNO=y
CONFIG_OSAL_LIB_HEAP=y
CONFIG_OSAL_LIB_STRING=y

# OSAL System
CONFIG_OSAL_SYS_CLOCK=y
CONFIG_OSAL_SYS_THREAD=y
CONFIG_OSAL_SYS_TIME=y

# OSAL Utility
CONFIG_OSAL_UTIL_LOG=y
CONFIG_OSAL_UTIL_VERSION=y

# Testing - Enabled
CONFIG_BUILD_TESTING=y

# Products - All Disabled
# CONFIG_PRODUCT_CCM is not set

# HAL - Disabled
# CONFIG_HAL is not set

# PDL - Disabled
# CONFIG_PDL is not set
```

## configs/riscv64_linux_defconfig
```kconfig
#
# RISC-V 64 Linux Configuration
# Target: RISC-V 64-bit with Linux
# Purpose: RISC-V platform support for emerging architectures
# Optimization: -O2 for balanced performance
# Libraries: Shared libraries for standard Linux deployment
#

# ============================================================================
# Build Options
# ============================================================================
CONFIG_OPT_O2=y
CONFIG_LIBRARY_BUILD_TYPE_DYNAMIC=y
CONFIG_INSTALL_HEADERS=y

# ============================================================================
# Target Platform
# ============================================================================
CONFIG_ARCH_RISCV64=y
CONFIG_OS_LINUX=y
CONFIG_CROSS_COMPILE="riscv64-linux-gnu-"

# ============================================================================
# OSAL (Operating System Abstraction Layer)
# ============================================================================
CONFIG_OSAL=y
CONFIG_OSAL_BUILD_SHARED=y

# OSAL Features
CONFIG_OSAL_FILE=y
CONFIG_OSAL_NETWORK=y
CONFIG_OSAL_IPC=y
CONFIG_OSAL_THREAD=y
CONFIG_OSAL_TIME=y
CONFIG_OSAL_SIGNAL=y

# OSAL Resource Limits (Standard)
CONFIG_OSAL_MAX_TASKS=64
CONFIG_OSAL_MAX_QUEUES=32
CONFIG_OSAL_MAX_MUTEXES=32

# ============================================================================
# HAL (Hardware Abstraction Layer)
# ============================================================================
CONFIG_HAL=y
CONFIG_HAL_BUILD_SHARED=y
CONFIG_PLATFORM_GENERIC_LINUX=y

# HAL Drivers (Standard Linux drivers)
CONFIG_HAL_CAN=y
CONFIG_HAL_CAN_FILTER=y
CONFIG_HAL_CAN_ERROR_HANDLING=y

CONFIG_HAL_UART=y

CONFIG_HAL_I2C=y

CONFIG_HAL_SPI=y

CONFIG_HAL_GPIO=y
CONFIG_HAL_GPIO_INTERRUPT=y

CONFIG_HAL_WATCHDOG=y

# ============================================================================
# PCL (Protocol Control Layer)
# ============================================================================
CONFIG_PCL=y
CONFIG_PCL_BUILD_SHARED=y

# ============================================================================
# PDL (Protocol Data Layer)
# ============================================================================
CONFIG_PDL=y
CONFIG_PDL_BUILD_SHARED=y

# ============================================================================
# ACL (Application Control Layer)
# ============================================================================
CONFIG_ACL=y
CONFIG_ACL_BUILD_SHARED=y

# ============================================================================
# Products - CCM
# ============================================================================
CONFIG_PRODUCT_CCM=y
CONFIG_PROJECT_H200_AM625=y

# CCM Applications (All enabled)
CONFIG_BUILD_CCM_SUPERVISOR=y
CONFIG_BUILD_CCM_COLLECTOR=y
CONFIG_BUILD_CCM_COMM=y
CONFIG_BUILD_CCM_HEALTH=y
CONFIG_BUILD_CCM_LOGGER=y
```

## configs/sample_default_defconfig
```kconfig
# Sample Product Default Configuration

# 产品选择
CONFIG_PRODUCT_SAMPLE=y

# 启用的应用
CONFIG_APP_DEMO=y

# SDK 组件
CONFIG_OSAL=y
CONFIG_HAL=y

# 平台配置
CONFIG_OS_LINUX=y
CONFIG_ARCH_X86_64=y
CONFIG_PLATFORM_LINUX=y

# HAL 驱动配置（示例：启用常用驱动）
CONFIG_HAL_CAN=y
CONFIG_HAL_UART=y
CONFIG_HAL_GPIO=y
```
