## configs/tests_x86_full_defconfig
```kconfig
# ============================================================================
# Full Test Configuration
# ============================================================================
# All modules, all features, all products, all applications enabled.
# Used for comprehensive full-stack testing.
# ============================================================================

# Product Selection - Disabled for testing
# CONFIG_PRODUCT_CCM is not set

# Core Components - Full Stack
CONFIG_OSAL=y
CONFIG_TYPES=y
CONFIG_HAL=y
CONFIG_PCL=y
CONFIG_PDL=y
CONFIG_PRL=y
CONFIG_ACL=y

# Architecture and OS
CONFIG_OS_LINUX=y
CONFIG_ARCH_X86_64=y

# Platform
CONFIG_PLATFORM_LINUX=y

# CCM Platform
CONFIG_PROJECT_H200_AM625=y

# Build Configuration - Dynamic Libraries
CONFIG_OSAL_BUILD_SHARED=y
CONFIG_HAL_BUILD_SHARED=y
CONFIG_PCL_BUILD_SHARED=y
CONFIG_PDL_BUILD_SHARED=y
CONFIG_PRL_BUILD_SHARED=y
CONFIG_ACL_BUILD_SHARED=y

# HAL Drivers - All Enabled
CONFIG_HAL_CAN=y
CONFIG_HAL_UART=y
CONFIG_HAL_I2C=y
CONFIG_HAL_SPI=y
CONFIG_HAL_GPIO=y
CONFIG_HAL_WATCHDOG=y

# HAL Linux Drivers - All Enabled
CONFIG_HAL_CAN_LINUX=y
CONFIG_HAL_GPIO_LINUX=y
CONFIG_HAL_I2C_LINUX=y
CONFIG_HAL_SPI_LINUX=y
CONFIG_HAL_UART_LINUX=y
CONFIG_HAL_WATCHDOG_LINUX=y

# PDL Sub-modules - All Enabled
CONFIG_PDL_SATELLITE_SUPPORT=y
CONFIG_PDL_BMC_SUPPORT=y
CONFIG_PDL_MCU_SUPPORT=y
CONFIG_PDL_WATCHDOG_SUPPORT=y

# PRL Protocols - All Enabled (Updated to device-based organization)
CONFIG_PRL_MCU=y
CONFIG_PRL_CCM=y
CONFIG_PRL_PMC=y
CONFIG_PRL_GSC=y
CONFIG_PRL_POWER=y

# PRL Features - All Enabled
CONFIG_PRL_CRC_CHECK=y
CONFIG_PRL_SEQUENCE_CHECK=y
CONFIG_PRL_MAX_PAYLOAD_SIZE=4096

# PDL Satellite Drivers - All Enabled
CONFIG_PDL_SATELLITE=y
CONFIG_PDL_SATELLITE_CAN=y

# PDL BMC Drivers - All Enabled
CONFIG_PDL_BMC=y
CONFIG_PDL_BMC_IPMI=y
CONFIG_PDL_BMC_REDFISH=y
CONFIG_PDL_BMC_TRANSPORT=y

# PDL MCU Drivers - All Enabled
CONFIG_PDL_MCU=y
CONFIG_PDL_MCU_CAN_SUPPORT=y
CONFIG_PDL_MCU_UART_SUPPORT=y
CONFIG_PDL_MCU_CAN=y
CONFIG_PDL_MCU_SERIAL=y
CONFIG_PDL_MCU_PROTOCOL=y


# OSAL Features - All Enabled
CONFIG_OSAL_IPC=y
CONFIG_OSAL_FILE=y
CONFIG_OSAL_THREAD=y
CONFIG_OSAL_NETWORK=y
CONFIG_OSAL_SIGNAL=y

# OSAL IPC - All Enabled
CONFIG_OSAL_IPC_ATOMIC=y
CONFIG_OSAL_IPC_MUTEX=y
CONFIG_OSAL_IPC_RWLOCK=y
CONFIG_OSAL_IPC_SEMAPHORE=y
CONFIG_OSAL_IPC_COND=y
CONFIG_OSAL_IPC_SHM=y
CONFIG_OSAL_IPC_SHM_CACHE=y

# OSAL Library - All Enabled
CONFIG_OSAL_LIB_ERRNO=y
CONFIG_OSAL_LIB_HEAP=y
CONFIG_OSAL_LIB_STDIO=y
CONFIG_OSAL_LIB_STRING=y

# OSAL System - All Enabled
CONFIG_OSAL_SYS_CLOCK=y
CONFIG_OSAL_SYS_ENV=y
CONFIG_OSAL_SYS_FILE=y
CONFIG_OSAL_SYS_PROCESS=y
CONFIG_OSAL_SYS_SCHED=y
CONFIG_OSAL_SYS_SELECT=y
CONFIG_OSAL_SYS_SIGNAL=y
CONFIG_OSAL_SYS_THREAD=y
CONFIG_OSAL_SYS_TIME=y

# OSAL Network - All Enabled
CONFIG_OSAL_NET_SOCKET=y
CONFIG_OSAL_NET_TERMIOS=y

# OSAL Utility - All Enabled
CONFIG_OSAL_UTIL_LOG=y
CONFIG_OSAL_UTIL_VERSION=y

# Testing - Enable All Tests
CONFIG_BUILD_TESTING=y
CONFIG_TEST_UNIT=y
CONFIG_TEST_OSAL=y
CONFIG_TEST_HAL=y
CONFIG_TEST_PCONFIG=y
CONFIG_TEST_PDL=y
CONFIG_TEST_ACONFIG=y
CONFIG_TEST_PRL=y
```

## configs/tests_x86_system_defconfig
```kconfig
# ============================================================================
# System Test Configuration
# ============================================================================
# All core modules enabled with one product (CCM) and selected applications.
# Used for system integration testing.
# ============================================================================

# Product Selection
CONFIG_PRODUCT_CCM=y

# Core Components - Full Stack
CONFIG_OSAL=y
CONFIG_HAL=y
CONFIG_PCL=y
CONFIG_PDL=y
CONFIG_ACL=y

# Architecture and OS
CONFIG_OS_LINUX=y
CONFIG_ARCH_X86_64=y

# Platform
CONFIG_PLATFORM_LINUX=y

# CCM Platform
CONFIG_PROJECT_H200_AM625=y

# Build Configuration - Dynamic Libraries
CONFIG_OSAL_BUILD_SHARED=y
CONFIG_HAL_BUILD_SHARED=y
CONFIG_PCL_BUILD_SHARED=y
CONFIG_PDL_BUILD_SHARED=y
CONFIG_ACL_BUILD_SHARED=y

# HAL Drivers
CONFIG_HAL_CAN=y
CONFIG_HAL_UART=y
CONFIG_HAL_I2C=y
CONFIG_HAL_SPI=y
CONFIG_HAL_GPIO=y
CONFIG_HAL_WATCHDOG=y

# HAL Linux Drivers
CONFIG_HAL_CAN_LINUX=y
CONFIG_HAL_GPIO_LINUX=y
CONFIG_HAL_I2C_LINUX=y
CONFIG_HAL_SPI_LINUX=y
CONFIG_HAL_UART_LINUX=y
CONFIG_HAL_WATCHDOG_LINUX=y

# PDL Sub-modules
CONFIG_PDL_SATELLITE_SUPPORT=y
CONFIG_PDL_BMC_SUPPORT=y
CONFIG_PDL_MCU_SUPPORT=y
CONFIG_PDL_WATCHDOG_SUPPORT=y

# PDL Satellite Drivers
CONFIG_PDL_SATELLITE=y
CONFIG_PDL_SATELLITE_CAN=y

# PDL BMC Drivers
CONFIG_PDL_BMC=y
CONFIG_PDL_BMC_IPMI=y
CONFIG_PDL_BMC_REDFISH=y
CONFIG_PDL_BMC_TRANSPORT=y

# PDL MCU Drivers
CONFIG_PDL_MCU=y
CONFIG_PDL_MCU_CAN_SUPPORT=y
CONFIG_PDL_MCU_UART_SUPPORT=y
CONFIG_PDL_MCU_CAN=y
CONFIG_PDL_MCU_SERIAL=y
CONFIG_PDL_MCU_PROTOCOL=y

# CCM Libraries
CONFIG_LIBCCM=y

# CCM Applications - Selected for System Test
CONFIG_APP_COLLECTOR=y
CONFIG_APP_COMM=y
CONFIG_APP_LOGGER=y
CONFIG_APP_HEALTH=y

# OSAL Features
CONFIG_OSAL_IPC=y
CONFIG_OSAL_FILE=y
CONFIG_OSAL_THREAD=y
CONFIG_OSAL_NETWORK=y
CONFIG_OSAL_SIGNAL=y

# OSAL IPC
CONFIG_OSAL_IPC_ATOMIC=y
CONFIG_OSAL_IPC_MUTEX=y
CONFIG_OSAL_IPC_SEMAPHORE=y
CONFIG_OSAL_IPC_COND=y
CONFIG_OSAL_IPC_SHM=y
CONFIG_OSAL_IPC_SHM_CACHE=y

# OSAL Library
CONFIG_OSAL_LIB_ERRNO=y
CONFIG_OSAL_LIB_HEAP=y
CONFIG_OSAL_LIB_STDIO=y
CONFIG_OSAL_LIB_STRING=y

# OSAL System
CONFIG_OSAL_SYS_CLOCK=y
CONFIG_OSAL_SYS_ENV=y
CONFIG_OSAL_SYS_FILE=y
CONFIG_OSAL_SYS_PROCESS=y
CONFIG_OSAL_SYS_SCHED=y
CONFIG_OSAL_SYS_SELECT=y
CONFIG_OSAL_SYS_SIGNAL=y
CONFIG_OSAL_SYS_THREAD=y
CONFIG_OSAL_SYS_TIME=y

# OSAL Network
CONFIG_OSAL_NET_SOCKET=y
CONFIG_OSAL_NET_TERMIOS=y

# OSAL Utility
CONFIG_OSAL_UTIL_LOG=y
CONFIG_OSAL_UTIL_VERSION=y

# Testing
CONFIG_BUILD_TESTING=y
CONFIG_TEST_SYSTEM=y
CONFIG_TEST_SYSTEM_OSAL=y
CONFIG_TEST_SYSTEM_HAL=y
CONFIG_TEST_SYSTEM_PDL=y
CONFIG_TEST_INTEGRATION=y
```

## configs/ubuntu/ubuntu_x86_modules_defconfig
```kconfig
# ============================================================================
# PDM kernel module build configuration
# ============================================================================

CONFIG_PROJECT_NAME="x86_modules"
CONFIG_PROJECT_VERSION="1.0.0"

CONFIG_LINUX_ONLY=y
CONFIG_OS_LINUX=y
CONFIG_ARCH_X86_64=y
CONFIG_PLATFORM_LINUX=y

CONFIG_OSAL=m
CONFIG_PDM=m
CONFIG_OSAL_PROFILE_STANDARD=y
```

## configs/ubuntu_x86_mock_modules_defconfig
```kconfig
# ============================================================================
# PDM kernel module build configuration
# ============================================================================

CONFIG_PROJECT_NAME="x86_mock_modules"
CONFIG_PROJECT_VERSION="1.0.0"

CONFIG_OS_LINUX=y
CONFIG_ARCH_X86_64=y
CONFIG_PLATFORM_LINUX=y

CONFIG_OSAL=m
CONFIG_PDM=m
CONFIG_OSAL_PROFILE_STANDARD=y

CONFIG_PDM_MOCK_DEVICES=y
```

## configs/x86_64_ci_defconfig
```kconfig
#
# x86_64 CI/CD Configuration
# Target: x86_64 Linux
# Purpose: Continuous Integration and automated testing
# Optimization: -O2 for realistic performance testing
# Libraries: Both static and shared for comprehensive CI coverage
#

# ============================================================================
# Build Options
# ============================================================================
CONFIG_OPT_O2=y
CONFIG_LIBRARY_BUILD_TYPE_STATIC=y
CONFIG_LIBRARY_BUILD_TYPE_DYNAMIC=y
CONFIG_INSTALL_HEADERS=y

# ============================================================================
# Target Platform
# ============================================================================
CONFIG_ARCH_X86_64=y
CONFIG_OS_LINUX=y
CONFIG_CROSS_COMPILE=""

# ============================================================================
# OSAL (Operating System Abstraction Layer)
# ============================================================================
CONFIG_OSAL=y
CONFIG_OSAL_BUILD_STATIC=y
CONFIG_OSAL_BUILD_SHARED=y

# OSAL Features (All enabled for CI testing)
CONFIG_OSAL_FILE=y
CONFIG_OSAL_NETWORK=y
CONFIG_OSAL_IPC=y
CONFIG_OSAL_THREAD=y
CONFIG_OSAL_TIME=y
CONFIG_OSAL_SIGNAL=y

# OSAL Resource Limits (Standard)
CONFIG_OSAL_MAX_TASKS=128
CONFIG_OSAL_MAX_QUEUES=64
CONFIG_OSAL_MAX_MUTEXES=64

# OSAL Debug (for CI diagnostics)
CONFIG_OSAL_DEBUG_LOGGING=y

# ============================================================================
# HAL (Hardware Abstraction Layer)
# ============================================================================
CONFIG_HAL=y
CONFIG_HAL_BUILD_STATIC=y
CONFIG_HAL_BUILD_SHARED=y
CONFIG_PLATFORM_GENERIC_LINUX=y

# HAL Advanced Features (for CI testing)
CONFIG_HAL_DEBUG=y
CONFIG_HAL_STATISTICS=y

# HAL Drivers (All enabled with loopback for CI)
CONFIG_HAL_CAN=y
CONFIG_HAL_CAN_FILTER=y
CONFIG_HAL_CAN_ERROR_HANDLING=y
CONFIG_HAL_CAN_LOOPBACK=y

CONFIG_HAL_UART=y
CONFIG_HAL_UART_FLOW_CONTROL=y

CONFIG_HAL_I2C=y

CONFIG_HAL_SPI=y

CONFIG_HAL_GPIO=y
CONFIG_HAL_GPIO_INTERRUPT=y

CONFIG_HAL_WATCHDOG=y

# ============================================================================
# PCL (Protocol Control Layer)
# ============================================================================
CONFIG_PCL=y
CONFIG_PCL_BUILD_STATIC=y
CONFIG_PCL_BUILD_SHARED=y

# ============================================================================
# PDL (Protocol Data Layer)
# ============================================================================
CONFIG_PDL=y
CONFIG_PDL_BUILD_STATIC=y
CONFIG_PDL_BUILD_SHARED=y

# ============================================================================
# ACL (Application Control Layer)
# ============================================================================
CONFIG_ACL=y
CONFIG_ACL_BUILD_STATIC=y
CONFIG_ACL_BUILD_SHARED=y

# ============================================================================
# Products - CCM
# ============================================================================
CONFIG_PRODUCT_CCM=y
CONFIG_PROJECT_H200_AM625=y

# CCM Applications (All enabled for CI)
CONFIG_BUILD_CCM_SUPERVISOR=y
CONFIG_BUILD_CCM_COLLECTOR=y
CONFIG_BUILD_CCM_COMM=y
CONFIG_BUILD_CCM_HEALTH=y
CONFIG_BUILD_CCM_LOGGER=y

# ============================================================================
# Test Configuration
# ============================================================================
CONFIG_BUILD_TESTING=y
```

## configs/x86_64_minimal_defconfig
```kconfig
#
# EMS x86_64 Minimal Configuration
# Target: x86_64 Linux
# Purpose: Minimal footprint for resource-constrained systems
# Optimization: -Os for smallest binary size
# Libraries: Static libraries only
#

# ============================================================================
# Build Options
# ============================================================================
CONFIG_OPT_OS=y
CONFIG_LIBRARY_BUILD_TYPE_STATIC=y
CONFIG_LIBRARY_BUILD_TYPE_DYNAMIC=y

# ============================================================================
# Target Platform
# ============================================================================
CONFIG_ARCH_X86_64=y
CONFIG_OS_LINUX=y
CONFIG_CROSS_COMPILE=""

# ============================================================================
# OSAL (Operating System Abstraction Layer)
# ============================================================================
CONFIG_OSAL=y
CONFIG_OSAL_BUILD_STATIC=y
CONFIG_OSAL_BUILD_SHARED=y

# OSAL Features (Minimal - only essential)
CONFIG_OSAL_FILE=y
CONFIG_OSAL_IPC=y
CONFIG_OSAL_THREAD=y

# OSAL Resource Limits (Minimal)
CONFIG_OSAL_MAX_TASKS=32
CONFIG_OSAL_MAX_QUEUES=16
CONFIG_OSAL_MAX_MUTEXES=16

# OSAL 细粒度配置（最小集）
CONFIG_OSAL_IPC_MUTEX=y
CONFIG_OSAL_IPC_SEMAPHORE=y
CONFIG_OSAL_FILE_FILE=y
CONFIG_OSAL_FILE_PROCESS=y
CONFIG_OSAL_THREAD_THREAD=y
CONFIG_OSAL_THREAD_TIME=y

# ============================================================================
# HAL (Hardware Abstraction Layer)
# ============================================================================
CONFIG_HAL=y
CONFIG_HAL_BUILD_STATIC=y
CONFIG_HAL_BUILD_SHARED=y
CONFIG_PLATFORM_GENERIC_LINUX=y

# HAL Drivers (Essential only)
CONFIG_HAL_UART=y
CONFIG_HAL_UART_LINUX=y

CONFIG_HAL_WATCHDOG=y
CONFIG_HAL_WATCHDOG_LINUX=y

# ============================================================================
# PCL (Protocol Control Layer)
# ============================================================================
CONFIG_PCL=y
CONFIG_PCL_BUILD_STATIC=y
CONFIG_PCL_BUILD_SHARED=y

# PCL 细粒度配置
CONFIG_PCL_API=y
CONFIG_PCL_REGISTER=y

# ============================================================================
# PDL (Protocol Data Layer)
# ============================================================================
CONFIG_PDL=y
CONFIG_PDL_BUILD_STATIC=y
CONFIG_PDL_BUILD_SHARED=y

# ============================================================================
# ACL (Application Control Layer)
# ============================================================================
CONFIG_ACL=y
CONFIG_ACL_BUILD_STATIC=y
CONFIG_ACL_BUILD_SHARED=y

# ACL 细粒度配置
CONFIG_ACL_API=y
CONFIG_ACL_TELEMETRY_CACHE=y

# ============================================================================
# Products - CCM
# ============================================================================
CONFIG_PRODUCT_CCM=y
CONFIG_PROJECT_H200_AM625=y

# CCM Applications (Essential only)
CONFIG_BUILD_CCM_SUPERVISOR=y
CONFIG_BUILD_CCM_LOGGER=y
```
